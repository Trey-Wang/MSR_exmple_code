AUTOSAR XML (schema 4-0-3)
package /MICROSAR/vCanCcCdm
  module definition Cdd [0..1]: category=VENDOR_SPECIFIC_MODULE_DEFINITION, api-service-prefix=vCanCcCdm, refined-module-def=Cdd, variants pre-compile  # The CDD module describes the minimal requirements that are necessary for the configuration of a CDD with respect to the surrounding standardized BSW modules.
    container CddComStackContribution [0..1]  # Contribution of COM Stack modules.
      container CddComIfUpperLayerContribution [0..1]  # Parameters that are necessary for the configuration of a Complex Device Driver that serves as the UpperLayer of the Com Interface module.
        container CddComIfUpperLayerRxPdu [1..*]  # This container specifies Rx PDUs that are exchanged between the CDD and the standardized BSW module.
          integer CddComIfHandleId: 0..65535, set at pre-compile, symbolic-name-value=true, default-value=65535  # ECU wide unique, symbolic handle for the Pdu.
          reference CddComIfPduRef: set at pre-compile, destination=Pdu  # Reference to the "global" Pdu structure to allow harmonization of handle IDs in the COM-Stack.
        container CddComIfUpperLayerTxPdu [1..*]  # This container specifies Tx PDUs that are exchanged between the CDD and the standardized BSW module.
          integer CddComIfHandleId: 0..65535, set at pre-compile, symbolic-name-value=true, default-value=65535  # ECU wide unique, symbolic handle for the Pdu.
          reference CddComIfPduRef: set at pre-compile, destination=Pdu  # Reference to the "global" Pdu structure to allow harmonization of handle IDs in the COM-Stack.
    container CddGeneral  # Container defines all general configuration parameters of the vCanCcCdmr.
      boolean CddVersionInfoApi: set at pre-compile, origin=Vector Informatik, default-value=false  # This parameter enables/disables the function vCanCcCdm_GetVersionInfo() to get major, minor and patch version information.
      boolean CddDevErrorDetect: set at pre-compile, origin=Vector Informatik, default-value=true  # This parameter switches the Development Error Detection and Notification ON or OFF. true: Development error detection is enabled. false: Development error detection is disabled. Note: In general, the development error detection is recommended during pre-test phase. It is not recommended to enable the development error detection in production code due to increased runtime and ROM needs. Note: Independetly from the configuration of this parameter, Development Error Detection is still enabled if parameter CddSafeBswChecks is true. See description of CddSafeBswChecks for more details.
      boolean CddSafeBswChecks: set at pre-compile, origin=Vector Informatik, default-value=false  # Selects if safety checks are used. These checks improve robustness as e.g. invalid parameters are checked before function is executed. This attribute has to be enabled for safety projects where this component is mapped to an ASIL partition.
      integer CddMinRxMessagesPerS: 0..20, set at pre-compile, origin=Vector Informatik, default-value=9
      integer CddMaxRxMessagesPerS: 0..20, set at pre-compile, origin=Vector Informatik, default-value=11
      integer CddMaxSkippedMessages [0..1]: 0..100, set at pre-compile, origin=Vector Informatik
      boolean CddNotifyApplication: set at pre-compile, origin=Vector Informatik, default-value=true
      function name CddIntialValueFunction: set at pre-compile, origin=Vector Informatik
      boolean CddUseBswMForComRequest: set at pre-compile, origin=Vector Informatik, default-value=true  # Use BswM For Com Request
      reference CddCommunicationRequest [0..1]: set at pre-compile, origin=Vector Informatik, destination=BswMGenericRequest  # Reference to a BswM Generic Request Mode that is used by vCanCcCdm to enable / disable the possibility to communicate via CAN. Note: If this parameter is not configured, the module expects the proper running of the CAN channel. During start of communication no communication request will be executed then.
    container CddNotificationFunctions [0..1]
      function name CddH108WeldingDetectedCbk [0..1]: set at pre-compile, origin=Vector Informatik
      function name CddH108OutputCurrentChangedCbk [0..1]: set at pre-compile, origin=Vector Informatik
      function name CddH108ThresholdVoltageChangedCbk [0..1]: set at pre-compile, origin=Vector Informatik
      function name CddH109PresentCurrentChangedCbk [0..1]: set at pre-compile, origin=Vector Informatik
      function name CddH109PresentVoltageChangedCbk [0..1]: set at pre-compile, origin=Vector Informatik
      function name CddH109StatusFaultFlagsChangedCbk [0..1]: set at pre-compile, origin=Vector Informatik
      function name CddNoDataReceptionCbk [0..1]: set at pre-compile, origin=Vector Informatik
  bsw implementation Cdd_Impl: programming-language=C, sw-version=1.00.00, used-code-generator=DaVinci Configurator, vendor-id=30, ar-release-version=4.00.03, behavior=vCanCcCdmBehavior, preconfigured-configuration=Cdd_Pre, recommended-configuration=Cdd_Rec, vendor-specific-module-def=Cdd
  module config Cdd_Pre: definition=Cdd
  module config Cdd_Rec: definition=Cdd
