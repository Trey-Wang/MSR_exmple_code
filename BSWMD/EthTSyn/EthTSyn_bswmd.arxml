AUTOSAR XML (schema 4-3-0)
# COPYRIGHT
# Copyright (c) 2017 by Vector Informatik GmbH. All rights reserved.
# This software is copyright protected and proprietary to Vector Informatik GmbH.
# Vector Informatik GmbH grants to you only those rights as set out in the license conditions.
package /MICROSAR
  module definition EthTSyn [0..1]: category=VENDOR_SPECIFIC_MODULE_DEFINITION, refined-module-def=EthTSyn, variants pre-compile  # Configuration of the Synchronized Time-base Manager (StbM) module with respect to global time handling on Ethernet.
    container EthTSynGeneral: multiplicity set at pre-compile  # This container holds the general parameters of the Ethernet-specific Synchronized Time-base Manager
      string EthTSynDestPhyAddr: multiplicity set at pre-compile, set at pre-compile, default-value=01:80:C2:00:00:0E  # Destination Physical Address (MAC-Address). | Destination Physical Hardware Address (MAC-Address) of EthTSyn-gPTP Frames. Input format has to match xx:xx:xx:xx:xx:xx, where x stands for a hex value between 0 and F.
      boolean EthTSynDevErrorDetect: multiplicity set at pre-compile, set at pre-compile, default-value=false  # Switches the development error detection and notification on or off. | * true: detection and notification is enabled. * false: detection and notification is disabled.
      float EthTSynGlobalTimeRxToUplinkSwitchResidenceTime [0..1]: 0..4294967295, multiplicity set at pre-compile, set at pre-compile, default-value=4000  # This parameter is specifying the default value used for the residence time of the Ethernet Switch [Ingress to Uplink]. | This value is used by the EthTSyn if the calculation of the residence time failed. Unit: seconds
      float EthTSynGlobalTimeUplinkToTxSwitchResidenceTime [0..1]: 0..4294967295, multiplicity set at pre-compile, set at pre-compile, default-value=4000  # This parameter is specifying the default value used for the residence time of the Ethernet Switch [Uplink to Egress]. | This value is used by the EthTSyn if the calculation of the residence time failed. Unit: seconds
      boolean EthTSynHardwareTimestampSupport: multiplicity set at pre-compile, set at pre-compile, default-value=false  # Activate/Deactivate the hardware time stamping functionality of the Ethernet hardware. | True: Timestamp is retrieved from the Ethernet hardware False: Timestamp is retrieved from the StbM
      float EthTSynMainFunctionPeriod: 0..65535, multiplicity set at pre-compile, set at pre-compile, default-value=0.05  # Schedule period of the main function EthTSyn_MainFunction. | Unit: seconds.
      boolean EthTSynMasterSlaveConflictDetection: multiplicity set at pre-compile, set at pre-compile, default-value=false  # Unused Parameter! Enables master / slave conflict detection and notification. | * true: detection and notification is enabled. * false: detection and notification is disabled.
      boolean EthTSynMessageCompliance: multiplicity set at pre-compile, set at pre-compile, default-value=false  # * true: IEEE 802.1AS compliant message format will be used. | * false: IEEE 802.1AS message format with AUTOSAR extension will be used.
      integer EthTSynSwitchMgmtRxMessageBufferCount [0..1]: 1..254, multiplicity set at pre-compile, set at pre-compile, default-value=10  # This parameter is used to determine the amount of Rx message buffers available in the EthTSyn when EthTSyn is used in a Bridge configuration.
      boolean EthTSynVersionInfoApi: multiplicity set at pre-compile, set at pre-compile, default-value=false  # Activate/Deactivate the version information API (EthTSyn_GetVersionInfo). True: version information API activated False: version information API deactivated.
      string EthTSynUserConfigFile [0..1]: multiplicity set at pre-compile, origin=Vector Informatik, set at pre-compile  # Reference to an external user configuration file that will be included during generation. The content of the user configuration file will be added at the end of the generated module configuration file and allows altering or extending the generated code. Caution: User configuration files can cause the software module to malfunction and must only be used with great care!
      string EthTSynPublicCddHeaderFile [0..*]: multiplicity set at pre-compile, origin=Vector Informatik, set at pre-compile  # Defines header files for call-back functions (e.g. Sync / FollowUp sent) which shall be included in case of CDDs. Range of characters is 1.. 32.
      boolean EthTSynSwitchMgmtGmCapable [0..1]: multiplicity set at pre-compile, origin=Vector Informatik, set at pre-compile, default-value=false  # Select whether the EthTSyn can act as Grand Master. In a bridge configuration, the ECU will take over the role of the GM in case a Sync-Timeout is detected on the Slave-Port.
      boolean EthTSynSwitchMgmtSwitchTimestampSupport [0..1]: multiplicity set at pre-compile, origin=Vector Informatik, set at pre-compile, default-value=false  # When EthTSyn is used to manage the Time Sync Protocol on an Ethernet Switch, this parameter is used to enable the support of Timestamps generated by the Ethernet Switch. For EthTSyn-Ports mapping to an Ethernet Switch Port, the Timestamps provided by the Ethernet Switch will be used. For EthTSyn-Ports mapping to an Ethernet Controller but not to an Ethernet Switch Port (i.e. End-Station Port), the configured TimestampMethod will be used.
      integer EthTSynSwitchMgmtRxMessageBufferPayloadSize [0..1]: 42..1500, multiplicity set at pre-compile, origin=Vector Informatik, set at pre-compile, default-value=42  # This parameter is specifying the size of the payload partion for each Bridge message buffer in Bytes.
      boolean EthTSynEnableSwitchMgmt: multiplicity set at pre-compile, origin=Vector Informatik, set at pre-compile, default-value=false  # This parameter is used to determin if the Switch management functionality of the EthTSyn is enabled or disabled.
      boolean EthTSynSafeBswChecks: multiplicity set at pre-compile, origin=Vector Informatik, set at pre-compile, default-value=false  # Selects if safety checks are used. These checks improve robustness as e.g. invalid parameters are checked before function is executed. This attribute has to be enabled for safety projects where this component is mapped to an ASIL partition.
      reference EthTSynEthIfFrameType: multiplicity set at pre-compile, set at pre-compile, destination=EthIfFrameOwnerConfig  # The chosen frame owner determines which frames (in respect to ethertype) are received.
    container EthTSynGlobalTimeDomain [1..*]: multiplicity set at pre-compile  # This represents the existence of a global time domain on Ethernet. The EthTSyn module can administrate several global time domains at the same time that in itself form a hierarchy of domains and sub-domains. | If the EthTSyn exists it is assumed that at least one global time domain exists.
      integer EthTSynGlobalTimeDomainId: 0..31, multiplicity set at pre-compile, set at pre-compile, default-value=0  # The global time domain ID.
      boolean EthTSynSwitchMgmtKeepSourcePortIdentity [0..1]: multiplicity set at pre-compile, origin=Vector Informatik, set at pre-compile, default-value=false  # This parameter is only used in a bridge configuration. When this parameter is enabled, the source port identity of forwarded Sync/FollowUp messages is not modified.
      float EthTSynSwitchMgmtGlobalTimeSyncTimeout [0..1]: 0..254, multiplicity set at pre-compile, origin=Vector Informatik, set at pre-compile, default-value=0.25  # This parameter is only used in a Bridge configuration. It specifies the time, the bridge is waiting for the reception of a new Sync message on its slave port before a Grand Master timeout is assumed and the Bridge begins to generate its own Sync and FollowUp messages.
      boolean EthTSynIsOffsetTimeDomain: multiplicity set at pre-compile, origin=Vector Informatik, set at pre-compile, default-value=false  # Information only (computed automatically). This parameter is set to 'TRUE' if the TimeDomain is an offset TimeDomain (TimeDomainId [16;31]).
      symbolic name reference EthTSynSynchronizedTimeBaseRef: multiplicity set at pre-compile, set at pre-compile, destination=StbMSynchronizedTimeBase  # Reference to the synchronized time-base. Note: Only Microsar StbM is supported.
      container EthTSynGlobalTimeFollowUpDataIDList [0..1]: multiplicity set at pre-compile, post-build-variant-multiplicity=true  # The DataIDList for Follow_Up message ensures the identification of data elements due to CRC calculation process.
        container EthTSynGlobalTimeFollowUpDataIDListElement [16..16]: multiplicity set at pre-compile  # Element of the DataIDList for Follow_Up message ensures the identification of data elements due to CRC calculation process.
          integer EthTSynGlobalTimeFollowUpDataIDListIndex: 0..15, multiplicity set at pre-compile, post-build-variant-value=true, set at pre-compile, default-value=0  # Index of the DataIDList for Follow_Up message ensures the identification of data elements due to CRC calculation process.
          integer EthTSynGlobalTimeFollowUpDataIDListValue: 0..255, multiplicity set at pre-compile, post-build-variant-value=true, set at pre-compile, default-value=0  # Value of the DataIDList for Follow_Up message ensures the identification of data elements due to CRC calculation process.
      container EthTSynPortConfig [1..*]: multiplicity set at pre-compile, post-build-variant-multiplicity=true  # Configuration of the EthTSyn-Ports within the TimeDomain.
        integer EthTSynFramePrio [0..1]: 0..7, multiplicity set at pre-compile, post-build-variant-multiplicity=true, post-build-variant-value=true, set at pre-compile, default-value=0  # This optional parameter, if present, indicates the priority of outgoing EthTSyn messages, if sent via VLAN (used for the 3-bit PCP field of the VLAN tag). If this optional parameter is not present, frames are sent without a priority and VLAN field.
        float EthTSynGlobalTimeDebounceTime: 0..4, multiplicity set at pre-compile, post-build-variant-value=true, set at pre-compile, default-value=0.05  # Unused Parameter! This represents the configuration of a TX debounce time for Sync and Follow_Up messages compared to a message before with the same PDU. Unit: seconds
        integer EthTSynPortNumber: 0..65534, multiplicity set at pre-compile, origin=Vector Informatik, set at pre-compile, default-value=0  # Determines the Port Number
        symbolic name reference EthTSynGlobalTimeEthIfRef: multiplicity set at pre-compile, set at pre-compile, destination=EthIfController  # This represents the reference to the Ethernet interface taken to fetch the global time information.
        symbolic name reference EthTSynSwitchManagementEthSwitchPortRef [0..1]: multiplicity set at pre-compile, set at pre-compile, destination=EthSwtPort  # In an AVB-Bridge config, this reference is used to assign the EthTSyn-Port to an Ethernet Switch-Port.
        container EthTSynPdelayConfig [0..1]: multiplicity set at pre-compile  # Configuration of cyclic propagation delay measurement.
          boolean EthTSynGlobalTimePdelayRespEnable: multiplicity set at pre-compile, post-build-variant-value=true, set at pre-compile, default-value=true  # This parameter allows disabling Pdelay_Resp / Pdelay_Resp_Follow_Up transmission, if no Pdelay_Req messages are expected. | FALSE: No Pdelay requests expected. Pdelay_Resp / Pdelay_Resp_Follow_Up transmission is disabled. TRUE: Pdelay requests expected. Pdelay_Resp / Pdelay_Resp_Follow_Up transmission is enabled.
          float EthTSynGlobalTimePropagationDelay: 0..4, multiplicity set at pre-compile, post-build-variant-value=true, set at pre-compile, default-value=0  # If cyclic propagation delay measurement is enabled, this parameter represents the default value of the propagation delay until the first actually measured propagation delay is available. If cyclic propagation delay measurement is disabled, this parameter represents the static value of the propagation delay. | If cyclic propagation delay measurement is disabled, this parameter replaces a measured propagation delay by a fixed value. Unit: seconds
          float EthTSynGlobalTimeTxPdelayReqPeriod: 0..65535, multiplicity set at pre-compile, post-build-variant-value=true, set at pre-compile, default-value=1  # This represents configuration of the TX period for Pdelay_Req messages. | A value of 0 disables the cyclic Pdelay measurement. Unit: seconds
          float EthTSynPdelayRespAndRespFollowUpTimeout: 0..4, multiplicity set at pre-compile, set at pre-compile, default-value=1  # Timeout value for Pdelay_Resp and Pdelay_Resp_Follow_Up after a Pdelay_Req has been transmitted resp. a Pdelay_Resp has been received. | A value of 0 deactivates this timeout observation. Unit: seconds
          integer EthTSynPdelayAverageWeight [0..1]: 1..255, multiplicity set at pre-compile, origin=Vector Informatik, set at pre-compile, default-value=30  # Represents weight factor (w) for PathDelay calculation: NewPathDelay = ( ( (w - 1) * OldPathDelay) + CurrentPathDelay) / w
          integer EthTSynPdelayReqAllowedLostResponses [0..1]: 0..255, multiplicity set at pre-compile, origin=Vector Informatik, set at pre-compile, default-value=3  # Determines the number of allowed lost responses of a PDelay_Request. If this count is exceeded, a reset of the corresponding EthTSynGlobalTimeDomain port occurs.
          float EthTSynPdelayNeighborDelayThreshold [0..1]: 0..4, multiplicity set at pre-compile, origin=Vector Informatik, set at pre-compile, default-value=1E-05  # Timeout value for Pdelay_Resp and Pdelay_Resp_Follow_Up after a Pdelay_Req has been transmitted resp. a Pdelay_Resp has been received.
          boolean EthTSynUseStaticPdelay: multiplicity set at pre-compile, origin=Vector Informatik, set at pre-compile, default-value=false  # When this parameter is set to TRUE, the configured Pdelay value (EthTSynGlobalTimePropagationDelay) always. The optional Pdelay measurement does not affect this value.
          boolean EthTSynAlwaysAsCapable: multiplicity set at pre-compile, origin=Vector Informatik, set at pre-compile, default-value=true  # Always AsCapable | This parameter sets ASCapable to true without checking for a gPTP-capable counterpart via Pdelay-Mechanism. According to IEEE 802.1AS this parameter must be false and is set automatically to true if a gPTP-capable device at the other end of the link is detected.
        choice container EthTSynPortRole: multiplicity set at pre-compile  # Specifying the Role of the EthTSyn-Port (Master or Slave).
          container EthTSynGlobalTimeMaster [0..1]: multiplicity set at pre-compile, post-build-variant-multiplicity=true  # Configuration of the global time master. Each global time domain is required to have exactly one global time master. This master may or may not exist on the configured ECU.
            float EthTSynCyclicMsgResumeTime: 0..1.7976931348623157E+308, multiplicity set at pre-compile, post-build-variant-value=true, set at pre-compile, default-value=0  # Defines the time where the 1st regular cycle time based message transmission takes place, after an immediate transmission before. Unit: seconds
            enumeration EthTSynGlobalTimeTxCrcSecured: {CRC_NOT_SUPPORTED, CRC_SUPPORTED}, multiplicity set at pre-compile, post-build-variant-value=true, set at pre-compile, default-value=CRC_NOT_SUPPORTED  # This represents the configuration of whether or not CRC is supported.
            float EthTSynGlobalTimeTxPeriod: 0..1.7976931348623157E+308, multiplicity set at pre-compile, post-build-variant-value=true, set at pre-compile, default-value=0.125  # This represents configuration of the TX period. Unit: seconds
            boolean EthTSynImmediateTimeSync: multiplicity set at pre-compile, post-build-variant-value=true, set at pre-compile, default-value=false  # Enables/Disables the cyclic polling of StbM_GetTimeBaseUpdateCounter() within EthTSyn_MainFunction().
            boolean EthTSynIsSystemWideGlobalTimeMaster: multiplicity set at pre-compile, post-build-variant-value=true, set at pre-compile, default-value=false  # This represents the configuration whether or not the global time master represents the root of a tree of global time domains. | It is possible that several global time masters exist that have set this parameter set to true because the global time masters exist once per global time domain and one ECU may start several global time domains on different busses it is connected to.
            boolean EthTSynTLVFollowUpOFSSubTLV: multiplicity set at pre-compile, post-build-variant-value=true, set at pre-compile, default-value=false  # This represents the configuration of whether an AUTOSAR Follow_Up TLV OFS Sub-TLV is used or not. | * true: This represents a configuration where an AUTOSAR Follow_Up TLV OFS Sub-TLV is used. * false: This represents a configuration where an AUTOSAR Follow_Up TLV OFS Sub-TLV is not used.
            boolean EthTSynTLVFollowUpStatusSubTLV: multiplicity set at pre-compile, post-build-variant-value=true, set at pre-compile, default-value=false  # This represents the configuration of whether an AUTOSAR Follow_Up TLV Status Sub-TLV is used or not. | * true: This represents a configuration where an AUTOSAR Follow_Up TLV Status Sub-TLV is used. * false: This represents a configuration where an AUTOSAR Follow_Up TLV Status Sub-TLV is not used.
            boolean EthTSynTLVFollowUpTimeSubTLV: multiplicity set at pre-compile, post-build-variant-value=true, set at pre-compile, default-value=false  # This represents the configuration of whether an AUTOSAR Follow_Up TLV Time Sub-TLV is used or not. | * true: This represents a configuration where an AUTOSAR Follow_Up TLV Time Sub-TLV is used. * false: This represents a configuration where an AUTOSAR Follow_Up TLV Time Sub-TLV is not used.
            boolean EthTSynTLVFollowUpUserDataSubTLV: multiplicity set at pre-compile, post-build-variant-value=true, set at pre-compile, default-value=false  # This represents the configuration of whether an AUTOSAR Follow_Up TLV UserData Sub-TLV is used or not. | * true: This represents a configuration where an AUTOSAR Follow_Up TLV UserData Sub-TLV is used. * false: This represents a configuration where an AUTOSAR Follow_Up TLV UserData Sub-TLV is not used.
            function name EthTSynSyncSentCallBackFunction [0..1]: multiplicity set at pre-compile, origin=Vector Informatik, set at pre-compile, min-length=1  # This function is called after a SYNC message has successfully been transmitted. Call-back function has following signature: FUNC(void, ETHTSYN_CODE) EthTSyn_SyncSentCallback(EthTSyn_PortIdxType PrtIdx, ETHTSYN_P2CONST(EthTSyn_CommonMsgHdrType) ComMsgPtr, ETHTSYN_P2CONST(EthTSyn_SyncMsgPtr) SyncMsgPtr);
            function name EthTSynFollowUpSentCallBackFunction [0..1]: multiplicity set at pre-compile, origin=Vector Informatik, set at pre-compile, min-length=1  # This function is called after a FOLLOW_UP message has successfully been transmitted. Call-back function has following signature: FUNC(void, ETHTSYN_CODE) EthTSyn_FollowUpSentCallback(EthTSyn_PortIdxType PrtIdx, ETHTSYN_P2CONST(EthTSyn_CommonMsgHdrType) ComMsgPtr, ETHTSYN_P2CONST(EthTSyn_FollowUpMsgType) FollowUpMsgPtr);
            boolean EthTSynTxAnnounce: multiplicity set at pre-compile, origin=Vector Informatik, set at pre-compile, default-value=false  # Transmit Announce | Determines whether EthTSyn sends Announce messages when port is in role master.
            container EthTSynCrcTimeFlagsTxSecured [0..1]: multiplicity set at pre-compile, post-build-variant-multiplicity=true  # This container collects definitions which parts of the Follow_Up message elements shall be used for CRC calculation.
              boolean EthTSynCrcCorrectionField: multiplicity set at pre-compile, post-build-variant-value=true, set at pre-compile, default-value=false  # correctionField from the Follow_Up Message Header shall be included in CRC calculation.
              boolean EthTSynCrcDomainNumber: multiplicity set at pre-compile, post-build-variant-value=true, set at pre-compile, default-value=false  # domainNumber from the Follow_Up Message Header shall be included in CRC calculation.
              boolean EthTSynCrcMessageLength: multiplicity set at pre-compile, post-build-variant-value=true, set at pre-compile, default-value=false  # messageLength from the Follow_Up Message Header shall be included in CRC calculation.
              boolean EthTSynCrcPreciseOriginTimestamp: multiplicity set at pre-compile, post-build-variant-value=true, set at pre-compile, default-value=true  # preciseOriginTimestamp from the Follow_Up Message Field shall be included in CRC calculation.
              boolean EthTSynCrcSequenceId: multiplicity set at pre-compile, post-build-variant-value=true, set at pre-compile, default-value=false  # sequenceId from the Follow_Up Message Header shall be included in CRC calculation.
              boolean EthTSynCrcSourcePortIdentity: multiplicity set at pre-compile, post-build-variant-value=true, set at pre-compile, default-value=false  # sourcePortIdentity from the Follow_Up Message Header shall be included in CRC calculation.
          container EthTSynGlobalTimeSlave [0..1]: multiplicity set at pre-compile, post-build-variant-multiplicity=true  # Configuration of a time slave. Each global time domain is required to have at least one time slave. The configured ECU may or may not represent a time slave.
            float EthTSynGlobalTimeFollowUpTimeout: 0..4, multiplicity set at pre-compile, post-build-variant-value=true, set at pre-compile, default-value=0.125  # Timeout value of the Follow_Up message (of the subsequent Sync message). A value of 0 deactivates this timeout observation. | A value of 0 deactivates this timeout observation. Unit: seconds
            enumeration EthTSynRxCrcValidated: {CRC_IGNORED, CRC_NOT_VALIDATED, CRC_OPTIONAL, CRC_VALIDATED}, multiplicity set at pre-compile, post-build-variant-value=true, set at pre-compile, default-value=CRC_IGNORED  # Definition of whether or not validation of the CRC is supported.
            integer EthTSynAnnounceMaxStepRemoved [0..1]: 1..254, multiplicity set at pre-compile, origin=Vector Informatik, set at pre-compile, default-value=7  # This represents the maximum number of network hops between the Grandmaster and this slave.
            float EthTSynAnnounceTimeout [0..1]: 0..65535, multiplicity set at pre-compile, origin=Vector Informatik, set at pre-compile, default-value=0.1  # Determines the maximum delay time in ms between expected and incoming Announce message sent by the master.
            boolean EthTSynEnableAnnounce: multiplicity set at pre-compile, origin=Vector Informatik, set at pre-compile, default-value=false  # When this option is enabled, the slave has to receive an valid annouce message before synchronization is possible. The slave stores the ClockIdentity of the GrandMaster (received via announce message) and validates Sync/FollowUp messages using this clock identity.
            boolean EthTSynEnableSourcePortIdentityCheck: multiplicity set at pre-compile, origin=Vector Informatik, set at pre-compile, default-value=false  # This parameter speciefies whether the SourcePortIdentity of received Sync/FollowUp messages should be verified or not.
            container EthTSynCrcFlagsRxValidated [0..1]: multiplicity set at pre-compile, post-build-variant-multiplicity=true  # This container collects definitions which parts of the Follow_Up message elements shall be included in CRC validation.
              boolean EthTSynCrcCorrectionField: multiplicity set at pre-compile, post-build-variant-value=true, set at pre-compile, default-value=false  # correctionField from the Follow_Up Message Header shall be included in CRC calculation.
              boolean EthTSynCrcDomainNumber: multiplicity set at pre-compile, post-build-variant-value=true, set at pre-compile, default-value=false  # domainNumber from the Follow_Up Message Header shall be included in CRC calculation.
              boolean EthTSynCrcMessageLength: multiplicity set at pre-compile, post-build-variant-value=true, set at pre-compile, default-value=false  # messageLength from the Follow_Up Message Header shall be included in CRC calculation.
              boolean EthTSynCrcPreciseOriginTimestamp: multiplicity set at pre-compile, post-build-variant-value=true, set at pre-compile, default-value=true  # preciseOriginTimestamp from the Follow_Up Message Field shall be included in CRC calculation.
              boolean EthTSynCrcSequenceId: multiplicity set at pre-compile, post-build-variant-value=true, set at pre-compile, default-value=false  # sequenceId from the Follow_Up Message Header shall be included in CRC calculation.
              boolean EthTSynCrcSourcePortIdentity: multiplicity set at pre-compile, post-build-variant-value=true, set at pre-compile, default-value=false  # sourcePortIdentity from the Follow_Up Message Header shall be included in CRC calculation.
            container EthTSynSourcePortIdentityCheckConfig [0..1]: multiplicity set at pre-compile  # Configuration of the Master Source Port Identity used to verifiy the Source Port Identity of Sync/FollowUp received by the slave if Source Port Identity Check is enabled.
              string EthTSynMasterPhysicalAddress: multiplicity set at pre-compile, origin=Vector Informatik, set at pre-compile, max-length=17, min-length=17  # The Physical Hardware Address (MAC-Address) of Time Master. Input format has to match xx::xx::xx::xx::xx::xx, where x stands for a hex value between 0 and F.
              integer EthTSynMasterPortNumber: 0..65535, multiplicity set at pre-compile, origin=Vector Informatik, set at pre-compile, default-value=0  # The Port Number of the time master.
  bsw implementation EthTSyn_Impl: programming-language=C, sw-version=5.01.01, used-code-generator=DaVinci Configurator, vendor-id=30, ar-release-version=4.03.00, behavior=EthTSynBehavior, preconfigured-configuration=EthTSyn_Pre, recommended-configuration=EthTSyn_Rec, vendor-specific-module-def=EthTSyn
  module config EthTSyn_Pre: definition=EthTSyn
  module config EthTSyn_Rec: definition=EthTSyn
