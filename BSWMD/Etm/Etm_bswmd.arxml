AUTOSAR XML (schema 4-1-1)
# COPYRIGHT
# Copyright (c) 2017 by Vector Informatik GmbH. All rights reserved.
# This software is copyright protected and proprietary to Vector Informatik GmbH.
# Vector Informatik GmbH grants to you only those rights as set out in the license conditions.
package /MICROSAR
  bsw implementation Etm_Impl: programming-language=C, sw-version=5.01.01, used-code-generator=DaVinci Configurator, vendor-id=30, ar-release-version=4.02.01, behavior=EtmBehavior, vendor-specific-module-def=Etm
  module definition Etm [0..1]: category=VENDOR_SPECIFIC_MODULE_DEFINITION, refined-module-def=Etm, variants pre-compile  # Configuration of the Etm module. (Ethernet Testability Module for TCP/IP for interaction with IxANVL from Ixia)
    container EtmGeneral  # This container specifies all general parameters used by the Test Stub for the ETM protocol. (Ethernet Testability Module for TCP/IP for interaction with IxANVL from Ixia)
      boolean EtmVersionInfoApi: set at pre-compile, origin=Vector Informatik, default-value=false  # This parameter enables/disables the Version Info API.
      boolean EtmDevErrorDetect: set at pre-compile, origin=Vector Informatik, default-value=true  # This parameter enables/disables the Development Error Detection and Notification mechanism.
      float EtmMainFunctionCycleTime: 0..32.767, set at pre-compile, origin=Vector Informatik, default-value=0.005  # This parameter specifies the periodically cycle time of the Main Function.
    container EtmConfig  # This container specifies all specific parameters used by the Test Stub for the ETM protocol. (Ethernet Testability Module for TCP/IP for interaction with IxANVL from Ixia)
      integer EtmServiceId: 0..65535, set at pre-compile, origin=Vector Informatik, default-value=261  # This parameter specifies the SOME/IP ServiceId used for communication. This parameter have to match with the Testers version.
      integer EtmStubListenPort: 0..65535, set at pre-compile, origin=Vector Informatik, default-value=10000  # This parameter specifies the Tester Stub's command channel port.
      enumeration EtmProtocolVersion: {Version_0_4, Version_0_5, Version_0_6, Version_1_0}, set at pre-compile, origin=Vector Informatik, default-value=Version_1_0  # This parameter specifies the used Protocol Version. This parameter have to match with the Testers Protocol Version.
      integer EtmMaxForwardLength: 0..65535, set at pre-compile, origin=Vector Informatik, default-value=1500  # This parameter specifies the maximum length used for the forwarded data in ReceiveAndForward events.
      boolean EtmSupportAnyAddresses: set at pre-compile, origin=Vector Informatik, default-value=false  # Support Any (Bind) Addresses | This parameter specifies if ANY LocalAddresses should be used for address bindings.
      boolean EtmSupportDefaultAddresses: set at pre-compile, origin=Vector Informatik, default-value=false  # Support Default (Bind) Addresses | This parameter specifies if a default LocalAddress should be used. The default LocalAddress is used in case no LocalAddress match the received address. As default the 'normal' IPv4/IPv6 LocalAddres is used.
      boolean EtmSupportMulticastAddresses: set at pre-compile, origin=Vector Informatik, default-value=false  # Support Multicast (Bind) Addresses | This parameter specifies if Multicast LocalAddresses should be used for address bindings.
      integer EtmNumberTestChannelsUdp: 0..255, set at pre-compile, origin=Vector Informatik, default-value=1  # This parameter specifies the Tester Stub's number of UDP test channels that can be used in parallel. Number of parallel UDP test channels.
      integer EtmNumberTestChannelsTcp [0..1]: 0..255, set at pre-compile, origin=Vector Informatik, default-value=1  # This parameter specifies the Tester Stub's number of TCP test channels that can be used in parallel. Number of parallel TCP test channels. This parameter is required if TCP is used.
      integer EtmNumberTestChannelsTcpListen [0..1]: 0..255, set at pre-compile, origin=Vector Informatik, default-value=1  # This parameter specifies the Tester Stub's number of TCP ports that can be used in parallel. Number of parallel TCP ports (derived from SocketOwner). This parameter is required if TCP is used.
      integer EtmTcpTestChannelBufferSizeRx [0..1]: 1..65535, set at pre-compile, origin=Vector Informatik, default-value=1500  # This parameter specifies the Tester Stub's TCP test channel Rx buffer size. This parameter is required if TCP is used.
      integer EtmTcpTestChannelBufferSizeTx [0..1]: 1..65535, set at pre-compile, origin=Vector Informatik, default-value=1500  # This parameter specifies the Tester Stub's TCP test channel Tx buffer size. This parameter is required if TCP is used.
      integer EtmTcpCommandChannelBufferSizeRx [0..1]: 1..65535, set at pre-compile, origin=Vector Informatik, default-value=256  # This parameter specifies the Tester Stub's TCP command channel Rx buffer size. This parameter is required if TCP is used.
      integer EtmTcpCommandChannelBufferSizeTx [0..1]: 1..65535, set at pre-compile, origin=Vector Informatik, default-value=256  # This parameter specifies the Tester Stub's TCP command channel Tx buffer size. This parameter is required if TCP is used.
      boolean EtmCommandChannelUdpV4: set at pre-compile, origin=Vector Informatik, default-value=true  # UDP over IPv4 Enabled (Command- and Test-Channel) | This parameter enables/disables the usage of UDP over IPv4 for command and test channels.
      boolean EtmCommandChannelUdpV6: set at pre-compile, origin=Vector Informatik, default-value=false  # UDP over IPv6 Enabled (Command- and Test-Channel) | This parameter enables/disables the usage of UDP over IPv6 for command and test channels.
      boolean EtmCommandChannelTcpV4: set at pre-compile, origin=Vector Informatik, default-value=false  # TCP over IPv4 Enabled (Command- and Test-Channel) | This parameter enables/disables the usage of TCP over IPv4 for command and test channels.
      boolean EtmCommandChannelTcpV6: set at pre-compile, origin=Vector Informatik, default-value=false  # TCP over IPv6 Enabled (Command- and Test-Channel) | This parameter enables/disables the usage of TCP over IPv6 for command and test channels.
      integer EtmStubMaxCommandSize: 0..65535, set at pre-compile, origin=Vector Informatik, default-value=100  # This parameter specifies the maximum length used by a received send command to save them locally until they are (asynchronously) finished. The buffer size should be greater or equal to the largest send command on the bus. Normally the payload pattern is repeated so a small buffer can be used.
      symbolic name reference EtmLocalAddressRefIPv4 [0..1]: set at pre-compile, origin=Vector Informatik, destination=TcpIpLocalAddr  # Reference to the LocalAddress the Tester should use for address bindings. Refers to an IPv4 LocallAddress. If enabled this IPv4 address is used as default.
      symbolic name reference EtmLocalAddressRefIPv6 [0..1]: set at pre-compile, origin=Vector Informatik, destination=TcpIpLocalAddr  # Reference to the LocalAddress the Tester should use for address bindings. Refers to an IPv6 LocallAddress. If enabled this IPv6 address is used as default.
      symbolic name reference EtmLocalAddressRefIPv4Any [0..1]: set at pre-compile, origin=Vector Informatik, destination=TcpIpLocalAddr  # Reference to the ANY LocalAddress the Tester should use for address bindings. Refers to an IPv4 ANY LocallAddress. This address is not needed in alle cases.
      symbolic name reference EtmLocalAddressRefIPv6Any [0..1]: set at pre-compile, origin=Vector Informatik, destination=TcpIpLocalAddr  # Reference to the ANY LocalAddress the Tester should use for address bindings. Refers to an IPv6 ANY LocallAddress. This address is not needed in alle cases.
      symbolic name reference EtmLocalAddressRefIPv4Multicast [0..1]: set at pre-compile, origin=Vector Informatik, destination=TcpIpLocalAddr  # Reference to the Multicast LocalAddress the Tester should use for address bindings. Refers to an IPv4 Multicast LocallAddress. This address is not needed in alle cases.
      symbolic name reference EtmLocalAddressRefIPv6Multicast [0..1]: set at pre-compile, origin=Vector Informatik, destination=TcpIpLocalAddr  # Reference to the Multicast LocalAddress the Tester should use for address bindings. Refers to an IPv6 Multicast LocallAddress. This address is not needed in alle cases.
    container EtmUserConfig [0..1]  # This container specifies all user specific parameters
      boolean EtmUseTcpIpInternalErrorCodes: set at pre-compile, origin=Vector Informatik, default-value=false  # This parameter specifies if TcpIp internal error codes are used within the stub's service primitive response messages. The TcpIp internal error codes are merged with the service primitive's result to indicate 'advanced' errors.
      string EtmUserConfigFile [0..1]: set at pre-compile, origin=Vector Informatik  # Reference to an external user configuration file that will be included during generation. The content of the user configuration file will be added at the end of the generated module configuration file and allows altering or extending the generated code. Caution: User configuration files can cause the software module to malfunction and must only be used with great care!
    container EtmUserScriptConfig [0..1]  # This container specifies all specific parameters used by the UserScript implementation
      integer EtmUserScriptLocalDataBufferSize: 0..65535, set at pre-compile, origin=Vector Informatik, default-value=50  # This parameter specifies the size of the local data buffer used for user script commands. The buffer should be able to save the largest user script command received over Udp and/or EthIf
      boolean EtmUserScriptOverEthIfInterface: set at pre-compile, origin=Vector Informatik, default-value=false  # This parameter specifies if receiption over EthIf for UserScript commands is enabled. The reception of UserScript commands over Udp is enabled in both cases.
    container EtmNvmBlock [0..1]  # This container specifies if Etm supports deactivation. If this container exists the Etm Service Primitive and command processing can be deactivated or activated. The Etm state (active/inactive) is saved in the NVM and can be changed by the use of e.g. an diagnostic service. If this container is missing Etm is allways active and process all incomming Service Primitives and commands. An Etm startup value has to be configured in the NVM.
      enumeration EtmProcessing: {DEFAULT_ACTIVE, DEFAULT_INACTIVE}, set at pre-compile, origin=Vector Informatik, default-value=DEFAULT_INACTIVE  # This parameter specifies Etm default behavior after start up if Service Primitive and command processing is enabled or not.
      reference EtmBlockDescriptorRef: set at pre-compile, origin=Vector Informatik, destination=NvMBlockDescriptor  # Reference to the NVM Block where the Activation/Deactivation status is saved. This parameter is only used if SupportDeactivation is TRUE.
