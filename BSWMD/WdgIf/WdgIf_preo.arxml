AUTOSAR XML (schema 4-0-3)
package /MICROSAR
  module config WdgIf_Pre: definition=WdgIf
