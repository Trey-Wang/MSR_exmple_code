AUTOSAR XML (schema 4-1-2)
package /MICROSAR
  module definition J1939Dcm [0..1]: category=VENDOR_SPECIFIC_MODULE_DEFINITION, refined-module-def=J1939Dcm, variants pre-compile/post-build-loadable/post-build-selectable  # The SAE J1939 Dcm module
    container J1939DcmConfigSet  # This container contains the configuration parameters and sub containers of the J1939DCM module supporting multiple configuration sets. | This container is a MultipleConfigurationContainer, i.e. this container and its sub-containers exist once per configuration set.
      container J1939DcmChannel [1..16]  # Contains the J1939DcmChannel parameters.
        enumeration J1939DcmBusType: {J1939DCM_ISO9141, J1939DCM_J1587, J1939DCM_J1850, J1939DCM_J1922, J1939DCM_J1939_NETWORK_1, J1939DCM_J1939_NETWORK_2, J1939DCM_J1939_NETWORK_3, J1939DCM_OTHER}, set at post-build in variant post-build-loadable+post-build-selectable / pre-compile in variant pre-compile, default-value=J1939DCM_J1939_NETWORK_1  # Identifies the communication port
        boolean J1939DcmIsobusChannel [0..1]: set at post-build in variant post-build-loadable+post-build-selectable / pre-compile in variant pre-compile, origin=Vector Informatik, default-value=false  # ISOBUS Channel | Identifies this channel as an ISOBUS (ISO 11873) channel. If enabled, the handling of the Acknowledge (ACKM) message conforms with ISO 11783, otherwise with SAE J1939. In contrast to J1939, which uses the AddressAcknowledged field (and corresponding fields for the other acknowledgement types), ISO 11783 uses the destination address of the ACKM message to identify the node which originated the acknowledged action.
        symbolic name reference J1939DcmComMChannelRef: set at post-build in variant post-build-loadable+post-build-selectable / pre-compile in variant pre-compile, destination=ComMChannel  # Reference to the ComMChannel.
      container J1939DcmNode [1..*]  # Contains the parameters for the support of a logical J1939 node (identified by an ECU address).
        integer J1939DcmSPNsInDataStream [0..*]: 0..524287, set at post-build in variant post-build-loadable+post-build-selectable / pre-compile in variant pre-compile, default-value=0  # SPNs in Data Stream | Defines the SPNs available in data stream for use in DM24.
        reference J1939DcmNodeChannelRef [0..1]: set at pre-compile, destination=J1939DcmChannel  # NOT USED. References to all J1939DcmChannels this node has access to.
        symbolic name reference J1939DcmNmNodeRef: set at pre-compile, destination=J1939NmNode  # Reference to the corresponding J1939Nm node.
        symbolic name reference J1939DcmRmUserRef: set at post-build in variant post-build-loadable+post-build-selectable / pre-compile in variant pre-compile, origin=Vector Informatik, destination=J1939RmUser  # Reference to the corresponding J1939RmUser.
        container J1939DcmDiagnosticMessageSupport [1..*]: post-build-changeable=true  # Contains parameters to configure the diagnostic message support
          enumeration J1939DcmDmxSupport: {J1939DCM_DM10_SUPPORT, J1939DCM_DM11_SUPPORT, J1939DCM_DM12_SUPPORT, J1939DCM_DM13_SUPPORT, J1939DCM_DM14_SUPPORT, J1939DCM_DM15_SUPPORT, J1939DCM_DM16_SUPPORT, J1939DCM_DM17_SUPPORT, J1939DCM_DM18_SUPPORT, J1939DCM_DM19_SUPPORT, J1939DCM_DM1_SUPPORT, J1939DCM_DM20_SUPPORT, J1939DCM_DM21_SUPPORT, J1939DCM_DM22_SUPPORT, J1939DCM_DM23_SUPPORT, J1939DCM_DM24_SUPPORT, J1939DCM_DM25_SUPPORT, J1939DCM_DM26_SUPPORT, J1939DCM_DM27_SUPPORT, J1939DCM_DM28_SUPPORT, J1939DCM_DM29_SUPPORT, J1939DCM_DM2_SUPPORT, J1939DCM_DM30_SUPPORT, J1939DCM_DM31_SUPPORT, J1939DCM_DM32_SUPPORT, J1939DCM_DM33_SUPPORT, J1939DCM_DM34_SUPPORT, J1939DCM_DM35_SUPPORT, J1939DCM_DM36_SUPPORT, J1939DCM_DM37_SUPPORT, J1939DCM_DM38_SUPPORT, J1939DCM_DM39_SUPPORT, J1939DCM_DM3_SUPPORT, J1939DCM_DM40_SUPPORT, J1939DCM_DM41_SUPPORT, J1939DCM_DM42_SUPPORT, J1939DCM_DM43_SUPPORT, J1939DCM_DM44_SUPPORT, J1939DCM_DM45_SUPPORT, J1939DCM_DM46_SUPPORT, J1939DCM_DM47_SUPPORT, J1939DCM_DM48_SUPPORT, J1939DCM_DM49_SUPPORT, J1939DCM_DM4_SUPPORT, J1939DCM_DM50_SUPPORT, J1939DCM_DM51_SUPPORT, J1939DCM_DM52_SUPPORT, J1939DCM_DM5_SUPPORT, J1939DCM_DM6_SUPPORT, J1939DCM_DM7_SUPPORT, J1939DCM_DM8_SUPPORT, J1939DCM_DM9_SUPPORT, J1939DCM_DM53_SUPPORT, J1939DCM_DM54_SUPPORT, J1939DCM_DM55_SUPPORT, J1939DCM_DM56_SUPPORT, J1939DCM_DM57_SUPPORT}, set at pre-compile, default-value=J1939DCM_DM1_SUPPORT  # This parameter is used to identify the actual DMx message.
          reference J1939DcmDiagnosticMessageSupportChannelRef: set at post-build in variant post-build-loadable+post-build-selectable / pre-compile in variant pre-compile, origin=Vector Informatik, destination=J1939DcmChannel  # Reference to J1939DcmChannel for which this diagnostic message is supported.
          container J1939DcmRxPdu [0..1]: post-build-changeable=true  # Contains parameters to configure the J1939DcmRxPdu.
            integer J1939DcmRxPduId: 0..65535, set at pre-compile, symbolic-name-value=true, default-value=0  # The I-PDU identifier used for communication with PduR.
            reference J1939DcmRxPduRef: set at post-build in variant post-build-loadable+post-build-selectable / pre-compile in variant pre-compile, destination=Pdu  # Reference to the global Pdu element in the Ecuc module.
          container J1939DcmTxPdu [0..1]: post-build-changeable=true  # Contains parameters to configure the J1939DcmTxPdu.
            integer J1939DcmTxPduId: 0..65535, set at pre-compile, symbolic-name-value=true, default-value=0  # The I-PDU identifier used to identify the Tx message.
            reference J1939DcmTxPduRef: set at post-build in variant post-build-loadable+post-build-selectable / pre-compile in variant pre-compile, destination=Pdu  # Reference to the global Pdu element in the Ecuc module.
    container J1939DcmGeneral  # Contains the general configuration parameters of the module.
      integer J1939DcmCommonBufferSize: 1..1785, set at pre-compile, default-value=1785  # Size of common buffer (in Bytes). The buffer size should be as large as the longest command or response message. Note: the max message size allowed by J1939 is 1785
      integer J1939DcmDM1BufferSize [0..1]: 1..1785, set at pre-compile, default-value=1785  # Size of DM1 buffer (in Bytes). The buffer size should be as large as the longest DM1 response message Note: the max message size allowed by J1939 is 1785.
      boolean J1939DcmDevErrorDetect: set at pre-compile, default-value=true  # Pre-processor switch for enabling development error detection support.
      float J1939DcmMainFunctionPeriod: 0.001..0.255, set at pre-compile, default-value=0.01  # Call cycle in seconds of J1939Dcm_MainFunction.
      integer J1939DcmMaxDTCsPerMainFunction [0..1]: 1..255, set at pre-compile, default-value=1  # Max DTCs Per Main Function | Maximum threshold of DTCs filtered in a single MainFunction cycle.
      integer J1939DcmMaxFreezeFramesPerMainFunction [0..1]: 1..255, set at pre-compile, default-value=1  # Maximum threshold of FreezeFrames filtered in a single MainFunction cycle.
      integer J1939DcmMaxRatiosPerMainFunction [0..1]: 1..255, set at pre-compile, default-value=1  # Maximum threshold of Ratios filtered in a single MainFunction cycle.
      boolean J1939DcmVersionInfoApi: set at pre-compile, default-value=false  # Pre-processor switch for enabling version info API support.
      float J1939DcmTxTimeout [0..1]: 0..Inf, set at pre-compile, origin=Vector Informatik, default-value=1  # This value specifies a timeout in case the lower layer aborts a transmission without a final TxConfirmation (e.g. in case of bus off).
      string J1939DcmUserConfigFile [0..1]: configuration-class-affection=affection-kind=PC-AFFECTS-LT-AND-PB, set at pre-compile, origin=Vector Informatik  # Reference to an external text file that will be included during generation to J1939Dcm_Cfg.h. The content of the user configuration file will be added at the end of the generated module configuration file and allows altering or extending the generated code. Caution: User configuration files can cause the software module to malfunction and must only be used with great care!
      container J1939DcmMemAccessFunctions [0..1]  # Contains call-out functions which are needed by the memory access PGNs DM14...DM18. If no memory access is needed, this container is optional.
        function name J1939DcmMemRequestIndicationFunc: set at pre-compile, origin=Vector Informatik, default-value=NULL_PTR  # Function is called to indicate a reception of DM14 (Memory Access Request). Function pointer definition: J1939Dcm_MemRequestRxFuncType
        function name J1939DcmMemResponseTxConfFunc: set at pre-compile, origin=Vector Informatik, default-value=NULL_PTR  # Function is called to indicate that DM15 (Memory Access Response) have been successfully transmitted. Function pointer definition: J1939Dcm_MemResponseTxConfFuncType Note: for transmission of DM15, the J1939Dcm provides the API J1939Dcm_MemAccessResponseTx
        function name J1939DcmMemDataStartOfReceptionFunc: set at pre-compile, origin=Vector Informatik, default-value=NULL_PTR  # Function is called to indicate the beginning of a memory data message reception (DM16 or DM18). Function pointer definition: J1939Dcm_MemDataRxStartFuncType
        function name J1939DcmMemDataCopyRxFunc: set at pre-compile, origin=Vector Informatik, default-value=NULL_PTR  # Function is called during reception of a memory data message (DM16 or DM18) to copy data to the application. Function pointer definition: J1939Dcm_MemDataCopyFuncType
        function name J1939DcmMemDataRxIndicationFunc: set at pre-compile, origin=Vector Informatik, default-value=NULL_PTR  # Function is called to indicate that a memory data message have been received (DM16, DM17 or DM18). For DM17, also the received data is included. Function pointer definition: J1939Dcm_MemDataRxIndicationFuncType
        function name J1939DcmMemDataTxConfFunc: set at pre-compile, origin=Vector Informatik, default-value=NULL_PTR  # Function is called to indicate that DM16 (Memory Access Binary Data) or DM18 (Memory Access Security Data) have been successfully transmitted. Function pointer definition: J1939Dcm_MemDataTxConfFuncType Note: for transmission of DM16 and DM18, the J1939Dcm provides the API J1939Dcm_MemAccessDataTransmit
        string J1939DcmMemAccessHeaderFile: set at pre-compile, origin=Vector Informatik  # Header file with the prototypes of configured the memory acces function
  bsw implementation J1939Dcm_Impl: programming-language=C, sw-version=4.02.00, used-code-generator=DaVinci Configurator, vendor-id=30, ar-release-version=4.01.02, behavior=J1939DcmBehavior, preconfigured-configuration=J1939Dcm_Pre, recommended-configuration=J1939Dcm_Rec, vendor-specific-module-def=J1939Dcm
  module config J1939Dcm_Rec: definition=J1939Dcm
  module config J1939Dcm_Pre: definition=J1939Dcm
