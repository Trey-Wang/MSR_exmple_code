AUTOSAR XML (schema 4-2-1)
package /MICROSAR
  bsw implementation Sent_30_Icu_Impl: programming-language=C, sw-version=1.00.00, vendor-id=30, ar-release-version=4.02.01, behavior=Sent_30_IcuBehavior, vendor-specific-module-def=Sent_30_Icu
  module definition Sent_30_Icu [0..1]: category=VENDOR_SPECIFIC_MODULE_DEFINITION, refined-module-def=Cdd, variants pre-compile
    container Sent_30_Icu_ConfigSet
