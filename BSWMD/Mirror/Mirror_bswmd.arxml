AUTOSAR XML (schema 4-2-1)
package /MICROSAR
  bsw implementation Mirror_Impl: programming-language=C, sw-version=2.00.00, used-code-generator=DaVinci Configurator, vendor-id=30, ar-release-version=4.02.02, behavior=MirrorBehavior, preconfigured-configuration=Mirror_Pre, recommended-configuration=Mirror_Rec, vendor-specific-module-def=Mirror
  module definition Mirror: category=VENDOR_SPECIFIC_MODULE_DEFINITION, variants pre-compile/post-build
    container MirrorGeneral  # This container contains the general configuration parameters of the Mirror module.
      boolean MirrorDevErrorDetect: origin=Vector Informatik, set at pre-compile, default-value=true  # Enables/disables the development error detection. Note: In general, the development error detection is recommended during pre-test phase. It is not recommended to enable the development error detection in production code due to increased runtime and ROM needs.
      float MirrorMainFunctionPeriod: 0.001..0.255, scope=ECU, origin=Vector Informatik, set at pre-compile, default-value=0.01  # Execution cycle of Mirror_MainFunction.
      boolean MirrorVersionInfoApi: origin=Vector Informatik, set at pre-compile, default-value=false  # Enables/disables the function Mirror_GetVersionInfo() to get major, minor and patch version information.
      string MirrorUserConfigurationFile: origin=Vector Informatik, set at pre-compile  # Reference to an external user configuration file that will be included during generation. The content of the user configuration file will be added at the end of the generated module configuration file and allows altering or extending the generated code. Caution: User configuration files can cause the software module to malfunction and must only be used with great care!
      float MirrorTxConfirmationTimeout: 0.01..65, origin=Vector Informatik, set at pre-compile, default-value=1.5  # Time to wait for a confirmation after transmission of a message. After this time, TxConfirmation is not expected to be called for the last transmission, and the message is assumed to have been lost.
      string MirrorTimingCalloutHeaderName [0..1]: origin=Vector Informatik, min-length=3  # Header name of the used defined source for time stamps. RESTRICTIONS: If this parameter is used the parameter /MICROSAR/Mirror/MirrorGeneral/MirrorDestChannelStbRef must not be used.
      function name MirrorTimingCalloutName [0..1]: origin=Vector Informatik, min-length=1  # Function name of the used defined source for time stamps. RESTRICTIONS: If this parameter is used the parameter /MICROSAR/Mirror/MirrorGeneral/MirrorDestChannelStbRef must not be used.
      enumeration MirrorSourceChannelCanFilterType: origin=Vector Informatik, set at pre-compile  # Source Channel Can Filter Type | Filter type used by all Can Source Channels.
        FILTER_TYPE_RANGE  # Range filter with lower and upper Id
        FILTER_TYPE_ID  # Id and Mask filter
      symbolic name reference MirrorDestChannelStbRef [0..1]: origin=Vector Informatik, destination=StbMSynchronizedTimeBase  # Reference to the synchronized time base used for time stamps. RESTRICTIONS: If this parameter is used the parameters /MICROSAR/Mirror/MirrorGeneral/MirrorTimingCalloutHeaderName /MICROSAR/Mirror/MirrorGeneral/MirrorTimingCalloutName must not be used.
    container MirrorConfigSet  # Configuration of the Mirror source and destination channel.
      choice container MirrorSourceChannel [1..*]: multiplicity set at post-build in variant post-build / pre-compile in variant pre-compile  # Source channel, bound to one of the supported bus types.
        container MirrorSourceChannelCan [0..1]: multiplicity set at post-build in variant post-build / pre-compile in variant pre-compile  # Source Channel CAN | Source channel of bus type CAN.
          integer MirrorNetworkId: 0..255, multiplicity set at pre-compile, origin=Vector Informatik, set at pre-compile  # Mirror Network Id | User defined network Id for a source channel. Will only be used as network identifier in IP frame.
          symbolic name reference MirrorSourceChannelComMNetworkHandleRef: origin=Vector Informatik, set at post-build in variant post-build / pre-compile in variant pre-compile, destination=ComMChannel  # Source Channel ComM Network Handle Ref | Reference to the channel defined by the ComMChannel providing access to the unique channel index ComMChannelId.
          container MirrorCanIdFilter [0..2]: multiplicity set at post-build in variant post-build / pre-compile in variant pre-compile  # CAN ID Filter | Filter configuration for CAN IDs. A CAN ID is accepted if it matches any of the configured filters.
            integer MirrorFilterValueHighOrMask: 0..4294967295, origin=Vector Informatik, default-value=0  # Filter Value High or Mask | If the general parameter MirrorSourceChannelCanFilterType is set to "Filter_Type_Range" this value is used as upper value for a range filter. If the general parameter MirrorSourceChannelCanFilterType is set to "Filter_Tyoe_Id" this parameter is used as Mask for the CAN ID match for a ID filter. The configured and the received CAN ID are first masked and then compared: (MirrorCanId & MirrorMask) == (canId & MirrorMask)
            integer MirrorFilterValueLowOrId: 0..4294967295, origin=Vector Informatik, default-value=0  # Filter Value Low or ID | If the general parameter MirrorSourceChannelCanFilterType is set to "Filter_Type_Range" this value is used as lower value for a range filter. If the general parameter MirrorSourceChannelCanFilterType is set to "Filter_Tyoe_Id" this parameter is used as base CAN ID for a ID filter.
            integer MirrorCanFilterId: 0..4294967295, origin=Vector Informatik, default-value=0  # CAN Filter Id | Id of the filter that must be used to access the filter.
      choice container MirrorDestChannel [1..*]: multiplicity set at post-build in variant post-build / pre-compile in variant pre-compile  # Destination channel, bound to one of the supported bus types.
        container MirrorDestChannelIp [0..1]: multiplicity set at post-build in variant post-build / pre-compile in variant pre-compile  # Contains the configuration of a destination channel IP.
          float MirrorDestPduMaxDelay [0..1]: 0.001..66, multiplicity set at post-build in variant post-build / pre-compile in variant pre-compile, origin=Vector Informatik, set at post-build in variant post-build / pre-compile in variant pre-compile, default-value=0.1  # Time in seconds after which a message is transmitted even if its buffer is not yet filled. RESTRICTIONS: If this parameter is used, its value must be greater than the value of: /MICROSAR/Mirror/MirrorGeneral/MirrorTxConfirmationTimeout
          boolean MirrorDefaultDestChannel: origin=Vector Informatik, default-value=false  # Standard destination channel after initialization of the Mirror module.
          integer MirrorDestChannelQueueSize: 1..5, origin=Vector Informatik, set at pre-compile, default-value=2  # Number of buffers used for transmitting IP mirror messages.
          symbolic name reference MirrorDestChannelComMNetworkHandleRef: origin=Vector Informatik, set at post-build in variant post-build / pre-compile in variant pre-compile, destination=ComMChannel  # Destination Channel ComM Network Handle Ref | Reference to the channel defined by the ComMChannel providing access to the unique channel index ComMChannelId.
          container MirrorDestPdu  # Contains the configuration of the PDU used to transmit the mirrored data.
            integer MirrorDestPduId: 0..65535, scope=ECU, origin=Vector Informatik, set at post-build in variant post-build / pre-compile in variant pre-compile, symbolic-name-value=true, default-value=0  # The PDU identifier used for TxConfirmation from PduR.
            reference MirrorDestPduRef: origin=Vector Informatik, set at post-build in variant post-build / pre-compile in variant pre-compile, destination=Pdu  # Reference to the Pdu object representing the PDU.
        container MirrorDestChannelCan [0..1]: multiplicity set at post-build in variant post-build / pre-compile in variant pre-compile  # Contains the configuration of a destination channel CAN.
          boolean MirrorDefaultDestChannel: origin=Vector Informatik, default-value=false  # Standard destination channel after initialization of the Mirror module.
          integer MirrorDestChannelQueueSize: 1..500, origin=Vector Informatik, set at pre-compile, default-value=2  # Number of buffers used for transmitting Can mirror messages.
          symbolic name reference MirrorDestChannelComMNetworkHandleRef: origin=Vector Informatik, set at post-build in variant post-build / pre-compile in variant pre-compile, destination=ComMChannel  # Destination Channel ComM Network Handle Ref | Reference to the channel defined by the ComMChannel providing access to the unique channel index ComMChannelId.
          container MirrorDestPdu
            integer MirrorDestPduId: 0..65535, scope=ECU, origin=Vector Informatik, set at post-build in variant post-build / pre-compile in variant pre-compile, symbolic-name-value=true, default-value=0  # The PDU identifier used for TxConfirmation from PduR.
            reference MirrorDestPduRef: origin=Vector Informatik, set at post-build in variant post-build / pre-compile in variant pre-compile, destination=Pdu  # Reference to the Pdu object representing the PDU.
  module config Mirror_Pre: definition=Mirror
  module config Mirror_Rec: definition=Mirror
