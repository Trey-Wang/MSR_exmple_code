AUTOSAR XML (schema 4-0-3)
package /MICROSAR
  module config FrNm_Pre: definition=FrNm
  module config FrNm_Rec: definition=FrNm
    FrNmChannelConfig
    FrNmGlobalConfig
      FrNmGlobalProperties: FrNmDevErrorDetect=1, FrNmVersionInfoApi=0
  module config FrNm_Rec_Class1: definition=FrNm
    FrNmChannelConfig
      FrNmChannel
  module config FrNm_Rec_Class2: definition=FrNm
    FrNmChannelConfig
      FrNmChannel
        FrNmChannelTiming: FrNmDataCycle=FRNM_CYCLE_VALUE_64, FrNmRepetitionCycle=FRNM_CYCLE_VALUE_64, FrNmVotingCycle=FRNM_CYCLE_VALUE_64, FrNmMsgTimeoutTime=0.4
  module config FrNm_Rec_Class3: definition=FrNm
    FrNmChannelConfig
      FrNmChannel
        FrNmChannelIdentifiers: FrNmPduScheduleVariant=FRNM_PDU_SCHEDULE_VARIANT_2
  module config FrNm_Rec_Class4: definition=FrNm
    FrNmChannelConfig
      FrNmChannel
        FrNmChannelIdentifiers
          FrNmTxPdu: FrNmTxPduContainsData=1, FrNmTxPduContainsVote=1
  module config FrNm_Rec_Class5: definition=FrNm
    FrNmChannelConfig
      FrNmChannel
        FrNmChannelIdentifiers
          FrNmRxPdu: FrNmRxPduContainsData=1, FrNmRxPduContainsVote=1
