AUTOSAR XML (schema 4-0-3)
package /MICROSAR/Can_CanoeemuCanoe
  module config Can_Pre: definition=Can
