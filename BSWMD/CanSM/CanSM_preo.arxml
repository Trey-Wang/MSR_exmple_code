AUTOSAR XML (schema 4-0-3)
package /MICROSAR
  module config CanSM_Pre: definition=CanSM
