AUTOSAR XML (schema 4-0-3)
package /MICROSAR
  module config FiM_Rec: definition=FiM
    FiMGeneral: FiMDevErrorDetect=1
