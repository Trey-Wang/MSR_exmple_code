AUTOSAR XML (schema 4-2-1)
package /MICROSAR
  module definition Sd [0..1]: category=VENDOR_SPECIFIC_MODULE_DEFINITION, refined-module-def=Sd, variants pre-compile/post-build  # Service Discovery | Configuration of the Service Discovery module.
    container SdConfig: multiplicity set at pre-compile  # This container contains the configuration parameters and sub containers of the AUTOSAR Service Discovery module.
      container SdInstance [0..*]: multiplicity set at post-build in variant post-build / pre-compile in variant pre-compile  # This container represents an instance of the SD; i.e. the SD configuration for a certain link.
        string SdInstanceHostname [0..1]: multiplicity set at post-build in variant post-build / pre-compile in variant pre-compile, set at post-build in variant post-build / pre-compile in variant pre-compile  # Configuration parameter to specify the Hostname.
        integer SdMaxNrDestAddr: 1..65535, set at pre-compile, origin=Vector Informatik, set at post-build in variant post-build / pre-compile in variant pre-compile, default-value=10  # Maximal Number of Destination Addresses | This Parameter specifies the size of the address storage array saving the addresses of communication partners.
        integer SdInOutQueueSize: 1..65535, set at pre-compile, origin=Vector Informatik, set at post-build in variant post-build / pre-compile in variant pre-compile, default-value=10  # Size of the Input/Output Queue | This parameter specifies the maximal amount of Entries which can pend in order to be processed. (Specifies the Rx as well as the Tx Entries)
        container SdClientService [0..*]: multiplicity set at post-build in variant post-build / pre-compile in variant pre-compile  # This container specifies all parameters used by Client services.
          boolean SdClientServiceAutoRequire: set at post-build in variant post-build / pre-compile in variant pre-compile, default-value=false  # If existing and set to true, this Service will be set to "required" on start.
          integer SdClientServiceHandleId: 0..65535, set at pre-compile, symbolic-name-value=true, default-value=0  # The HandleId by which the BswM can identify this Client Service Instance.
          integer SdClientServiceId: 0..65534, set at post-build in variant post-build / pre-compile in variant pre-compile, default-value=0  # Id to identify the service. This is unique for the service interface.
          integer SdClientServiceInstanceId: 0..65534, set at post-build in variant post-build / pre-compile in variant pre-compile, default-value=1  # Configuration parameter to specify Instance Id of the service as used in SD entries.
          integer SdClientServiceMajorVersion: 0..254, set at post-build in variant post-build / pre-compile in variant pre-compile, default-value=1  # Major version number of the Service as used in the SD entries.
          integer SdClientServiceMinorVersion: 0..4294967295, set at post-build in variant post-build / pre-compile in variant pre-compile, default-value=0  # Minor version number of the Service as used in the SD Service Entries.
          reference SdClientServiceTcpRef [0..1]: multiplicity set at post-build in variant post-build / pre-compile in variant pre-compile, set at post-build in variant post-build / pre-compile in variant pre-compile, destination=SoAdSocketConnectionGroup  # Reference to the SoAdSocketConnection representing the data path (TCP) for communication with methods. | This element is also used to set the remote address of the server and to open the TCP connection.
          reference SdClientServiceTimerRef: scope=ECU, set at post-build in variant post-build / pre-compile in variant pre-compile, destination=SdClientTimer  # The reference of the SdClientTimer container for this service.
          reference SdClientServiceUdpRef [0..1]: multiplicity set at post-build in variant post-build / pre-compile in variant pre-compile, set at post-build in variant post-build / pre-compile in variant pre-compile, destination=SoAdSocketConnectionGroup  # Reference to the SoAdSocketConnection representing the data path (UDP) for communication with methods. | This element is also used to set the remote address of the server.
          reference SdClientCapabilityRecordMatchCalloutRef [0..1]: multiplicity set at post-build in variant post-build / pre-compile in variant pre-compile, origin=Vector Informatik, post-build-variant-multiplicity=true, set at post-build in variant post-build / pre-compile in variant pre-compile, destination=SdCapabilityRecordMatchCallout  # Reference to an SdCallout, The referenced SdCallout is invoked to determine whether the configuration options contained in the entries of a received SD message match the client's configured SdClientCapabilityRecord elements.
          container SdClientCapabilityRecord [0..*]: multiplicity set at post-build in variant post-build / pre-compile in variant pre-compile  # Sd uses capability records to store arbitrary name/value pairs conveying additional information about the named service. | The following use cases are supported: 1) Key present, with no value (e.g. "passreq" -- password required for this service) 2) Key present, with empty value (e.g. "PlugIns=" server supports plugins, but none are presently installed) 3) Key present, with non-empty value (e.g. "PlugIns=JPEG,MPEG2,MPEG4")
            string SdClientServiceCapabilityRecordKey: set at post-build in variant post-build / pre-compile in variant pre-compile  # Defines a CapabilityRecord key.
            string SdClientServiceCapabilityRecordValue [0..1]: multiplicity set at post-build in variant post-build / pre-compile in variant pre-compile, set at post-build in variant post-build / pre-compile in variant pre-compile  # Defines the corresponding CapabilityRecord value.
          container SdConsumedEventGroup [0..*]: multiplicity set at post-build in variant post-build / pre-compile in variant pre-compile  # A Service may have event groups which can be consumed. A service consumer has to subscribe to the corresponding event-group. After the subscription the event consumer takes the role of a server and the event provider that of a client.
            boolean SdConsumedEventGroupAutoRequire: set at post-build in variant post-build / pre-compile in variant pre-compile, default-value=false  # If existing and set to true, this EventGroup will be set to "required" on start.
            integer SdConsumedEventGroupHandleId: 0..65535, set at pre-compile, symbolic-name-value=true, default-value=0  # The HandleId by which the BswM can identify this EventGroup.
            integer SdConsumedEventGroupId: 0..65534, set at post-build in variant post-build / pre-compile in variant pre-compile, default-value=0  # The Eventgroup Id of this eventGroup as a unique identifier of the eventgroup in this service. This identifier is used for EventGroup entries as well.
            reference SdConsumedEventGroupMulticastGroupRef [0..*]: multiplicity set at post-build in variant post-build / pre-compile in variant pre-compile, set at post-build in variant post-build / pre-compile in variant pre-compile, destination=SoAdSocketConnectionGroup  # Reference to the SoAdSocketConnectionGroup representing the multicast data path (UDP).
            reference SdConsumedEventGroupTimerRef: set at post-build in variant post-build / pre-compile in variant pre-compile, destination=SdClientTimer  # The reference of the SdClientTimer container for this eventGroup.
            symbolic name reference SdConsumedEventGroupMulticastActivationRef [0..1]: multiplicity set at post-build in variant post-build / pre-compile in variant pre-compile, set at post-build in variant post-build / pre-compile in variant pre-compile, destination=SoAdRoutingGroup  # The reference of a Routing Group in order to activate and setup the Socket Connection for Multicast Events of this EventGroup. The multicast address from the received Multicast option is setup by SoAd_RequestIpAddrAssignment. If no SoAdRoutingGroup is referenced and there exists a valid SdConsumedEventGroupMulticastGroupRef, the Sd will reuse the SoAdRoutingGroup referenced by SdConsumedEventGroupUdpActivationRef. | The local address is the same as for the unicast events; thus, it was sent in the UDP Endpoint option of the Subscribe EventGroup entry.
            symbolic name reference SdConsumedEventGroupTcpActivationRef [0..1]: multiplicity set at post-build in variant post-build / pre-compile in variant pre-compile, set at post-build in variant post-build / pre-compile in variant pre-compile, destination=SoAdRoutingGroup  # The reference of the Routing Group for activation of the data path for receiving TCP events. | This element is also being used for getting the IP address and port number for building the TCP endpoint option for the Subscribe EventGroup entry. If no TCP methods are used in the service, this element is also being used for setting the remote address (TCP Endpoint option referenced by the Offer Service entry) and opening the TCP connection to the server before sending the Subscribe EventGroup entry. If multiple EventGroups of the same Service Instance are subscribed the TCP connection will be shared and must be opened only once.
            symbolic name reference SdConsumedEventGroupUdpActivationRef [0..1]: multiplicity set at post-build in variant post-build / pre-compile in variant pre-compile, set at post-build in variant post-build / pre-compile in variant pre-compile, destination=SoAdRoutingGroup  # The reference of the Routing Group for activation of the data path for receiving UDP events. | This element is also being used for getting the IP address and port number for building the UDP endpoint option for the Subscribe EventGroup entry. If no UDP methods are used in the service, this element is also being used for setting the remote address (UDP Endpoint option referenced by the Offer Service entry). If multiple EventGroups of the same Service Instance are subscribed the UDP Socket Connection will be shared and must be set only once.
          container SdConsumedMethods [0..1]: multiplicity set at post-build in variant post-build / pre-compile in variant pre-compile  # Container element for representing the data path for accessing the server methods.
            symbolic name reference SdClientServiceActivationRef: multiplicity set at post-build in variant post-build / pre-compile in variant pre-compile, set at post-build in variant post-build / pre-compile in variant pre-compile, destination=SoAdRoutingGroup  # Reference to a SoAdRoutingGroupRef to activate/deactivate the data path for the methods.
        container SdClientTimer [0..*]: multiplicity set at post-build in variant post-build / pre-compile in variant pre-compile  # This container specifies all timers used by the Service Discovery module for Client Services.
          float SdClientTimerInitialFindDelayMax [0..1]: 0..4294967, scope=ECU, multiplicity set at post-build in variant post-build / pre-compile in variant pre-compile, set at post-build in variant post-build / pre-compile in variant pre-compile, default-value=0.5  # Max value in [s] to delay randomly the transmission of a find message. This parameter is mandatory for ClientService.
          float SdClientTimerInitialFindDelayMin [0..1]: 0..4294967, scope=ECU, multiplicity set at post-build in variant post-build / pre-compile in variant pre-compile, set at post-build in variant post-build / pre-compile in variant pre-compile, default-value=0.1  # Min value in [s] to delay randomly the transmission of a find message. This parameter is mandatory for ClientService.
          float SdClientTimerInitialFindRepetitionsBaseDelay [0..1]: 0..4294967, scope=ECU, multiplicity set at post-build in variant post-build / pre-compile in variant pre-compile, set at post-build in variant post-build / pre-compile in variant pre-compile, default-value=1  # The base delay in [s] for find repetitions. Successive finds have an exponential back off delay (1x base delay, 2x base delay, 4x base delay, ...). This parameter is mandatory for ClientService.
          integer SdClientTimerInitialFindRepetitionsMax [0..1]: 0..10, scope=ECU, multiplicity set at post-build in variant post-build / pre-compile in variant pre-compile, set at post-build in variant post-build / pre-compile in variant pre-compile, default-value=4  # Configuration for the maximum number of find repetitions. This parameter is mandatory for ClientService.
          float SdClientTimerRequestResponseMaxDelay [0..1]: 0..4294967, scope=ECU, multiplicity set at post-build in variant post-build / pre-compile in variant pre-compile, set at post-build in variant post-build / pre-compile in variant pre-compile, default-value=0.1  # Maximum allowable response delay to entries received by multicast in seconds. This parameter is mandatory for ConsumedEventGroups.
          float SdClientTimerRequestResponseMinDelay [0..1]: 0..4294967, scope=ECU, multiplicity set at post-build in variant post-build / pre-compile in variant pre-compile, set at post-build in variant post-build / pre-compile in variant pre-compile, default-value=0.01  # Minimum allowable response delay to the find message in seconds. This parameter is mandatory for ConsumedEventGroups.
          integer SdClientTimerTTL: 1..16777215, scope=ECU, set at post-build in variant post-build / pre-compile in variant pre-compile, default-value=5  # Time to live for find and subscribe messages.
        container SdInstanceDemEventParameterRefs [0..1]: multiplicity set at post-build in variant post-build / pre-compile in variant pre-compile  # Container for the references to DemEventParameter elements which shall be invoked using the API Dem_ReportErrorStatus API in case the corresponding error occurs. The EventId is taken from the referenced DemEventParameter's DemEventId value. The standardized errors are provided in the container and can be extended by vendor specific error references.
          symbolic name reference SD_E_MALFORMED_MSG [0..1]: multiplicity set at post-build in variant post-build / pre-compile in variant pre-compile, set at post-build in variant post-build / pre-compile in variant pre-compile, destination=DemEventParameter  # Reference to the DemEventParameter which shall be issued when the SD Instance received malformed messsage.
          symbolic name reference SD_E_OUT_OF_RES [0..1]: multiplicity set at post-build in variant post-build / pre-compile in variant pre-compile, set at post-build in variant post-build / pre-compile in variant pre-compile, destination=DemEventParameter  # Reference to the DemEventParameter which shall be issued when the SD Instance does not have enough resources to handle client.
          symbolic name reference SD_E_SUBSCR_NACK_RECV [0..1]: set at pre-compile, multiplicity set at post-build in variant post-build / pre-compile in variant pre-compile, set at post-build in variant post-build / pre-compile in variant pre-compile, destination=DemEventParameter  # Reference to the DemEventParameter which shall be issued when the Service Discovery module received a SOME/IP Negative Acknowledge entry.
        container SdInstanceMulticastRxPdu  # This container specifies the received PDU.
          integer SdRxPduId: 0..65535, scope=ECU, set at post-build in variant post-build / pre-compile in variant pre-compile, symbolic-name-value=true, default-value=0  # ID of the PDU that will be received via the API Sd_SoAdIfRxIndication().
          reference SdRxPduRef: set at post-build in variant post-build / pre-compile in variant pre-compile, destination=Pdu  # Reference to the "global" Pdu structure to allow harmonization of handle IDs in the COM-Stack.
        container SdInstanceTxPdu  # This container specifies the transmitted PDU.
          reference SdTxPduRef: set at post-build in variant post-build / pre-compile in variant pre-compile, destination=Pdu  # Reference to the "global" Pdu structure to allow harmonization of handle IDs in the COM-Stack.
        container SdInstanceUnicastRxPdu  # This container specifies the received PDU.
          integer SdRxPduId: 0..65535, scope=ECU, set at post-build in variant post-build / pre-compile in variant pre-compile, symbolic-name-value=true, default-value=1  # ID of the PDU that will be received via the API Sd_SoAdIfRxIndication().
          reference SdRxPduRef: set at post-build in variant post-build / pre-compile in variant pre-compile, destination=Pdu  # Reference to the "global" Pdu structure to allow harmonization of handle IDs in the COM-Stack.
        container SdServerService [0..*]: multiplicity set at post-build in variant post-build / pre-compile in variant pre-compile  # This container specifies all parameters used by Server services.
          boolean SdServerServiceAutoAvailable: set at post-build in variant post-build / pre-compile in variant pre-compile, default-value=false  # If existing and set to true, this Service will be set to "Available" on start.
          integer SdServerServiceHandleId: 0..65535, set at pre-compile, symbolic-name-value=true, default-value=0  # The HandleId by which the BswM can identify this Server Service Instance.
          integer SdServerServiceId: 0..65534, set at post-build in variant post-build / pre-compile in variant pre-compile, default-value=0  # Id to identify the service. This is unique for the service interface.
          integer SdServerServiceInstanceId: 0..65534, set at post-build in variant post-build / pre-compile in variant pre-compile, default-value=1  # Configuration parameter to specify Instance Id of the Service implemented by the Server Service.
          integer SdServerServiceMajorVersion: 0..254, set at post-build in variant post-build / pre-compile in variant pre-compile, default-value=1  # Major version number of the Service as used in SD Entries.
          integer SdServerServiceMinorVersion: 0..4294967294, set at post-build in variant post-build / pre-compile in variant pre-compile, default-value=0  # Minor version number of the Service as used e.g. in Offer Service entries.
          reference SdServerServiceTcpRef [0..1]: scope=ECU, multiplicity set at post-build in variant post-build / pre-compile in variant pre-compile, set at post-build in variant post-build / pre-compile in variant pre-compile, destination=SoAdSocketConnectionGroup  # Reference to SoAdSocketConnectionGroup used for methods. | This is used to access the local IP address and port for building the endpoint option for offers of this service.
          reference SdServerServiceTimerRef: scope=ECU, set at post-build in variant post-build / pre-compile in variant pre-compile, destination=SdServerTimer  # The reference of the SdServerTimer container for this service.
          reference SdServerServiceUdpRef [0..1]: scope=ECU, multiplicity set at post-build in variant post-build / pre-compile in variant pre-compile, set at post-build in variant post-build / pre-compile in variant pre-compile, destination=SoAdSocketConnectionGroup  # Reference to SoAdSocketConnectionGroup used for methods. | This is used to access the local IP address and port for building the endpoint option for offers of this service.
          reference SdServerCapabilityRecordMatchCalloutRef [0..1]: multiplicity set at post-build in variant post-build / pre-compile in variant pre-compile, origin=Vector Informatik, post-build-variant-multiplicity=true, set at post-build in variant post-build / pre-compile in variant pre-compile, destination=SdCapabilityRecordMatchCallout  # Reference to an SdCallout, The referenced SdCallout is invoked to determine whether the configuration options contained in the entries of a received SD message match the server's configured SdServerCapabilityRecord elements.
          container SdEventHandler [0..*]: multiplicity set at post-build in variant post-build / pre-compile in variant pre-compile  # Container Element for representing an EventGroup as part of the Service Instance.
            integer SdEventHandlerEventGroupId: 0..65534, set at post-build in variant post-build / pre-compile in variant pre-compile, default-value=0  # The EventGroup Id of this EventGroup as a unique identifier of the EventGroup in this service. This identifier is used for EventGroup entries as well.
            integer SdEventHandlerHandleId: 0..65535, scope=ECU, set at pre-compile, symbolic-name-value=true, default-value=0  # The HandleId by which the BswM can identify this EventGroup.
            integer SdEventHandlerMulticastThreshold: 0..65535, set at post-build in variant post-build / pre-compile in variant pre-compile, default-value=0  # Specifies the number of subscribed clients that trigger the Server to change the transmission of events to Multicast. | If configured to 0 only unicast will be used. If configured to 1 the first client will be already served by multicast. If configured to 2 the first client will be served with unicast and as soon as the second client arrives both will be served by multicast. This does not influence the handling of initial events, which are served using unicast only.
            reference SdEventHandlerTimerRef: set at post-build in variant post-build / pre-compile in variant pre-compile, destination=SdServerTimer  # The reference of the SdServerTimer container for this EventGroup.
            container SdEventHandlerMulticast [0..1]: multiplicity set at post-build in variant post-build / pre-compile in variant pre-compile  # The subcontainer including the Routing Group for Activation of Events sent over Multicast. | The activation ref is also being used for identification of the related Socket Connection in order to find the Multicast Address used in the Multicast Option referenced by the Subscribe EventGroup Ack entry.
              symbolic name reference SdEventActivationRef [0..1]: multiplicity set at post-build in variant post-build / pre-compile in variant pre-compile, set at post-build in variant post-build / pre-compile in variant pre-compile, destination=SoAdRoutingGroup  # Reference to a SoAdRoutingGroup for activation of the data path for a subscribed client (start sending events after subscribe). If no SoAdRoutingGroup is referenced, the Sd will reuse the SoAdRoutingGroup referenced by SdEventHandlerUdp/SdEventActivationRef.
              symbolic name reference SdMulticastEventSoConRef: multiplicity set at post-build in variant post-build / pre-compile in variant pre-compile, set at post-build in variant post-build / pre-compile in variant pre-compile, destination=SoAdSocketConnection  # Reference to the SoAdSocketConnection representing the multicast data path (UDP).
            container SdEventHandlerTcp [0..1]: multiplicity set at post-build in variant post-build / pre-compile in variant pre-compile  # The subcontainer including the Routing Groups for Activation and Trigger Transmit for Events sent over TCP. | The activation ref (or triggering ref if no activation ref exists) is also being used for identification of the related socket connections in order to find the related client by iterating the SdEventHandlerTcp elements (remote address statically configured or automatically set by opening TCP connection before subscription).
              symbolic name reference SdEventActivationRef [0..1]: multiplicity set at post-build in variant post-build / pre-compile in variant pre-compile, set at post-build in variant post-build / pre-compile in variant pre-compile, destination=SoAdRoutingGroup  # Reference to a SoAdRoutingGroup for activation of the data path for a subscribed client (start sending events after subscribe).
              symbolic name reference SdEventTriggeringRef [0..1]: multiplicity set at post-build in variant post-build / pre-compile in variant pre-compile, set at post-build in variant post-build / pre-compile in variant pre-compile, destination=SoAdRoutingGroup  # Reference to a SoAdRoutingGroup that is used for triggered transmit. Triggering is needed to sent out initial events on the server side after a client got subscribed.
            container SdEventHandlerUdp [0..1]: multiplicity set at post-build in variant post-build / pre-compile in variant pre-compile  # The subcontainer including the Routing Groups for Activation and Trigger Transmit for Events sent over UDP. | The activation ref (or triggering ref if no activation ref exists) is also being used for identification of the related socket connections in order to set the remote address of the client or find the related client by iterating the SdEventHandlerUdp elements (remote address statically configured or automatically set by method call before subscription).
              symbolic name reference SdEventActivationRef [0..1]: multiplicity set at post-build in variant post-build / pre-compile in variant pre-compile, set at post-build in variant post-build / pre-compile in variant pre-compile, destination=SoAdRoutingGroup  # Reference to a SoAdRoutingGroup for activation of the data path for a subscribed client (start sending events after subscribe).
              symbolic name reference SdEventTriggeringRef [0..1]: multiplicity set at post-build in variant post-build / pre-compile in variant pre-compile, set at post-build in variant post-build / pre-compile in variant pre-compile, destination=SoAdRoutingGroup  # Reference to a SoAdRoutingGroup that is used for triggered transmit. Triggering is needed to sent out initial events on the server side after a client got subscribed.
          container SdProvidedMethods [0..1]: multiplicity set at post-build in variant post-build / pre-compile in variant pre-compile  # Container element for representing the needed elements of the data path for the methods provided by the service.
            symbolic name reference SdServerServiceActivationRef: scope=ECU, multiplicity set at post-build in variant post-build / pre-compile in variant pre-compile, set at post-build in variant post-build / pre-compile in variant pre-compile, destination=SoAdRoutingGroup  # Reference to a SoAdRoutingGroup to activated and deactivate the data path for methods of the service.
          container SdServerCapabilityRecord [0..*]: multiplicity set at post-build in variant post-build / pre-compile in variant pre-compile  # Sd uses capability records to store arbitrary name/value pairs conveying additional information about the named service. | The following use cases are supported: 1) Key present, with no value (e.g. "passreq" -- password required for this service) 2) Key present, with empty value (e.g. "PlugIns=" server supports plugins, but none are presently installed) 3) Key present, with non-empty value (e.g. "PlugIns=JPEG,MPEG2,MPEG4")
            string SdServerCapabilityRecordKey: set at post-build in variant post-build / pre-compile in variant pre-compile  # Defines a CapabilityRecord key.
            string SdServerCapabilityRecordValue [0..1]: multiplicity set at post-build in variant post-build / pre-compile in variant pre-compile, set at post-build in variant post-build / pre-compile in variant pre-compile  # Defines the corresponding CapabilityRecord value.
        container SdServerTimer [0..*]: multiplicity set at post-build in variant post-build / pre-compile in variant pre-compile  # This container specifies all timers used by the Service Discovery module for Server Services.
          float SdServerTimerInitialOfferDelayMax [0..1]: 0..4294967, scope=ECU, multiplicity set at post-build in variant post-build / pre-compile in variant pre-compile, set at post-build in variant post-build / pre-compile in variant pre-compile, default-value=0.5  # Max value in [s] to delay randomly the first offer. This parameter is mandatory for ServerService.
          float SdServerTimerInitialOfferDelayMin [0..1]: 0..4294967, scope=ECU, multiplicity set at post-build in variant post-build / pre-compile in variant pre-compile, set at post-build in variant post-build / pre-compile in variant pre-compile, default-value=0.1  # Min value in [s] to delay randomly the first offer. This parameter is mandatory for ServerService.
          float SdServerTimerInitialOfferRepetitionBaseDelay [0..1]: 0..4294967, scope=ECU, multiplicity set at post-build in variant post-build / pre-compile in variant pre-compile, set at post-build in variant post-build / pre-compile in variant pre-compile, default-value=0.1  # The base delay in [s] for offer repetitions. Successive offers have an exponential back off delay (1x base delay, 2x base delay, 4x base delay, ...). This parameter is mandatory for ServerService.
          integer SdServerTimerInitialOfferRepetitionsMax [0..1]: 0..10, scope=ECU, multiplicity set at post-build in variant post-build / pre-compile in variant pre-compile, set at post-build in variant post-build / pre-compile in variant pre-compile, default-value=5  # Configure the maximum amount of offer repetition. This parameter is mandatory for ServerService.
          float SdServerTimerOfferCyclicDelay [0..1]: 0..4294967, multiplicity set at post-build in variant post-build / pre-compile in variant pre-compile, set at post-build in variant post-build / pre-compile in variant pre-compile, default-value=2  # Interval between cyclic offers in the main phase. This parameter is mandatory for ServerService.
          float SdServerTimerRequestResponseMaxDelay: 0..4294967, scope=ECU, set at post-build in variant post-build / pre-compile in variant pre-compile, default-value=0.1  # Maximum allowable response delay to entries received by multicast in seconds.
          float SdServerTimerRequestResponseMinDelay: 0..4294967, scope=ECU, set at post-build in variant post-build / pre-compile in variant pre-compile, default-value=0.01  # Minimum allowable response delay to entries received by multicast in seconds.
          integer SdServerTimerTTL: 1..16777215, scope=ECU, set at post-build in variant post-build / pre-compile in variant pre-compile, default-value=5  # Time to live for offer service.
      container SdCapabilityRecordMatchCallout [0..*]: multiplicity set at pre-compile  # Callout that is invoked by the Sd implementation to determine whether the configuration options contained in the entries of a received SD message match the capability record elements configured in SdServerCapabilityRecord or SdClientCapabilityRecord.
        function name SdCapabilityRecordMatchCalloutName: origin=Vector Informatik, set at pre-compile, default-value=SdCallout_CapabilityRecordMatchFunction  # Function name (i.e., C-identifier) of the SdCapabilityRecordMatchCallout.
    container SdGeneral  # This container lists the general configuration parameters for the Service Discovery module.
      boolean SdDevErrorDetect: set at pre-compile, default-value=true  # Enables and disables the development error detection and notification mechanism.
      float SdMainFunctionCycleTime: 0.0001..1, set at pre-compile, default-value=0.005  # This parameter defines the cycle time in seconds of the periodic calling of Sd main function.
      boolean SdVersionInfoApi: set at pre-compile, default-value=false  # Enables and disables the version info API.
      integer SdMaxNrOptionsPerMsg: 1..65534, set at pre-compile, origin=Vector Informatik, set at pre-compile, default-value=10  # This parameter specifies the amount of attached options, which can be handled per incomming message.
      string SdRandomNumberFunctionIncludeFile: set at pre-compile, origin=Vector Informatik, set at pre-compile, default-value=Appl_Rand.h  # This parameter defines the header file holding the declaration of the random number generation function defined in 'SdRandomNumberFunction'.
      string SdRandomNumberFunction: set at pre-compile, origin=Vector Informatik, set at pre-compile, default-value=Appl_Crypto_GetRandNo  # This parameter defines the function called for the random number generation.
      string SdUserConfigFile [0..1]: multiplicity set at pre-compile, origin=Vector Informatik, set at pre-compile  # Reference to an external user configuration file that will be included during generation. The content of the user configuration file will be added at the end of the generated module configuration file and allows altering or extending the generated code. Caution: User configuration files can cause the software module to malfunction and must only be used with great care!
      integer SdTxBufferSize [0..1]: 48..65535, multiplicity set at post-build in variant post-build / pre-compile in variant pre-compile, origin=Vector Informatik, set at post-build in variant post-build / pre-compile in variant pre-compile, default-value=1464  # Buffer size in bytes which can be used for message transmission.
      boolean SdSafeBswChecks: origin=Vector Informatik, set at pre-compile, default-value=false  # Selects if safety checks are used. These checks improve robustness as e.g. invalid parameters are checked before function is executed. This attribute has to be enabled for safety projects where this component is mapped to an ASIL partition.
      container SdGeneration  # Contains the generation configuration parameters of the module Sd.
        enumeration SdOutOfBoundsWriteProtectionStrategy: origin=Vector Informatik, set at pre-compile, default-value=NONE  # This parameter is used to configure a strategy to protect the code to write out of bounds. NONE: no protection strategy is generated in the data access. INDEX_SATURATION: arrays are blown up and the data access index is saturated by an appropriate mask. The advantage is the speed of the data access, but own data elements at other indexes of the same variable can be overridden. INDEX_CHECKING: the data access index is validated by a runtime check. The advantage is that values are never written to incorrect indexes of the data access.
          NONE  # none
          INDEX_SATURATION  # index saturation
          INDEX_CHECKING  # index checking
        boolean SdOutOfBoundsWriteSanitizer: origin=Vector Informatik, set at pre-compile, default-value=false  # This parameter activates/deactivates the generation of runtime checks which call a DET error notification function to find easily out of bounds write problems. FALSE: no checks are generated in the data access. TRUE: the data access is enriched with DET checks to validate indexes.
        boolean SdOutOfBoundsReadSanitizer: origin=Vector Informatik, set at pre-compile, default-value=false  # This parameter activates/deactivates the generation of runtime checks which call a DET error notification function to find easily out of bounds read problems. FALSE: no checks are generated in the data access. TRUE: the data access is enriched with DET checks to validate indexes.
        boolean SdReduceConstantData2Define: origin=Vector Informatik, set at pre-compile, default-value=false  # Reduce Constant Data To a Define | This parameter activates/deactivates the capability to generate CONFIG-CLASS PRE-COMPILE ROM arrays as constant define. FALSE: ROM arrays are generated as data even if all values are identical. TRUE: ROM arrays are generated as constant define if all values are identical.
        enumeration SdBoolDataInArrayOfStructStrategy: origin=Vector Informatik, set at pre-compile, default-value=BITMASKING  # This parameter is used to tailor the usage of boolean data in structures in all CONFIG-CLASSES ROM data. The difference between BITFIELD and BITMASKING depends on your compiler options and memory mapping. BOOLEAN: the datatype of boolean data is native boolean. BITFIELD: the bitfield type is used and the compiler extracts the boolean data from structures. BITMASKING: generated masks are used to extract the boolean data from structures.
          BOOLEAN  # boolean
          BITFIELD  # bitfield
          BITMASKING  # bitmasking
        boolean SdDeduplicateIndirectedData: origin=Vector Informatik, set at pre-compile, default-value=true  # This parameter activates/deactivates the capability to compress 0:N relational ROM data in all CONFIG-CLASSES without increasing the runtime. FALSE: 0:N relational ROM data is not compressed. TRUE: 0:N relational ROM data is compressed without increasing the runtime.
        enumeration SdDataDeduplicationStrategy: origin=Vector Informatik, set at pre-compile, default-value=DEDUPLICATE_CONST_DATA_WITH_CAST  # This parameter is used to taylor the the deduplication of CONFIG-CLASS PRE-COMPILE ROM data. NONE: The generated data is not deduplicated. DEDUPLICATE_CONST_DATA_WITHOUT_CAST: The data is deduplicated without using casts. DEDUPLICATE_CONST_DATA_WITH_CAST: The data is deduplicated using casts.
          NONE  # none
          DEDUPLICATE_CONST_DATA_WITHOUT_CAST  # deduplicate const data without cast
          DEDUPLICATE_CONST_DATA_WITH_CAST  # deduplicate const data with cast
        integer SdReduceBoolDataByNegationThreshold: 0..9223372036854775807, origin=Vector Informatik, set at pre-compile, default-value=2  # This parameter activates/deactivates the capability to compress boolean CONFIG-CLASS PRE-COMPILE ROM data by using the negation operator. 0: The optimization is deactivated. >0: If the number of deduplicateable elements is greater than this threshold the data optimization can be performed.
        integer SdReduceBoolDataByNumericalComparisonThreshold: 0..9223372036854775807, origin=Vector Informatik, set at pre-compile, default-value=2  # This parameter activates/deactivates the capability to compress boolean CONFIG-CLASS PRE-COMPILE ROM data by using numerical comparison with other ROM data. 0: The optimization is deactivated. >0: If the number of deduplicateable elements is greater than this threshold the data optimization can be performed.
        integer SdReduceBoolDataByNumericalRelationThreshold: 0..9223372036854775807, origin=Vector Informatik, set at pre-compile, default-value=2  # This parameter activates/deactivates the capability to compress boolean CONFIG-CLASS PRE-COMPILE ROM data by using relational comparison with other ROM data. 0: The optimization is deactivated. >0: If the number of deduplicateable elements is greater than this threshold the data optimization can be performed.
        enumeration SdReduceBoolDataByNumericalOperandStrategy: origin=Vector Informatik, set at pre-compile, default-value=DEDUPLICATE_DATA_WITH_ANY_VALUE  # This parameter is used to taylor the CONFIG-CLASS PRE-COMPILE ROM bool data with number deduplication mechanisms. A comparison with 0 is very efficient, but a numerical comparison with a value not 0 can be used to increase the ROM data compression rate. NONE: ROM data deduplications are switched off. DEDUPLICATE_DATA_WITH_ZERO: ROM data deduplications can be applied with the value 0. DEDUPLICATE_DATA_WITH_ANY_VALUE: ROM data deduplications can be applied with any numerical value.
          NONE  # none
          DEDUPLICATE_DATA_WITH_ZERO  # deduplicate data with zero
          DEDUPLICATE_DATA_WITH_ANY_VALUE  # deduplicate data with any value
        integer SdReduceNumericalDataByOffsetThreshold: 0..9223372036854775807, origin=Vector Informatik, set at pre-compile, default-value=2  # This parameter activates/deactivates the capability to compress numerical CONFIG-CLASS PRE-COMPILE ROM data by using a constant offset. 0: The optimization is deactivated. >0: If the number of deduplicateable elements is greater than this threshold the data optimization can be performed.
        integer SdReduceNumericalDataByArraySubtractionThreshold: 0..9223372036854775807, origin=Vector Informatik, set at pre-compile, default-value=2  # This parameter activates/deactivates the capability to compress numerical CONFIG-CLASS PRE-COMPILE ROM data by using a subtraction with other ROM data. 0: The optimization is deactivated. >0: If the number of deduplicateable elements is greater than this threshold the data optimization can be performed.
        boolean SdReduceDataByStreaming: origin=Vector Informatik, set at pre-compile, default-value=false  # This parameter activates/deactivates the capability to pack generated CONFIG-CLASS PRE-COMPILE ROM data into a data type dependent stream. FALSE: generated const data is not packed into a data type dependent stream. TRUE: generated const data is packed into a data type dependent stream.
        boolean SdShortSymbols: origin=Vector Informatik, set at pre-compile, default-value=false  # This parameter activates/deactivates the capability to generate shortened symbol names. FALSE: symbol names are generated in a human readable style based on the MIP, tags and variant names. TRUE: symbol names are generated based on the MIP and a CRC32.
        boolean SdInterfacesForDeactivatedData: origin=Vector Informatik, set at pre-compile, default-value=false  # This parameter activates/deactivates the capability to generate bsw data interfaces for deactivated data elements. This is an advantage for the BSW developer to reduce the time to market with a development environment using auto completition and to investigate potential interfaces. FALSE: data interfaces are not generated if the data elementis deactivated. TRUE: data interfaces are generated as e.g. emty macros.
        boolean SdReferringKeysInComments: origin=Vector Informatik, set at pre-compile, default-value=false  # This parameter activates/deactivates the capability to generate referring keys in comments. This is an advantage for the developer to investigate indirections, but this feature reduces the overall readability of the generated data. FALSE: referring keys are not generated in comments. TRUE: referring keys are generated in comments.
  bsw implementation Sd_Impl: programming-language=C, sw-version=5.04.00, used-code-generator=DaVinci Configurator, vendor-id=30, ar-release-version=4.02.01, behavior=SdBehavior, recommended-configuration=Sd_Rec, vendor-specific-module-def=Sd
