AUTOSAR XML (schema 4-0-3)
package /MICROSAR
  module config NvM_Pre: definition=NvM
  module config NvM_Rec: definition=NvM
    NvMConfigBlock (NvMBlockDescriptor): NvMUseServicePorts=0
    NvMCommon: NvMDevErrorDetect=1, NvMVersionInfoApi=0
  module config NvM_Rec_Class1: definition=NvM
    NvMBlockDescriptor:
      NvMBlockCrcType = NVM_CRC16
      NvMBlockManagementType = NVM_BLOCK_NATIVE
      NvMInitBlockCallback = NULL_PTR
      NvMResistantToChangedSw = 1
      NvMSelectBlockForReadAll = 1
      NvMSelectBlockForWriteAll = 0
      NvMReadRamBlockFromNvCallback = (unset)
      NvMWriteRamBlockToNvCallback = NULL_PTR
      NvMUseInitCallback = 0
      NvMUseJobendCallback = 0
      NvMSingleBlockCallback = NULL_PTR
      NvMBswMBlockStatusInformation = 0
      NvMBlockUseCrc = 1
      NvMBlockUseSyncMechanism = 0
      NvMCalcRamBlockCrc = 0
