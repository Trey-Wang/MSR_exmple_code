AUTOSAR XML (schema 4-0-3)
package /MICROSAR
  module definition Exi [0..1]: category=VENDOR_SPECIFIC_MODULE_DEFINITION, variants pre-compile  # Configuration of the Domain Name System (Exi) Client.
    container ExiGeneral
      boolean ExiDevErrorDetect: set at pre-compile, origin=Vector Informatik, default-value=false  # If 'Dev Error Detection' is enabled, all development errors are reported to the Development Error Tracer (DET). The errors are described in the [TechnicalReference_Asr_Exi.pdf]. Note: In general, the development error detection is recommended during pre-test phase. It is not recommended to enable the development error detection in production code due to increased runtime and ROM needs.
      boolean ExiVersionInfoApi: set at pre-compile, origin=Vector Informatik, default-value=false  # If 'Version Info Api' is enabled, the function Exi_GetVersionInfo() is available to get major, minor and patch version information.
      string ExiUserConfigFile: set at pre-compile, origin=Vector Informatik  # If a file path will be specified, the file is read and its contents are put at the end of the Exi config file.
      boolean ExiSupportedAppProtocolSupport: set at pre-compile, origin=Vector Informatik, default-value=true  # If 'Supported App Protocol Support' is enabled, EXI Encoder/Decoder is able to handle Messages described in the ISO15118/DIN70121 supportedAppProtocol Schema.
      boolean ExiDin70121Support: set at pre-compile, origin=Vector Informatik, default-value=false  # DIN 70121 Support | If 'DIN 70121 Support' is enabled, EXI Encoder/Decoder is able to handle Messages described in the ISO15118/DIN70121 MsgDef Schema Set urn:din:70121:2012:MsgDef, version 2.0. HINT: Select this option if you want to handle Messages based on ISO 15118-2 DIS schema version.
      boolean ExiDecodeStringTruncation: set at pre-compile, origin=Vector Informatik, default-value=false  # If 'Decode String Truncation' is enabled, string characters that do not fit into the schema dependent target buffer will be skipped silently. Setting the value to false will lead to a decoding error. This option can be helpful to accept some schema deviations and avoid errors receiving strings that do not match the schema definition.
      boolean ExiInternalDevErrorDetect: set at pre-compile, origin=Vector Informatik, default-value=false  # If 'Internal Dev Error Detection' is enabled, all development errors for internal EXI Encoder/Decoder functions are reported to the Development Error Tracer (DET). The errors are identified via module Instance ID 108 for Encoder and 109 for Decoder errors. Note: In general, the development error detection is recommended during pre-test phase. It is not recommended to enable the development error detection in production code due to increased runtime and ROM needs.
      boolean ExiAllowSchemaDeviation: set at pre-compile, origin=Vector Informatik, default-value=false  # If 'Allow Schema Deviation' is enabled, schema deviations in the decoding process will be skipped silently if possible. Setting the value to false will lead to a decoding error with return value EXI_INV_EVENT_CODE for all schema deviations. This option can be helpful to accept some schema deviations and avoid errors receiving strings that do not match the schema definition.
      integer ExiMaxOccursUnbounded: 1..65535, set at pre-compile, origin=Vector Informatik, default-value=32  # Support for unbounded maximum occurrence values is not possible. Therefore this value is used as max value for all elements in the schema where MaxOccurs is set to "unbounded" and no special optimization attribute is available.
      integer ExiMaxOccursGenericElement [0..1]: 1..65535, set at pre-compile, origin=Vector Informatik, default-value=1  # Max Occurrence Value Generic Elements | Support for unbounded maximum occurrence values is not possible. Therefore this value is used as max value for generic #any and #other schema elements used in CanonicalizationMethod, DigestMethod, PGPData and SignatureMethod complex type included in the Signature used in the Message Header. The XSD schema does not limit the maximum number of these entries because the value is set to unbounded. RESTRICTION: Only required if ISO PnC identification mode with XML security should be supported. HINT: The use of this element is not required for ISO15118. Setting the value to 1 is recommended to reduce the code size.
      boolean ExiEnablePBufSupport: set at pre-compile, origin=Vector Informatik, default-value=true  # If 'Enable PBuf Support' is enabled, EXI uses AUTOSAR PBufs for EXI stream buffers. If linear buffers are used, disable this feature.
      boolean ExiEnableEVMessageSet: set at pre-compile, origin=Vector Informatik, default-value=true  # If 'Enable EV Message Set' is enabled, EXI is able to encode and decode the ISO 15118 and DIN 70121 messages that are required for the EV side. For optimization reason, this feature shall only be enabled for electric vehicles.
      boolean ExiEnableEVSEMessageSet: set at pre-compile, origin=Vector Informatik, default-value=false  # If 'Enable EVSE Message Set' is enabled, EXI is able to encode and decode the ISO 15118 and DIN 70121 messages that are required for the EVSE side. For optimization reason, this feature shall only be enabled for charge points.
      integer ExiBigIntegerMaxSize: 8..65535, set at pre-compile, origin=Vector Informatik, default-value=20  # XML Signature namespace requires support for bit integer values - numbers that are not limited to a maximum value (XSD type Integer). This configuration parameter is used to set the maximum number of bytes. This effects the parameter HMACOutpputLength and X509SerialNumber. HMACOutputLength shall not occur in an ISO15118 use case but X509SerialNumber may be used inside a KeyInfo element to identify the certificate that was used to create the signature and allow the receiver to get the public key information required for signature validation. RESTRICTION: Only required if ISO PnC identification mode with XML security should be supported. HINT: See [RFC5280 4.1.2.2. Serial Number] "The serial number MUST be a positive integer assigned by the CA to each certificate. It MUST be unique for each certificate issued by a given CA (i.e., the issuer name and serial number identify a unique certificate). CAs MUST force the serialNumber to be a non-negative integer. Given the uniqueness requirements above, serial numbers can be expected to contain long integers. Certificate users MUST be able to handle serialNumber values up to 20 octets. Conforming CAs MUST NOT use serialNumber values longer than 20 octets. Note: Non-conforming CAs may issue certificates with serial numbers that are negative or zero. Certificate users SHOULD be prepared to gracefully handle such certificates."
      integer ExiStringBufferSize: 1..65535, set at pre-compile, origin=Vector Informatik, default-value=64  # The string values used in the ISO15118 and XML Signature namespace is not length limited. The maximum supported length needs to be configured using this parameter. The stringValue element is included in the Parameter element used for service details, the X509IssuerName inside the X509IssuerSerial element, The X509SubjectName in the X509Data element and as XPath filter in the Transform element. RESTRICTION: Only required if ISO PnC identification with value added services or XML security should be supported.
      integer ExiUnboundedBufferSize: 1..65535, set at pre-compile, origin=Vector Informatik, default-value=64  # Support for unbounded length values is not possible. Therefore this value is used as max value for all elements in the schema where the buffer length is not limited and no special optimization attribute is available.
      boolean ExiIso15118FdisSupport: set at pre-compile, origin=Vector Informatik, default-value=true  # ISO 15118-2 FDIS Support | If 'ISO 15118-2 FDIS Support' is enabled, EXI Encoder/Decoder is able to handle Messages described in the ISO15118 MsgDef Schema Set urn:iso:15118:2:2013:MsgDef, version 2.0.
      boolean ExiXmlSecuritySupport: set at pre-compile, origin=Vector Informatik, default-value=true  # XML Security Support | If 'XML Security Support' is enabled, EXI Encoder/Decoder is able to handle Elements described in the XML Signature Schema. Schema fragment grammar encoding is supported as well to be able to generate and validate Signatures accoring to the ISO15118 requirements for PnC profile.
      boolean ExiUseVStdLib: set at pre-compile, origin=Vector Informatik, default-value=true  # During decoding Exi needs to clear the memory where to store the newly created structs. If this parameter is set to true, VStdLib functionality is used. Else Exi will call memset defined in string.h.
      boolean ExiIso15118FdisCustomerExtensionSupport [0..1]: set at pre-compile, origin=Vector Informatik, default-value=true  # ISO 15118-2 FDIS Customer Extension Support | If 'ISO 15118-2 FDIS Customer Extension Support' is enabled, EXI Encoder/Decoder is able to handle Messages described in the customer defined extension Schema Set for ISO15118 MsgDef Schema urn:iso:15118:2:2013:MsgDef, version 2.0.
      float ExiMainFunctionPeriod: 0.001..30, set at pre-compile, origin=Vector Informatik, default-value=0.005  # Main Function Period [sec] | Specifies the period in seconds that the MainFunction has to be triggered with.
      boolean ExiEncoderSimpleStreamingSupport: set at pre-compile, origin=Vector Informatik, default-value=true  # Enable Simple Encoder Streaming Support | If enabled the EXI encoder supports a simplified EXI stream streaming. It can encode the full EXI stream at once, parts of an EXI stream or just calculate the stream length without writing data. Note: This will result in a higher runtime for big messages (e.g. CertificateUpdateReq). The benefit is that the TLS and/or TCP buffer that is used by e.g. SCC can be reduced to e.g. 200 bytes.
      container ExiPaddingConfig [0..1]
        boolean ExiEnableStructPad16Bit: set at pre-compile, origin=Vector Informatik, default-value=false  # Enable 16 Bit Struct Padding | In case your platform does not support unaligned memory access, you should use this configuration. In case you have enough memory this setting may give you a performance advantage. Enabling 16 or 32 bit padding will result in all structures that do not have a length that is a multiple of 16 or 32 bit to be padded to this length. This will result in all following EXI structure structs to have the chosen alignment too. Note: Your compiler must not add padding or alignment itself. If it does, the manual padding must be disabled!
        boolean ExiEnableStructPad32Bit: set at pre-compile, origin=Vector Informatik, default-value=false  # Enable 32 Bit Struct Padding | In case your platform does not support unaligned memory access, you should use this configuration. In case you have enough memory this setting may give you a performance advantage. Enabling 16 or 32 bit padding will result in all structures that do not have a length that is a multiple of 16 or 32 bit to be padded to this length. This will result in all following EXI structure structs to have the chosen alignment too. Note: Your compiler must not add padding or alignment itself. If it does, the manual padding must be disabled!
        integer ExiStructPadBitFieldSize: 1..4, set at pre-compile, origin=Vector Informatik, default-value=1  # Struct Padding Bit Field Size | In case your platform does not support unaligned memory access, you should use this configuration. In case you have enough memory this setting may give you a performance advantage. Enabling 16 or 32 bit padding will result in all structures that do not have a length that is a multiple of 16 or 32 bit to be padded to this length. This will result in all following EXI structure structs to have the chosen alignment too. Note: Your compiler must not add padding or alignment itself. If it does, the manual padding must be disabled!
        integer ExiStructPadEnumSize: 1..4, set at pre-compile, origin=Vector Informatik, default-value=1  # Struct Padding Enum Size | In case your platform does not support unaligned memory access, you should use this configuration. In case you have enough memory this setting may give you a performance advantage. Enabling 16 or 32 bit padding will result in all structures that do not have a length that is a multiple of 16 or 32 bit to be padded to this length. This will result in all following EXI structure structs to have the chosen alignment too. Note: Your compiler must not add padding or alignment itself. If it does, the manual padding must be disabled!
    container ExiDIN70121 [0..1]
      integer ExiMaxOccursConsumptionCost: 1..65535, set at pre-compile, origin=Vector Informatik, default-value=3  # Max Occurrence Value Consumption Cost Element | Support for unbounded maximum occurrence values is not possible. Therefore this value is used as max value for ConsumptionCost schema element used in SalesTariffEntry complex type included in the SalesTariff used in the Charge Parameter Discovery Response. The XSD schema does not limit the maximum number of ConsumptionCost entries because the value is set to unbounded. HINT: ISO Requirement [V2G2-326] limits the value to 3. RESTRICTION: Only required if ISO PnC identification mode should be supported.
      integer ExiMaxOccursCost: 1..65535, set at pre-compile, origin=Vector Informatik, default-value=3  # Max Occurrence Value Cost Element | Support for unbounded maximum occurrence values is not possible. Therefore this value is used as max value for Cost schema element used in ConsumptionCost complex type included in the SalesTariff used in the Charge Parameter Discovery Response. The XSD schema does not limit the maximum number of Cost entries because the value is set to unbounded. HINT: ISO Requirement [V2G2-334] limits the value to 3. RESTRICTION: Only required if ISO PnC identification mode should be supported.
      integer ExiMaxOccursParameter: 1..65535, set at pre-compile, origin=Vector Informatik, default-value=2  # Max Occurrence Value Parameter Element | Support for unbounded maximum occurrence values is not possible. Therefore this value is used as max value for Parameter schema elements used in ParameterSet complex type included in the ParameterList used in the Service Details Response. The XSD schema does not limit the maximum number of these entries because the value is set to unbounded. HINT: ISO specified services internet access requieres 2 and certificate requires 1 Parameter. RESTRICTION: Only required if Services with Service Details (e.g. internet access, certificate service) should be supported.
      integer ExiMaxOccursParameterSet: 1..65535, set at pre-compile, origin=Vector Informatik, default-value=4  # Max Occurrence Value Parameter Set Element | Support for unbounded maximum occurrence values is not possible. Therefore this value is used as max value for ParameterSet schema elements used in ParameterList complex type included in the ParameterList used in the Service Details Response. The XSD schema does not limit the maximum number of these entries because the value is set to unbounded. HINT: ISO specified services internet access defines 4 and certificate defines 2 ParameterLists. RESTRICTION: Only required if Services with Service Details (e.g. internet access, certificate service) should be supported.
      integer ExiMaxOccursPaymentOption: 1..65535, set at pre-compile, origin=Vector Informatik, default-value=2  # Max Occurrence Value Payment Option Element | Support for unbounded maximum occurrence values is not possible. Therefore this value is used as max value for PaymentOption schema elements used in PaymentOptions complex type included in the Service Discovery Response. The XSD schema does not limit the maximum number of these entries because the value is set to unbounded. HINT: ISO specified only 2 valid PaymentOptions: Contract and ExternalPayment.
      integer ExiMaxOccursPMaxScheduleEntry: 1..65535, set at pre-compile, origin=Vector Informatik, default-value=12  # Max Occurrence Value PMax Schedule Entry Element | Support for unbounded maximum occurrence values is not possible. Therefore this value is used as max value for PMaxScheduleEntry schema elements used in PMaxSchedule complex type included in the SAScheduleList used in the Charge Parameter Response. The XSD schema does not limit the maximum number of these entries because the value is set to unbounded. HINT: ISO Requirement [V2G2-312] limits the value to 12.
      integer ExiMaxOccursProfileEntry: 1..65535, set at pre-compile, origin=Vector Informatik, default-value=24  # Max Occurrence Value Profile Entry Element | Support for unbounded maximum occurrence values is not possible. Therefore this value is used as max value for ProfileEntry schema elements used in ChargingProfile complex type included in the Power Delivery Request. The XSD schema does not limit the maximum number of these entries because the value is set to unbounded. HINT: ISO Requirement [V2G2-287] limits the value to 24.
      integer ExiMaxOccursRootCertificateID: 1..65535, set at pre-compile, origin=Vector Informatik, default-value=20  # Max Occurrence Value Root Certificate ID Element | Support for unbounded maximum occurrence values is not possible. Therefore this value is used as max value for RootCertificateID schema element used in ListOfRootCertificateIDs complex type included in Certificate Installation and Update Request messages. The XSD schema does not limit the maximum number of RootCertificateID because the value is set to unbounded. HINT: ISO Requirement [V2G2-357] limits the value to 20. RESTRICTION: Only required if ISO PnC identification mode should be supported.
      integer ExiMaxOccursSalesTariffEntry: 1..65535, set at pre-compile, origin=Vector Informatik, default-value=12  # Max Occurrence Value Sales Tariff Entry Element | Support for unbounded maximum occurrence values is not possible. Therefore this value is used as max value for SalesTariffEntry schema element used in SalesTariff complex type included in the Charge Parameter Discovery Response message. The XSD schema does not limit the maximum number of SalesTariffEntry because the value is set to unbounded. HINT: ISO Requirement [V2G2-320] limits the value to 12. RESTRICTION: Only required if ISO PnC identification mode should be supported.
      integer ExiMaxOccursSAScheduleTuple: 1..65535, set at pre-compile, origin=Vector Informatik, default-value=3  # Max Occurrence Value SA Schedule Tuple Element | Support for unbounded maximum occurrence values is not possible. Therefore this value is used as max value for SAScheduleTuple schema element used in SAScheduleList complex type included in the Charge Parameter Discovery Response message. The XSD schema does not limit the maximum number of SAScheduleTuple because the value is set to unbounded. HINT: ISO Requirement [V2G2-295] limits the value to 3. RESTRICTION: Only required if ISO PnC identification mode should be supported.
      integer ExiMaxOccursSelectedService: 1..65535, set at pre-compile, origin=Vector Informatik, default-value=3  # Max Occurrence Value Selected Service Element | Support for unbounded maximum occurrence values is not possible. Therefore this value is used as max value for SelectedService schema element used in SelectedServiceList complex type included in the Service Payment Selection Request message. The XSD schema does not limit the maximum number of SelectedService because the value is set to unbounded. HINT: ISO Requirement [V2G2-417] only defines 3 known services (AC_DC_Charging, Certificate and InternetAccess).
      integer ExiMaxOccursService: 1..65535, set at pre-compile, origin=Vector Informatik, default-value=3  # Max Occurrence Value Service Element | Support for unbounded maximum occurrence values is not possible. Therefore this value is used as max value for Service schema element used in ServiceTagList complex type included in the Service Discovery Response message. The XSD schema does not limit the maximum number of Service because the value is set to unbounded. HINT: ISO Requirement [V2G2-417] only defines 3 known services (AC_DC_Charging, Certificate and InternetAccess).
      integer ExiDinIDBufferSize: 1..65535, set at pre-compile, origin=Vector Informatik, default-value=10  # DIN ID Buffer Size | The ID string attribute used in the ISO15118 and XML Signature namespace is not length limited. The maximum supported string length needs to be configured using this parameter. The ID attribute is used to identify XML elements that are signed using XML Signature.
      integer ExiDinNameBufferSize: 1..65535, set at pre-compile, origin=Vector Informatik, default-value=8  # DIN Name Buffer Size | The Name string attribute used in the Parameter element at ISO15118 namespace is not length limited. The maximum supported length needs to be configured using this parameter. RESTRICTION: Only required if ISO PnC identification with value added services should be supported. HINT: ISO15118 specifies 3 valid Parameter Names: Service, Protocol and Port. A minimum size of 8 is recommended to be able to receive these parameters. See [V2G2-428], [V2G2-429] and the related Tables 100 and 101.
      integer ExiGenChallengeBufferSize: 1..65535, set at pre-compile, origin=Vector Informatik, default-value=32  # The GenChallenge element used in the ISO15118 namespace is not length limited. The maximum supported length needs to be configured using this parameter. RESTRICTION: Only required if ISO PnC identification mode should be supported. HINT: For ISO15118 the GenChallenge value will be a SHA256 hash value. The value langth will be 32 byte in this case. Note: Base64 encoding length does not need to be included in this length because EXI is working with the binary representation.
      boolean ExiACEIMSupport: set at pre-compile, origin=Vector Informatik, default-value=false  # AC External Identification Means Profile Support | If 'AC External Identification Means Profile Support' is enabled, EXI Encoder/Decoder is able to handle Messages described in the ISO15118/DIN70121 MsgDef Schema Set, that are included in the External Identification Means (EIM) Profile for AC charging.
      boolean ExiACPnCSupport: set at pre-compile, origin=Vector Informatik, default-value=false  # AC Plug and Charge Profile Support | If 'AC Plug and Charge Profile Support' is enabled, EXI Encoder/Decoder is able to handle Messages described in the ISO15118/DIN70121 MsgDef Schema Set, that are included in the Plug and Charge (PnC) Profile for AC charging.
      boolean ExiDCEIMSupport: set at pre-compile, origin=Vector Informatik, default-value=true  # DC External Identification Means Profile Support | If 'DC External Identification Means Profile Support' is enabled, EXI Encoder/Decoder is able to handle Messages described in the ISO15118/DIN70121 MsgDef Schema Set, that are included in the External Identification Means (EIM) Profile for DC charging.
      integer ExiMaxOccursCertificate: 1..65535, set at pre-compile, origin=Vector Informatik, default-value=8  # Max Occurrence Value Certificate Element | Support for unbounded maximum occurrence values is not possible. Therefore this value is used as max value for Certificate schema element used in SubCertifcates complex type included in the CertificateChain used in Certificate Installation and Update messages as well as in the Payment Details Request. The XSD schema does not limit the maximum number of Certificates because the value is set to unbounded. RESTRICTION: Only required if ISO PnC identification mode should be supported.
    container ExiISO15118FDIS [0..1]
      integer ExiIsoIDBufferSize: 1..65535, set at pre-compile, origin=Vector Informatik, default-value=10  # ISO ID Buffer Size | The ID string attribute used in the ISO15118 and XML Signature namespace is not length limited. The maximum supported string length needs to be configured using this parameter. The ID attribute is used to identify XML elements that are signed using XML Signature.
      integer ExiIsoNameBufferSize: 1..65535, set at pre-compile, origin=Vector Informatik, default-value=8  # ISO Name Buffer Size | The Name string attribute used in the Parameter element at ISO15118 namespace is not length limited. The maximum supported length needs to be configured using this parameter. RESTRICTION: Only required if ISO PnC identification with value added services should be supported. HINT: ISO15118 specifies 3 valid Parameter Names: Service, Protocol and Port. A minimum size of 8 is recommended to be able to receive these parameters. See [V2G2-428], [V2G2-429] and the related Tables 100 and 101.
      boolean ExiACEIMSupport: set at pre-compile, origin=Vector Informatik, default-value=true  # AC External Identification Means Profile Support | If 'AC External Identification Means Profile Support' is enabled, EXI Encoder/Decoder is able to handle Messages described in the ISO15118/DIN70121 MsgDef Schema Set, that are included in the External Identification Means (EIM) Profile for AC charging.
      boolean ExiACPnCSupport: set at pre-compile, origin=Vector Informatik, default-value=true  # AC Plug and Charge Profile Support | If 'AC Plug and Charge Profile Support' is enabled, EXI Encoder/Decoder is able to handle Messages described in the ISO15118/DIN70121 MsgDef Schema Set, that are included in the Plug and Charge (PnC) Profile for AC charging.
      boolean ExiDCEIMSupport: set at pre-compile, origin=Vector Informatik, default-value=false  # DC External Identification Means Profile Support | If 'DC External Identification Means Profile Support' is enabled, EXI Encoder/Decoder is able to handle Messages described in the ISO15118/DIN70121 MsgDef Schema Set, that are included in the External Identification Means (EIM) Profile for DC charging.
      boolean ExiDCPnCSupport: set at pre-compile, origin=Vector Informatik, default-value=false  # DC Plug and Charge Profile Support | If 'DC Plug and Charge Profile Support' is enabled, EXI Encoder/Decoder is able to handle Messages described in the ISO15118/DIN70121 MsgDef Schema Set, that are included in the Plug and Charge (PnC) Profile for DC charging.
      boolean ExiDecodePnCMessageSupport: set at pre-compile, origin=Vector Informatik, default-value=false  # Decode PnC Message Support | If enabled EXI will be able to decode PnC messages in EIM usecase. This may be required for detailed error logs. In case PnC is disabled and this option is: - Disabled: Decoding of e.g. a CertificateUpdateRes will result in a decode error. - Enabled: Decoding of e.g. a CertificateUpdateRes is possible, application e.g. SCC can decide how to handle this sequence error. Note: Decoding of messages that include optional PnC parameters is always possible. Note: This configuration will not enable PnC message encoding. Note: In case AC or DC PnC support is enabled this switch has no functionality for this engery type.
      boolean ExiDecodeAllAcDcSpecificMessages: set at pre-compile, origin=Vector Informatik, default-value=false  # Decode All AC/DC Specific Messages | If enabled EXI will be able to decode AC messages in DC only use case and vice verssa. This may be required for detailed error logs. In case an energy transfermode (e.g. DC charging) is disabled and this option is: - Disabled: Decoding of e.g. a CableCheckRes will result in a decode error. - Enabled: Decoding of e.g. a CableCheckRes is possible, application e.g. SCC can decide how to handle this sequence error. Note: The decoding of not supported energy transfer type elememnts is always possible e.g. decoding of ChargeParameterDiscoveryRes.DC_EVSEChargeParameter in an AC only use case. Note: This configuration will not enable the message encoding of unsupported energy transfer types. Note: In case AC and DC support is enabled this switch has no functionality.
    container ExiXMLSignature [0..1]
      integer ExiMaxOccursReference: 1..65535, set at pre-compile, origin=Vector Informatik, default-value=16  # Max Occurrence Value Reference Element | Support for unbounded maximum occurrence values is not possible. Therefore this value is used as max value for Reference schema elements used in Manifest or SignedInfo complex type. Manifest is a XML Security root element and may appear as a #any element below the Signature in the MessageHeader. SignedInfo complex type is included in the Signature in the MessageHeader. The XSD schema does not limit the maximum number of these entries because the value is set to unbounded. RESTRICTION: Only required if ISO PnC identification mode with XML security should be supported.
      integer ExiMaxOccursSignatureProperty [0..1]: 1..65535, set at pre-compile, origin=Vector Informatik, default-value=1  # Max Occurrence Value Signature Property Element | Support for unbounded maximum occurrence values is not possible. Therefore this value is used as max value for SignatureProperty schema element included in SignatureProperties complex type. SignatureProperty is a XML Security root element and may appear as a #any element below the Signature in the MessageHeader. The XSD schema does not limit the maximum number of SignatureProperty because the value is set to unbounded. RESTRICTION: Only required if ISO PnC identification mode with XML security should be supported. HINT: The use of this element is not required for ISO15118. Setting the value to 1 is recommended to reduce the code size.
      integer ExiMaxOccursTransform: 1..65535, set at pre-compile, origin=Vector Informatik, default-value=2  # Max Occurrence Value Transform Element | Support for unbounded maximum occurrence values is not possible. Therefore this value is used as max value for Transform schema element included in Transforms complex type is used in the Signature included in the MessageHeader. The XSD schema does not limit the maximum number of Transform because the value is set to unbounded. RESTRICTION: Only required if ISO PnC identification mode with XML security should be supported.
      integer ExiMaxOccursObject [0..1]: 1..65535, set at pre-compile, origin=Vector Informatik, default-value=1  # Max Occurrence Value Object Element | Support for unbounded maximum occurrence values is not possible. Therefore this value is used as max value for Object schema elements included in the Signature complex type used in the Message Header. The XSD schema does not limit the maximum number of these entries because the value is set to unbounded. RESTRICTION: Only required if ISO PnC identification mode with XML security should be supported. HINT: The use of this element is not required for ISO15118. Setting the value to 1 is recommended to reduce the code size.
      integer ExiMaxOccursTransformChoice: 1..65535, set at pre-compile, origin=Vector Informatik, default-value=1  # Max Occurrence Value Transform Choice Element | Support for unbounded maximum occurrence values is not possible. Therefore this value is used as max value for Transform choice schema element included in Transform complex type is used in the Signature included in the MessageHeader. The XSD schema does not limit the maximum number of Transform choice element because the value is set to unbounded. RESTRICTION: Only required if ISO PnC identification mode with XML security should be supported. HINT: This choice shall not be used in ISO15118 use case. Setting the value to 1 is recommended to reduce the code size.
      integer ExiMaxOccursSigPropertyChoice [0..1]: 1..65535, set at pre-compile, origin=Vector Informatik, default-value=1  # Max Occurrence Value Signature Property Choice Element | Support for unbounded maximum occurrence values is not possible. Therefore this value is used as max value for SignatureProperty choice schema element included in SignatureProperties complex type. SignatureProperty is a XML Security root element and may appear as a #any element below the Signature in the MessageHeader. The XSD schema does not limit the maximum number of SignatureProperty choice because the value is set to unbounded. RESTRICTION: Only required if ISO PnC identification mode with XML security should be supported. HINT: The use of this element is not required for ISO15118. Setting the value to 1 is recommended to reduce the code size.
      integer ExiMaxOccursKeyInfoChoice [0..1]: 1..65535, set at pre-compile, origin=Vector Informatik, default-value=1  # Max Occurrence Value Key Info Choice Element | Support for unbounded maximum occurrence values is not possible. Therefore this value is used as max value for KeyInfo choice schema elements used in Signature complex type. The XSD schema does not limit the maximum number of KeyInfo choice elements because the value is set to unbounded. RESTRICTION: Only required if ISO PnC identification mode with XML security should be supported. HINT: Only one KeyInfo element should be used for ISO15118-2 DIS. The use of this element is not required for ISO15118-2 FDIS. Setting the value to 1 is recommended to reduce the code size.
      integer ExiMaxOccursX509DataChoice [0..1]: 1..65535, set at pre-compile, origin=Vector Informatik, default-value=8  # Max Occurrence Value X509 Data Choice Element | Support for unbounded maximum occurrence values is not possible. Therefore this value is used as max value for X509Data choice schema elements used in KeyInfo complex type. The XSD schema does not limit the maximum number of X509Data choice elements because the value is set to unbounded. RESTRICTION: Only required if ISO PnC identification mode with XML security should be supported. HINT: X509Data choice element may represent a certificate chain required for signature validation in ISO15118-2 DIS. The use of this element is not required for ISO15118-2 FDIS. Setting the value to 1 for FDIS version is recommended to reduce the code size.
      integer ExiAlgorithmBufferSize: 1..65535, set at pre-compile, origin=Vector Informatik, default-value=51  # The Algorithm string attribute used in the XML Signature namespace is not length limited. The maximum supported string length needs to be configured using this parameter. RESTRICTION: Only required if ISO PnC identification mode with XML security should be supported. HINT: For ISO15118 the longest algorithm identifier is http://www.w3.org/2001/04/xmldsig-more#ecdsa-sha256. Therefore it is not recommended to configure a value smaller than 51.
      integer ExiXMLSigIDBufferSize: 1..65535, set at pre-compile, origin=Vector Informatik, default-value=10  # The ID string attribute used in the ISO15118 and XML Signature namespace is not length limited. The maximum supported string length needs to be configured using this parameter. The ID attribute is used to identify XML elements that are signed using XML Signature.
      integer ExiURIBufferSize: 1..65535, set at pre-compile, origin=Vector Informatik, default-value=11  # The URI string attribute used in the XML Signature namespace is not length limited. The maximum supported string length needs to be configured using this parameter. The URI is used to specify the referenced element inside the Reference element. RESTRICTION: Only required if ISO PnC identification mode with XML security should be supported. HINT: A good value is ID Buffer Size + 1 because ISO15118 uses same document references. Same document reference form is a #-signed followed by the ID.
      integer ExiDigestValueBufferSize: 1..65535, set at pre-compile, origin=Vector Informatik, default-value=32  # The DigestValue element used in the XML Signature namespace is not length limited. The maximum supported length needs to be configured using this parameter. RESTRICTION: Only required if ISO PnC identification mode with XML security should be supported. HINT: For ISO15118 the only supported hash algorithm is SHA256. The digest value length using SHA256 is 32 byte.
      integer ExiSignatureValueBufferSize: 1..65535, set at pre-compile, origin=Vector Informatik, default-value=72  # The SignatureValue element used in the XML Signature namespace is not length limited. The maximum supported length needs to be configured using this parameter. RESTRICTION: Only required if ISO PnC identification mode with XML security should be supported. HINT: For ISO15118 the only supported signature algorithm is ECDSA with SHA256 and curve secp256r1 (see [V2G2-006]). The signature value worst case length for this algorithm is 72 byte.
      integer ExiBase64BinaryBufferSize: 1..65535, set at pre-compile, origin=Vector Informatik, default-value=900  # The Base64Binary element used for X509SKI, X509CRL, X509Certificate and SPKISexp in the XML Signature namespace is not length limited. The maximum supported length needs to be configured using this parameter. RESTRICTION: Only required if ISO PnC identification mode with XML security should be supported. HINT: For ISO15118 the only X509Certificate is required. This element should be able to store a complete X509v3 certificate with a Base64 encoded maximum length of 1200 (see [V2G2-354]). Note: Base64 encoding length does not need to be included in this length because EXI is working with the binary representation. Therefore a buffer size of 900 byte will be a good value.
      integer ExiTypeBufferSize [0..1]: 1..65535, set at pre-compile, origin=Vector Informatik, default-value=1  # The Type attribute used inside the Reference and RetrievelMethod element in the XML Signature namespace is not length limited. The maximum supported length needs to be configured using this parameter. RESTRICTION: Only required if ISO PnC identification with XML security should be supported. HINT: The use of this attribute is not required for ISO15118. Setting the value to 1 is recommended to reduce the code size.
      integer ExiEncodingBufferSize [0..1]: 1..65535, set at pre-compile, origin=Vector Informatik, default-value=1  # The Encoding attribute used inside the Object element in the XML Signature namespace is not length limited. The maximum supported length needs to be configured using this parameter. RESTRICTION: Only required if ISO PnC identification with XML security should be supported. HINT: The use of the Object element and its attributes is not required for ISO15118. Setting the value to 1 is recommended to reduce the code size.
      integer ExiMimeTypeBufferSize [0..1]: 1..65535, set at pre-compile, origin=Vector Informatik, default-value=1  # The MimeType attribute used inside the Object element in the XML Signature namespace is not length limited. The maximum supported length needs to be configured using this parameter. RESTRICTION: Only required if ISO PnC identification with XML security should be supported. HINT: The use of the Object element and its attributes is not required for ISO15118. Setting the value to 1 is recommended to reduce the code size.
      integer ExiTargetBufferSize [0..1]: 1..65535, set at pre-compile, origin=Vector Informatik, default-value=1  # The Target attribute used inside the SignatureProperty element in the XML Signature namespace is not length limited. The maximum supported length needs to be configured using this parameter. RESTRICTION: Only required if ISO PnC identification with XML security should be supported. HINT: The use of the SignatureProperty element and its attributes is not required for ISO15118. Setting the value to 1 is recommended to reduce the code size.
      integer ExiCryptoBinaryBufferSize [0..1]: 1..65535, set at pre-compile, origin=Vector Informatik, default-value=1  # The CryptoBinary type used inside the RSAKeyValue and DSAKeyValue element in the XML Signature namespace is not length limited. The maximum supported length needs to be configured using this parameter. RESTRICTION: Only required if ISO PnC identification with XML security should be supported. HINT: The use of the RSAKeyValue and DSAKeyValue elements are not required for ISO15118. Setting the value to 1 is recommended to reduce the code size.
      integer ExiKeyNameBufferSize [0..1]: 1..65535, set at pre-compile, origin=Vector Informatik, default-value=1  # The KeyName element used inside the KeyInfo choice in the XML Signature namespace is not length limited. The maximum supported length needs to be configured using this parameter. RESTRICTION: Only required if ISO PnC identification with XML security should be supported. HINT: The use of the KeyName element is not required for ISO15118. Setting the value to 1 is recommended to reduce the code size.
      integer ExiMgmtDataBufferSize [0..1]: 1..65535, set at pre-compile, origin=Vector Informatik, default-value=1  # The MgmtData element used inside the KeyInfo choice in the XML Signature namespace is not length limited. The maximum supported length needs to be configured using this parameter. RESTRICTION: Only required if ISO PnC identification with XML security should be supported. HINT: The use of the MgmtData element is not required for ISO15118. Setting the value to 1 is recommended to reduce the code size.
  bsw implementation Exi_Impl: programming-language=C, sw-version=3.02.05, used-code-generator=DaVinci Configurator, vendor-id=30, ar-release-version=4.00.03, behavior=ExiBehavior, preconfigured-configuration=Exi_Pre, recommended-configuration=Exi_Rec, vendor-specific-module-def=Exi
  module config Exi_Pre: definition=Exi
  module config Exi_Rec: definition=Exi
