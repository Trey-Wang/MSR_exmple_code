AUTOSAR XML (schema 4-0-3)
# COPYRIGHT
# Copyright (c) 2017 by Vector Informatik GmbH. All rights reserved.
# This software is copyright protected and proprietary to Vector Informatik GmbH.
# Vector Informatik GmbH grants to you only those rights as set out in the license conditions.
package /MICROSAR
  bsw implementation Vita_Impl: programming-language=C, sw-version=2.01.00, ar-release-version=4.00.03, preconfigured-configuration=Vita_Pre, vendor-specific-module-def=Vita
  module definition Vita [0..1]: category=VENDOR_SPECIFIC_MODULE_DEFINITION, variants pre-compile/post-build-selectable/post-build-loadable  # Vector IntegrationTest Application | Configuration of the Vita (Vector IntegrationTest Application) module.
    container VitaGeneral  # Configuration of the general configuration parameters of the module.
      enumeration VitaImplementation: {VITAMIN, VITAMAX}, set at pre-compile, origin=Vector Informatik, default-value=VITAMIN  # This value specifies the implementation variant. - VITAMIN: A simple implementation is generated, suitable for customer + a CanoePanelAdaption CAPL file - VITAMAX: A complex implementation is generated, suitable for test + the LOTA CAPL file (DO NOT USE)
      enumeration VitaSwcScaling: {VITAMIN, SUPERSET}, set at pre-compile, origin=Vector Informatik, default-value=SUPERSET  # This value specifies if the generated SWC should scale: - VITAMIN: Only ports used by the Vitamin use case are generated. - SUPERSET: All ports are generated (superset). NOTE: Switching from VITAMIN to SUPERSET means loosing ports and thus loosing mappings. If you switch back to VITAMAX later, you have to re-do the mappings for the VITAMAX ports. (DO NOT USE)
      boolean VitaBreSupport [0..1]: set at pre-compile, origin=Vector Informatik, default-value=false  # BRE Support | TRUE: Start Application uses BSW API (BRE use case) FALSE or parameter does not exist: Start Application is modelled as SWC and uses ASR Ports (RTE use case)
      container Vitamin  # Configuration of the Vitamin (Start Application) use case.
        enumeration VitaMinCom: {BASIC}, set at pre-compile, origin=Vector Informatik, default-value=BASIC  # Com | This value specifies the test depth for the Vitamin COM use case. - BASIC: Demonstrate that simple signal transmission as well as reception works on runnable level The COM use case will only be considered if at least one VitaCanoeChannel exists.
        enumeration VitaMinMem: {BASIC, NONE}, set at pre-compile, origin=Vector Informatik, default-value=NONE  # Mem | This value specifies the test depth for the Vitamin MEM use case. - BASIC: Demonstrate that simple reading and writing of aNvBlock works on runnable level - NONE: No MEM use case
        enumeration VitaMinDiag: {BASIC, NONE}, set at pre-compile, origin=Vector Informatik, default-value=NONE  # Diag | This value specifies the test depth for the Vitamin DIAG use case. - BASIC: Demonstrate the setting of a DemEvent as well as Dcm RDBI/WDBI on runnable level - NONE: No DIAG use case
        enumeration VitaMinModeMgt: {BASIC, NONE}, set at pre-compile, origin=Vector Informatik, default-value=NONE  # Nm | This value specifies the test depth for the Vitamin NM use case. - BASIC: Demonstrate basic sleep/wakeup for CAN, LIN, FlexRay - NONE: No NM use case NOTE: For NON AUTOSAR NM channels there is only a ComM user request/release available, but no external wakeup or keeping alive with NM messages.
        enumeration VitaMinWdg: {BASIC, NONE}, set at pre-compile, origin=Vector Informatik, default-value=NONE  # Wdg | This value specifies the test depth for the Vitamin WDG use case. - BASIC: Demonstrate basic alive supervision for a supervised entity of the WdgM - NONE: No WDG use case
        enumeration VitaMinXcp: {BASIC, NONE}, set at pre-compile, origin=Vector Informatik, default-value=NONE  # Xcp | This value specifies the test depth for the Vitamin Xcp use case. - BASIC: Demonstrate basic upload and download via Xcp - NONE: No Xcp use case
        enumeration VitaMinJ1939Diag: {BASIC, NONE}, set at pre-compile, origin=Vector Informatik, default-value=NONE  # J1939Diag | This value specifies the test depth for the Vitamin J1939 DIAG use case. - BASIC: Demonstrate basic DemEvent Handling via J1939Dcm - NONE: No J1939 DIAG use case
        enumeration VitaMinScc: {BASIC, NONE}, set at pre-compile, origin=Vector Informatik, default-value=NONE  # Scc | This value specifies the test depth for the Vitamin Scc use case. - BASIC: Demonstrate basic Smart Charging Communication protocol interaction between Electric Vehicle (EV) and Electric Vehicle Supply Equipment (EVSE) - NONE: No Scc use case
        enumeration VitaMinMulticore: {BASIC, NONE}, set at pre-compile, origin=Vector Informatik, default-value=NONE  # Multicore | This value specifies the test depth for the Vitamin Multicore use case. - BASIC: Demonstrate intercore sender/receiver communication between two or more SWCs running on different cores. Please add the slave cores to be used in the VitaTestElement section - NONE: No Multicore use case
        enumeration VitaMinMemoryProtection: {BASIC, NONE}, set at pre-compile, origin=Vector Informatik, default-value=NONE  # MemoryProtection | This value specifies the test depth for the Vitamin MemoryProtection use case. - BASIC: Demonstrate the basic usage of the memory protection feature - NONE: No MemoryProtection use case
        boolean VitaMinComSecOcSupport [0..1]: set at pre-compile, origin=Vector Informatik, default-value=false  # Com SecOc Support | TRUE: Allow usage of SecOc signals for control ports and the COM use case. FALSE or parameter does not exist: SecOc signals are not allowed for control ports and the COM use case . NOTE: if you choose to enable SecOc support, you have to do additional configuration steps on CANoe side: See Vita Integration Manual.
      container VitaCanoeChannel [0..*]: post-build-changeable=true  # Configuration/Mapping of the CANoe channel names to bus drivers. For the StartApplication at least one VitaCanoeChannel must be created. For the "Setup Support Only" use case no VitaCanoeChannels must exist. In this case Vita will only have the follwing functionality: - Solving Actions to create Default Tasks - Generation of BswInit.c
        string VitaCanoeChannelName: set at post-build in variant post-build-loadable+post-build-selectable / pre-compile in variant pre-compile, origin=Vector Informatik, default-value=_unset_  # Set the name as configured in the CANoe network. Do not use CANoe keywords (CAN1...CAN32) as channel name. Generally avoid using similar constructs like CAN0, CAN00, etc. for channel names.
        choice reference VitaChannelRef: set at post-build in variant post-build-loadable+post-build-selectable / pre-compile in variant pre-compile, origin=Vector Informatik, destination=[CanController, FrIfController, LinChannel, EthCtrlConfig]  # Set the reference to the correspondig bus driver container.
      container Vitamax  # Configuration of the Vitamax (Test) use case. (DO NOT USE)
        enumeration VitaMaxCom: {NONE, SERIAL}, set at pre-compile, origin=Vector Informatik, default-value=NONE  # Com | This value specifies the test depth for the Vitamax COM use case and activates the COM specific validators to create COM test elements. - SERIAL: Configure Vitamax for serial production tests. - NONE: No Vitamax COM tests. (DO NOT USE)
        enumeration VitaMaxMem: {NONE, SERIAL}, set at pre-compile, origin=Vector Informatik, default-value=NONE  # Mem | This value specifies the test depth for the Vitamax MEM use case and activates the MEM specific validators to create MEM test elements. - SERIAL: Configure Vitamax for serial production tests. - NONE: No Vitamax MEM tests. (DO NOT USE)
        enumeration VitaMaxDiag: {NONE, SERIAL}, set at pre-compile, origin=Vector Informatik, default-value=NONE  # Diag | This value specifies the test depth for the Vitamax Diag use case and activates the Diag specific validators to create Diag test elements. - SERIAL: Configure Vitamax for serial production tests. - NONE: No Vitamax Diag tests. (DO NOT USE)
    container VitaPorts  # Configuration of Vita SWC ports
      boolean VitaUseGenericPortInterface: set at pre-compile, origin=Vector Informatik, default-value=false  # FALSE : Every Vita Control Port must have a valid reference. For every reference a corresponding port is generated in the SWC. This is the default behaviour. TRUE: A generic uint16 port is generated for every Vita Control Port with an empty reference. The user has to implement an adapter and map the ports accordingly.
      container VitaControlPorts [0..1]: post-build-changeable=true  # Configuration of control ports (mandatory). In PBS use case configure for one identity only.
        choice reference VitaControlRxSignal [0..1]: set at pre-compile, origin=Vector Informatik, destination=[ComSignal, ComGroupSignal]  # Select a Rx signal or group signal with at least 8bit and a primitive type (NOT UINT8_N). Note: For Vitamax, the Rx Ctrl and the Rx Data signal must be within the same pdu
        choice reference VitaControlTxSignal [0..1]: set at pre-compile, origin=Vector Informatik, destination=[ComSignal, ComGroupSignal]  # Select a Tx signal or group signal with at least 8bit and a primitive type (NOT UINT8_N).
        choice reference VitaDataRxSignal [0..1]: set at pre-compile, origin=Vector Informatik, destination=[ComSignal, ComGroupSignal]  # Select a Rx signal or group signal with at least 8bit and a primitive type (NOT UINT8_N). Note: For Vitamax, the Rx Ctrl and the Rx Data signal must be within the same pdu
        choice reference VitaDataTxSignal [0..1]: set at pre-compile, origin=Vector Informatik, destination=[ComSignal, ComGroupSignal]  # Select a Tx signal or group signal with at least 8bit and a primitive type (NOT UINT8_N).
    container VitaTestElements
      container VitaCom [0..1]
        container VitaComSignal [0..*]
          string VitaTestId: set at pre-compile, origin=Vector Informatik, default-value=_unset_  # Contains the test id
          enumeration VitaComSignalUseSrPort: {NOT, VITA_MAX, ALL}, set at pre-compile, origin=Vector Informatik, default-value=VITA_MAX  # Use S/R Port | This value specifies the usage of the test element. - NOT: No port is created and the test element is not accessible by the application. - VITA_MAX: A port is created on the SWC if VitaSwcScaling is set to SUPERSET and thus the test element is applicable for VitaMax based tests. - ALL: A port is always created on the SWC and thus the test element is applicable for VitaMax based tests as well as for further usage by the StartApplication use case (VitaMin).
          reference VitaComSignalRef: set at pre-compile, origin=Vector Informatik, destination=ComSignal  # Reference to a Com Signal
        container VitaComSignalGroup [0..*]
          string VitaTestId: set at pre-compile, origin=Vector Informatik, default-value=_unset_  # Contains the test id
          enumeration VitaComSignalGroupUseSrPort: {NOT, VITA_MAX, ALL}, set at pre-compile, origin=Vector Informatik, default-value=VITA_MAX  # Use S/R Port | This value specifies the usage of the test element. - NOT: No port is created and the test element is not accessible by the application. - VITA_MAX: A port is created on the SWC if VitaSwcScaling is set to SUPERSET and thus the test element is applicable for VitaMax based tests. - ALL: A port is always created on the SWC and thus the test element is applicable for VitaMax based tests as well as for further usage by the StartApplication use case (VitaMin).
          reference VitaComSignalGroupRef: set at pre-compile, origin=Vector Informatik, destination=ComSignalGroup  # Reference to a Com Signal Group
      container VitaMem [0..1]  # DO NOT USE
        container VitaNvMBlockDescriptor [0..*]
          enumeration VitaUseAdminPort: {NOT, VITA_MAX, ALL}, set at pre-compile, origin=Vector Informatik, default-value=VITA_MAX  # This value specifies the usage of the test element. - NOT: No port is created and the test element is not accessible by the application. - VITA_MAX: A port is created on the SWC if VitaSwcScaling is set to SUPERSET and thus the test element is applicable for VitaMax based tests. - ALL: A port is always created on the SWC and thus the test element is applicable for VitaMax based tests as well as for further usage by the StartApplication use case (VitaMin).
          string VitaTestId: set at pre-compile, origin=Vector Informatik, default-value=_unset_  # Contains the test id
          enumeration VitaUseSingleBlockRequestPort: {NOT, VITA_MAX, ALL}, set at pre-compile, origin=Vector Informatik, default-value=VITA_MAX  # This value specifies the usage of the test element. - NOT: No port is created and the test element is not accessible by the application. - VITA_MAX: A port is created on the SWC if VitaSwcScaling is set to SUPERSET and thus the test element is applicable for VitaMax based tests. - ALL: A port is always created on the SWC and thus the test element is applicable for VitaMax based tests as well as for further usage by the StartApplication use case (VitaMin).
          reference VitaNvMBlockDescriptorRef: set at pre-compile, origin=Vector Informatik, destination=NvMBlockDescriptor
      container VitaDiag [0..1]  # DO NOT USE
        container VitaDcmDspData [0..*]
          string VitaTestId: set at pre-compile, origin=Vector Informatik, default-value=_unset_  # Contains the test id
          enumeration VitaUseDataServicesPort: {NOT, VITA_MAX, ALL}, set at pre-compile, origin=Vector Informatik, default-value=VITA_MAX  # This value specifies the usage of the test element. - NOT: No port is created and the test element is not accessible by the application. - VITA_MAX: A port is created on the SWC if VitaSwcScaling is set to SUPERSET and thus the test element is applicable for VitaMax based tests. - ALL: A port is always created on the SWC and thus the test element is applicable for VitaMax based tests as well as for further usage by the StartApplication use case (VitaMin).
          reference VitaDcmDspDataRef: set at pre-compile, origin=Vector Informatik, destination=DcmDspData
        container VitaDcmDslProtocolRx [0..*]
          string VitaTestId: set at pre-compile, origin=Vector Informatik, default-value=_unset_  # Contains the test id
          reference VitaDcmDslProtocolRxRef: set at pre-compile, origin=Vector Informatik, destination=DcmDslProtocolRx
      container VitaMulticore [0..1]  # This container contains the multicore test elements. You can specify which slave cores shall be considered by the StartApplication, by adding slave core test elements and reference the corresponding core there.
        container VitaSlaveCore [0..8]  # This container represents one slave core which shall be used in StartApplication Multicore use case. Please ensure to instantiate the slave core SWC on the referenced core and connect it to the master SWC (StartApplication).
          reference VitaEcucCoreRef: set at pre-compile, origin=Vector Informatik, destination=EcucCoreDefinition  # Reference the slave core on which the slave core SWC shall run. Ensure not to choose the same core as the master core or as other test elements.
  module config Vita_Pre: definition=Vita
    VitaGeneral: VitaImplementation=VITAMIN, VitaSwcScaling=SUPERSET
      Vitamax: VitaMaxCom=NONE, VitaMaxDiag=NONE, VitaMaxMem=NONE
      Vitamin: VitaMinCom=BASIC, VitaMinComSecOcSupport=0
