AUTOSAR XML (schema 4-2-1)
package /MICROSAR
  module config TcpIp_Rec: definition=TcpIp
    TcpIpGeneral: TcpIpSafeBswChecks=1
