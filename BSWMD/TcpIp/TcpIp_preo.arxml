AUTOSAR XML (schema 4-0-3)
package /MICROSAR
  module config TcpIp_Pre: definition=TcpIp, implementation-config-variant=VARIANT-PRE-COMPILE
  module config TcpIp_Rec: definition=TcpIp
