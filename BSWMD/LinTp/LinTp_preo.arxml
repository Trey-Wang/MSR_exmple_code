AUTOSAR XML (schema 4-0-3)
package /MICROSAR
  module config LinTp_Pre: definition=LinTp
