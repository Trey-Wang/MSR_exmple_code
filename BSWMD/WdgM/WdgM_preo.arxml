AUTOSAR XML (schema 4-0-3)
package /MICROSAR
  module config WdgM_Pre: definition=WdgM
