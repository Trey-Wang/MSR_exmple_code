AUTOSAR XML (schema 4-0-3)
package /MICROSAR/VTT
  module config VTTCan_Rec: definition=VTTCan
    CanGeneral: CanSafeBswChecks=1
