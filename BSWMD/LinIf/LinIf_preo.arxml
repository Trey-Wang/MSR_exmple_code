AUTOSAR XML (schema 4-0-3)
package /MICROSAR
  module config LinIf_Pre: definition=LinIf
