AUTOSAR XML (schema 4-2-1)
package /MICROSAR
  module config EthFw_Rec: definition=EthFw
    EthFwGeneral: EthFwSafeBswChecks=1
