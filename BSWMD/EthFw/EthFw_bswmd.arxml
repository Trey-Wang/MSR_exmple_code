AUTOSAR XML (schema 4-2-1)
package /MICROSAR
  bsw implementation EthFw_Impl: programming-language=C, sw-version=1.00.01, used-code-generator=DaVinci Configurator, vendor-id=30, ar-release-version=4.02.01, behavior=EthFwBehavior, recommended-configuration=EthFw_Rec, vendor-specific-module-def=EthFw
  module definition EthFw [0..1]: category=VENDOR_SPECIFIC_MODULE_DEFINITION, variants pre-compile/post-build  # Ethernet Firewall | Configuration of the Ethernet Firewall module.
    container EthFwConfig: multiplicity set at pre-compile  # This container contains the configuration parameters for the Ethernet Firewall (EthFw) module.
      function name EthFwRxFrameDiscardedCbk [0..1]: multiplicity set at pre-compile, origin=Vector Informatik, set at pre-compile, min-length=1  # User-Callout which is called if a received frame is discarded by the firewall module.
      function name EthFwTxFrameDiscardedCbk [0..1]: multiplicity set at pre-compile, origin=Vector Informatik, set at pre-compile, min-length=1  # User-Callout which is called if a transmitted frame is discarded by the firewall module and will not be forwarded to the physical layer.
      container EthFwRule [1..*]: multiplicity set at post-build in variant post-build / pre-compile in variant pre-compile  # Contains configuration parameter for each individual firewall rule. The firewall is implemented as DENY-ALL firewall. Each rule is interpreted as WHITELIST.
        symbolic name reference EthFwControllerRef: multiplicity set at pre-compile, origin=Vector Informatik, set at pre-compile, destination=EthIfController  # Firewall rule is only relevant for the referenced controller. (VLAN)
        reference EthFwFrameOwnerRef: multiplicity set at pre-compile, origin=Vector Informatik, set at pre-compile, destination=EthIfFrameOwnerConfig  # Firewall rule is only relevant for the referenced frame type. (Ethertype)
        container EthFwMacAddr [1..*]: multiplicity set at post-build in variant post-build / pre-compile in variant pre-compile  # Contains information about the allowed MAC addresses. Three different types of configuration are possible: - Enable "AllowAll" switch and do not configure start and end addresses - Configure start address. (Single address) - Configure start and end address. (Range of addresses)
          string EthFwLocalMacAddrStart [0..1]: multiplicity set at post-build in variant post-build / pre-compile in variant pre-compile, origin=Vector Informatik, set at post-build in variant post-build / pre-compile in variant pre-compile  # Allowed LOCAL MAC address.
          string EthFwLocalMacAddrEnd [0..1]: multiplicity set at post-build in variant post-build / pre-compile in variant pre-compile, origin=Vector Informatik, set at post-build in variant post-build / pre-compile in variant pre-compile  # Allowed range of LOCAL MAC addresses (in combination with EthFwLocalMacAddrStart).
          boolean EthFwLocalMacAddrAllowAll: multiplicity set at pre-compile, origin=Vector Informatik, set at post-build in variant post-build / pre-compile in variant pre-compile, default-value=false  # Allowes all LOCAL MAC addresses.
          string EthFwRemoteMacAddrStart [0..1]: multiplicity set at post-build in variant post-build / pre-compile in variant pre-compile, origin=Vector Informatik, set at post-build in variant post-build / pre-compile in variant pre-compile  # Allowed REMOTE MAC address.
          string EthFwRemoteMacAddrEnd [0..1]: multiplicity set at post-build in variant post-build / pre-compile in variant pre-compile, origin=Vector Informatik, set at post-build in variant post-build / pre-compile in variant pre-compile  # Allowed range of REMOTE MAC addresses (in combination with EthFwRemoteMacAddrStart).
          boolean EthFwRemoteMacAddrAllowAll: multiplicity set at pre-compile, origin=Vector Informatik, set at post-build in variant post-build / pre-compile in variant pre-compile, default-value=false  # Allowes all REMOTE MAC addresses.
        container EthFwMacProtocol: multiplicity set at pre-compile  # Contains information about the next higher layer protocol.
          container EthFwIpRule [0..*]: multiplicity set at post-build in variant post-build / pre-compile in variant pre-compile  # Contains information about the next higher layer: IP
            container EthFwIpProtocol: multiplicity set at pre-compile  # Contains information about the next higher layer protocol.
              container EthFwRawProtocolRule [0..1]: multiplicity set at post-build in variant post-build / pre-compile in variant pre-compile  # Contains information about the allowed next higher layers.
                integer EthFwProtocolType [0..*]: 0..255, multiplicity set at post-build in variant post-build / pre-compile in variant pre-compile, origin=Vector Informatik, set at post-build in variant post-build / pre-compile in variant pre-compile  # Allowed protocol types.
                boolean EthFwAllowAllProtocolTypes: multiplicity set at pre-compile, origin=Vector Informatik, set at post-build in variant post-build / pre-compile in variant pre-compile, default-value=false  # Switch allows all porotocols of IP messages.
              container EthFwTcpRule [0..1]: multiplicity set at post-build in variant post-build / pre-compile in variant pre-compile  # Contains information about the next higher layer: TCP
                container EthFwTcpPort [1..*]: multiplicity set at post-build in variant post-build / pre-compile in variant pre-compile  # Contains information about the allowed TCP ports. Three different types of configuration are possible: - Enable "AllowAll" switch and do not configure start and end ports - Configure start port. (Single port) - Configure start and end port. (Range of ports)
                  integer EthFwLocalPortStart [0..1]: 0..65535, multiplicity set at post-build in variant post-build / pre-compile in variant pre-compile, origin=Vector Informatik, set at post-build in variant post-build / pre-compile in variant pre-compile  # Allowed LOCAL PORT.
                  integer EthFwLocalPortEnd [0..1]: 0..65535, multiplicity set at post-build in variant post-build / pre-compile in variant pre-compile, origin=Vector Informatik, set at post-build in variant post-build / pre-compile in variant pre-compile  # Allowed range of LOCAL PORTS (in combination with EthFwLocalPortStart).
                  boolean EthFwLocalPortAllowAll: multiplicity set at pre-compile, origin=Vector Informatik, set at post-build in variant post-build / pre-compile in variant pre-compile, default-value=false  # Allowes all LOCAL PORTS.
                  integer EthFwRemotePortStart [0..1]: 0..65535, multiplicity set at post-build in variant post-build / pre-compile in variant pre-compile, origin=Vector Informatik, set at post-build in variant post-build / pre-compile in variant pre-compile  # Allowed REMOTE PORT.
                  integer EthFwRemotePortEnd [0..1]: 0..65535, multiplicity set at post-build in variant post-build / pre-compile in variant pre-compile, origin=Vector Informatik, set at post-build in variant post-build / pre-compile in variant pre-compile  # Allowed range of REMOTE PORTS (in combination with EthFwRemotePortStart).
                  boolean EthFwRemotePortAllowAll: multiplicity set at pre-compile, origin=Vector Informatik, set at post-build in variant post-build / pre-compile in variant pre-compile, default-value=false  # Allowes all REMOTE PORTS.
              container EthFwUdpRule [0..1]: multiplicity set at post-build in variant post-build / pre-compile in variant pre-compile  # Contains information about the next higher layer: UDP
                container EthFwUdpPort [1..*]: multiplicity set at post-build in variant post-build / pre-compile in variant pre-compile  # Contains information about the allowed UDP ports. Three different types of configuration are possible: - Enable "AllowAll" switch and do not configure start and end ports - Configure start port. (Single port) - Configure start and end port. (Range of ports)
                  integer EthFwLocalPortStart [0..1]: 0..65535, multiplicity set at post-build in variant post-build / pre-compile in variant pre-compile, origin=Vector Informatik, set at post-build in variant post-build / pre-compile in variant pre-compile  # Allowed LOCAL PORT.
                  integer EthFwLocalPortEnd [0..1]: 0..65535, multiplicity set at post-build in variant post-build / pre-compile in variant pre-compile, origin=Vector Informatik, set at post-build in variant post-build / pre-compile in variant pre-compile  # Allowed range of LOCAL PORTS (in combination with EthFwLocalPortStart).
                  boolean EthFwLocalPortAllowAll: multiplicity set at pre-compile, origin=Vector Informatik, set at post-build in variant post-build / pre-compile in variant pre-compile, default-value=false  # Allowes all LOCAL PORTS.
                  integer EthFwRemotePortStart [0..1]: 0..65535, multiplicity set at post-build in variant post-build / pre-compile in variant pre-compile, origin=Vector Informatik, set at post-build in variant post-build / pre-compile in variant pre-compile  # Allowed REMOTE PORT.
                  integer EthFwRemotePortEnd [0..1]: 0..65535, multiplicity set at post-build in variant post-build / pre-compile in variant pre-compile, origin=Vector Informatik, set at post-build in variant post-build / pre-compile in variant pre-compile  # Allowed range of REMOTE PORTS (in combination with EthFwRemotePortStart).
                  boolean EthFwRemotePortAllowAll: multiplicity set at pre-compile, origin=Vector Informatik, set at post-build in variant post-build / pre-compile in variant pre-compile, default-value=false  # Allowes all REMOTE PORTS.
            container EthFwIpAddr [1..*]: multiplicity set at post-build in variant post-build / pre-compile in variant pre-compile  # Contains information about the allowed IP addresses. Three different types of configuration are possible: - Enable "AllowAll" switch and do not configure start and end addresses - Configure start address. (Single address) - Configure start and end address. (Range of addresses)
              string EthFwLocalIpAddrStart [0..1]: multiplicity set at post-build in variant post-build / pre-compile in variant pre-compile, origin=Vector Informatik, set at post-build in variant post-build / pre-compile in variant pre-compile  # Allowed LOCAL IP address.
              string EthFwLocalIpAddrEnd [0..1]: multiplicity set at post-build in variant post-build / pre-compile in variant pre-compile, origin=Vector Informatik, set at post-build in variant post-build / pre-compile in variant pre-compile  # Allowed range of LOCAL IP addresses (in combination with EthFwLocalIpAddrStart).
              boolean EthFwLocalIpAddrAllowAll: multiplicity set at pre-compile, origin=Vector Informatik, set at post-build in variant post-build / pre-compile in variant pre-compile, default-value=false  # Allowes all LOCAL IP addresses.
              string EthFwRemoteIpAddrStart [0..1]: multiplicity set at post-build in variant post-build / pre-compile in variant pre-compile, origin=Vector Informatik, set at post-build in variant post-build / pre-compile in variant pre-compile  # Allowed REMOTE IP address.
              string EthFwRemoteIpAddrEnd [0..1]: multiplicity set at post-build in variant post-build / pre-compile in variant pre-compile, origin=Vector Informatik, set at post-build in variant post-build / pre-compile in variant pre-compile  # Allowed range of REMOTE IP addresses (in combination with EthFwRemoteIpAddrStart).
              boolean EthFwRemoteIpAddrAllowAll: multiplicity set at pre-compile, origin=Vector Informatik, set at post-build in variant post-build / pre-compile in variant pre-compile, default-value=false  # Allowes all REMOTE IP addresses.
          container EthFwAvbRule [0..1]: multiplicity set at post-build in variant post-build / pre-compile in variant pre-compile  # Contains information about the next higher layer: AVB
            integer EthFwStreamId [1..*]: 0..18446744073709551615, multiplicity set at post-build in variant post-build / pre-compile in variant pre-compile, origin=Vector Informatik, set at post-build in variant post-build / pre-compile in variant pre-compile  # Allowed AVB stream IDs.
        container EthFwFramePriority [0..1]: multiplicity set at post-build in variant post-build / pre-compile in variant pre-compile  # Configuration of allowed frame priorities.
          integer EthFwFramePriority [0..7]: 0..7, multiplicity set at post-build in variant post-build / pre-compile in variant pre-compile, origin=Vector Informatik, set at post-build in variant post-build / pre-compile in variant pre-compile  # Allowed frame priorities.
          boolean EthFwAllowAllFramePriorities: multiplicity set at pre-compile, origin=Vector Informatik, set at post-build in variant post-build / pre-compile in variant pre-compile, default-value=false  # Switch allows all frame priorities.
    container EthFwGeneral: multiplicity set at pre-compile  # This container lists the general configuration parameters for the ETHFW module.
      string EthFwUserConfigFile [0..1]: multiplicity set at pre-compile, origin=Vector Informatik, set at pre-compile, default-value=X:\xyz\EthFw_UserConfig.txt, min-length=1  # Reference to an external user configuration file that will be included during generation. The content of the user configuration file will be added at the end of the generated module configuration file and allows altering or extending the generated code. Caution: User configuration files can cause the software module to malfunction and must only be used with great care!
      boolean EthFwDevErrorDetect: multiplicity set at pre-compile, origin=Vector Informatik, set at pre-compile, default-value=true  # Enables and disables the development error detection and notification mechanism.
      boolean EthFwVersionInfoApi: multiplicity set at pre-compile, origin=Vector Informatik, set at pre-compile, default-value=false  # Enables and disables the version info API.
      boolean EthFwEnabled: multiplicity set at pre-compile, origin=Vector Informatik, set at pre-compile, default-value=true  # Enables and disables the firewall module.
      boolean EthFwSafeBswChecks: multiplicity set at pre-compile, origin=Vector Informatik, set at pre-compile, default-value=false  # Selects if safety checks are used. These checks improve robustness as e.g. invalid parameters are checked before function is executed. This attribute has to be enabled for safety projects where this component is mapped to an ASIL partition.
      container EthFwGeneration: multiplicity set at pre-compile  # Contains the generation configuration parameters of the module EthFw.
        enumeration EthFwOutOfBoundsWriteProtectionStrategy: multiplicity set at pre-compile, origin=Vector Informatik, set at pre-compile, default-value=NONE  # This parameter is used to configure a strategy to protect the code to write out of bounds. NONE: no protection strategy is generated in the data access. INDEX_SATURATION: arrays are blown up and the data access index is saturated by an appropriate mask. The advantage is the speed of the data access, but own data elements at other indexes of the same variable can be overridden. INDEX_CHECKING: the data access index is validated by a runtime check. The advantage is that values are never written to incorrect indexes of the data access.
          NONE  # none
          INDEX_SATURATION  # index saturation
          INDEX_CHECKING  # index checking
        boolean EthFwOutOfBoundsWriteSanitizer: multiplicity set at pre-compile, origin=Vector Informatik, set at pre-compile, default-value=false  # This parameter activates/deactivates the generation of runtime checks which call a DET error notification function to find easily out of bounds write problems. FALSE: no checks are generated in the data access. TRUE: the data access is enriched with DET checks to validate indexes.
        boolean EthFwOutOfBoundsReadSanitizer: multiplicity set at pre-compile, origin=Vector Informatik, set at pre-compile, default-value=false  # This parameter activates/deactivates the generation of runtime checks which call a DET error notification function to find easily out of bounds read problems. FALSE: no checks are generated in the data access. TRUE: the data access is enriched with DET checks to validate indexes.
        enumeration EthFwNumericalDataTypeMinimizationStrategy: multiplicity set at pre-compile, origin=Vector Informatik, set at pre-compile, default-value=MINIMIZE_NUMERICAL_DATA_TYPES_WITH_CAST  # This parameter is used to minimize the datatypes of CONFIG-CLASS PRE-COMPILE numerical data based on the used values. NONE: the datatype is not minimized. MINIMIZE_NUMERICAL_DATA_TYPES_WITHOUT_CAST: the datatype of numerical data is minimized. Unsigned data types are not changed to signed datatypes. MINIMIZE_NUMERICAL_DATA_TYPES_WITH_CAST: the datatype of numerical data is minimized. Unsigned data types can be optimized to signed datatypes.
          NONE  # none
          MINIMIZE_NUMERICAL_DATA_TYPES_WITHOUT_CAST  # minimize numerical data types without cast
          MINIMIZE_NUMERICAL_DATA_TYPES_WITH_CAST  # minimize numerical data types with cast
        boolean EthFwReduceConstantData2Define: multiplicity set at pre-compile, origin=Vector Informatik, set at pre-compile, default-value=false  # Reduce Constant Data To a Define | This parameter activates/deactivates the capability to generate CONFIG-CLASS PRE-COMPILE ROM arrays as constant define. FALSE: ROM arrays are generated as data even if all values are identical. TRUE: ROM arrays are generated as constant define if all values are identical.
        enumeration EthFwBoolDataInArrayOfStructStrategy: multiplicity set at pre-compile, origin=Vector Informatik, set at pre-compile, default-value=BITMASKING  # This parameter is used to tailor the usage of boolean data in structures in all CONFIG-CLASSES ROM data. The difference between BITFIELD and BITMASKING depends on your compiler options and memory mapping. BOOLEAN: the datatype of boolean data is native boolean. BITFIELD: the bitfield type is used and the compiler extracts the boolean data from structures. BITMASKING: generated masks are used to extract the boolean data from structures.
          BOOLEAN  # boolean
          BITFIELD  # bitfield
          BITMASKING  # bitmasking
        boolean EthFwDeduplicateIndirectedData: multiplicity set at pre-compile, origin=Vector Informatik, set at pre-compile, default-value=true  # This parameter activates/deactivates the capability to compress 0:N relational ROM data in all CONFIG-CLASSES without increasing the runtime. FALSE: 0:N relational ROM data is not compressed. TRUE: 0:N relational ROM data is compressed without increasing the runtime.
        enumeration EthFwDataDeduplicationStrategy: multiplicity set at pre-compile, origin=Vector Informatik, set at pre-compile, default-value=DEDUPLICATE_CONST_DATA_WITH_CAST  # This parameter is used to taylor the the deduplication of CONFIG-CLASS PRE-COMPILE ROM data. NONE: The generated data is not deduplicated. DEDUPLICATE_CONST_DATA_WITHOUT_CAST: The data is deduplicated without using casts. DEDUPLICATE_CONST_DATA_WITH_CAST: The data is deduplicated using casts.
          NONE  # none
          DEDUPLICATE_CONST_DATA_WITHOUT_CAST  # deduplicate const data without cast
          DEDUPLICATE_CONST_DATA_WITH_CAST  # deduplicate const data with cast
        integer EthFwReduceBoolDataByNegationThreshold: 0..9223372036854775807, multiplicity set at pre-compile, origin=Vector Informatik, set at pre-compile, default-value=2  # This parameter activates/deactivates the capability to compress boolean CONFIG-CLASS PRE-COMPILE ROM data by using the negation operator. 0: The optimization is deactivated. >0: If the number of deduplicateable elements is greater than this threshold the data optimization can be performed.
        integer EthFwReduceBoolDataByNumericalComparisonThreshold: 0..9223372036854775807, multiplicity set at pre-compile, origin=Vector Informatik, set at pre-compile, default-value=2  # This parameter activates/deactivates the capability to compress boolean CONFIG-CLASS PRE-COMPILE ROM data by using numerical comparison with other ROM data. 0: The optimization is deactivated. >0: If the number of deduplicateable elements is greater than this threshold the data optimization can be performed.
        integer EthFwReduceBoolDataByNumericalRelationThreshold: 0..9223372036854775807, multiplicity set at pre-compile, origin=Vector Informatik, set at pre-compile, default-value=2  # This parameter activates/deactivates the capability to compress boolean CONFIG-CLASS PRE-COMPILE ROM data by using relational comparison with other ROM data. 0: The optimization is deactivated. >0: If the number of deduplicateable elements is greater than this threshold the data optimization can be performed.
        enumeration EthFwReduceBoolDataByNumericalOperandStrategy: multiplicity set at pre-compile, origin=Vector Informatik, set at pre-compile, default-value=DEDUPLICATE_DATA_WITH_ANY_VALUE  # This parameter is used to taylor the CONFIG-CLASS PRE-COMPILE ROM bool data with number deduplication mechanisms. A comparison with 0 is very efficient, but a numerical comparison with a value not 0 can be used to increase the ROM data compression rate. NONE: ROM data deduplications are switched off. DEDUPLICATE_DATA_WITH_ZERO: ROM data deduplications can be applied with the value 0. DEDUPLICATE_DATA_WITH_ANY_VALUE: ROM data deduplications can be applied with any numerical value.
          NONE  # none
          DEDUPLICATE_DATA_WITH_ZERO  # deduplicate data with zero
          DEDUPLICATE_DATA_WITH_ANY_VALUE  # deduplicate data with any value
        integer EthFwReduceNumericalDataByOffsetThreshold: 0..9223372036854775807, multiplicity set at pre-compile, origin=Vector Informatik, set at pre-compile, default-value=2  # This parameter activates/deactivates the capability to compress numerical CONFIG-CLASS PRE-COMPILE ROM data by using a constant offset. 0: The optimization is deactivated. >0: If the number of deduplicateable elements is greater than this threshold the data optimization can be performed.
        integer EthFwReduceNumericalDataByArraySubtractionThreshold: 0..9223372036854775807, multiplicity set at pre-compile, origin=Vector Informatik, set at pre-compile, default-value=2  # This parameter activates/deactivates the capability to compress numerical CONFIG-CLASS PRE-COMPILE ROM data by using a subtraction with other ROM data. 0: The optimization is deactivated. >0: If the number of deduplicateable elements is greater than this threshold the data optimization can be performed.
        boolean EthFwReduceDataByStreaming: multiplicity set at pre-compile, origin=Vector Informatik, set at pre-compile, default-value=false  # This parameter activates/deactivates the capability to pack generated CONFIG-CLASS PRE-COMPILE ROM data into a data type dependent stream. FALSE: generated const data is not packed into a data type dependent stream. TRUE: generated const data is packed into a data type dependent stream.
        boolean EthFwShortSymbols: multiplicity set at pre-compile, origin=Vector Informatik, set at pre-compile, default-value=false  # This parameter activates/deactivates the capability to generate shortened symbol names. FALSE: symbol names are generated in a human readable style based on the MIP, tags and variant names. TRUE: symbol names are generated based on the MIP and a CRC32.
        boolean EthFwInterfacesForDeactivatedData: multiplicity set at pre-compile, origin=Vector Informatik, set at pre-compile, default-value=false  # This parameter activates/deactivates the capability to generate bsw data interfaces for deactivated data elements. This is an advantage for the BSW developer to reduce the time to market with a development environment using auto completition and to investigate potential interfaces. FALSE: data interfaces are not generated if the data elementis deactivated. TRUE: data interfaces are generated as e.g. emty macros.
        boolean EthFwReferringKeysInComments: multiplicity set at pre-compile, origin=Vector Informatik, set at pre-compile, default-value=false  # This parameter activates/deactivates the capability to generate referring keys in comments. This is an advantage for the developer to investigate indirections, but this feature reduces the overall readability of the generated data. FALSE: referring keys are not generated in comments. TRUE: referring keys are generated in comments.
