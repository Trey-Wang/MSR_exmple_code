AUTOSAR XML (schema 4-0-3)
package /MICROSAR
  module config Wdg_Rec: definition=Wdg
    WdgGeneral: WdgSafeBswChecks=1
