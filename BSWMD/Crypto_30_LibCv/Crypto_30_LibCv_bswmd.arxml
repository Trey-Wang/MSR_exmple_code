AUTOSAR XML (schema 4-0-3)
# COPYRIGHT
# Copyright (c) 2017 by Vector Informatik GmbH. All rights reserved.
# This software is copyright protected and proprietary to Vector Informatik GmbH.
# Vector Informatik GmbH grants to you only those rights as set out in the license conditions.
package /MICROSAR/Crypto_30_LibCv
  bsw implementation Crypto_Impl: programming-language=C, sw-version=2.01.00, used-code-generator=DaVinci Configurator 5, vendor-id=30, ar-release-version=4.03.00, behavior=Crypto_30_LibCv, preconfigured-configuration=Crypto_Pre, recommended-configuration=Crypto_Rec, vendor-api-infix=LibCv, vendor-specific-module-def=Crypto
  module definition Crypto [0..1]: category=VENDOR_SPECIFIC_MODULE_DEFINITION, refined-module-def=Crypto, variants pre-compile  # Software Crypto Driver
    container CryptoDriverObjects  # Container for Crypto Driver Objects
      container CryptoDriverObject [1..*]  # Container for configuration of Crypto Driver Object. The container name serves as a symbolic name for the identifier of a Crypto Driver Object.
        integer CryptoDriverObjectId: 0..4294967295, set at pre-compile, symbolic-name-value=true, default-value=0  # Identifier of the Crypto Driver Object. The Crypto Driver Object offers different crypto primitives.
        integer CryptoDriverObjectQueueSize: 1..1, set at pre-compile, default-value=1  # Size of the queue in the Crypto Driver. Defines the maximum number of jobs in the Crypto Driver Object queue. If it is set to 0, queueing is disabled in the Crypto Driver Object. This Crypto Driver does not support queuing but uses the buffer for asynchronous processing.
        reference CryptoPrimitiveRef [1..*]: set at pre-compile, destination=CryptoPrimitive  # Refers to primitive in the CRYPTO. The CryptoPrimitive is a pre-configured container of the crypto service that shall be used.
    container CryptoGeneral  # Container for common configuration options.
      boolean CryptoDevErrorDetect: set at pre-compile, default-value=true  # Switches the development error detection and notification on or off. - True: detection and notification is enabled. - False: detection and notification is disabled. | True: Development error detection enabled. False: Development error detection disabled
      boolean CryptoVersionInfoApi: set at pre-compile, default-value=false  # Pre-processor switch to enable and disable availability of the API Crypto_GetVersionInfo(). - True: API Crypto_GetVersionInfo() is available - False: API Crypto_GetVersionInfo() is not available.
      float CryptoMainFunctionPeriod: 0..3600, set at pre-compile, default-value=0.01  # Specifies the period of main function Crypto_MainFunction in seconds.
      boolean CryptoSupportSheKeyUpdate: set at pre-compile, origin=Vector Informatik, default-value=false  # If enabled, the She key update with M1,M2 and M3 can be used for setting/updating a key. Disable to save ROM and Runtime.
      boolean CryptoSupportKeyDerive: set at pre-compile, origin=Vector Informatik, default-value=false  # If enabled, key derivation is usable via Crypto_KeyDerive API. Disable to save ROM.
      boolean CryptoSupportPublicKeyExchange: set at pre-compile, origin=Vector Informatik, default-value=false  # If enabled, key exchange is usable via Crypto_KeyExchangeCalcPubVal and Crypto_KeyExchangeCalcSecret API. Disable to save ROM.
      symbolic name reference CryptoNvMBlockDescriptor [0..1]: set at pre-compile, origin=Vector Informatik, destination=NvMBlockDescriptor  # NvM Block Descriptor | Reference to the NvM Block Descriptor to store Key Elements
    container CryptoKeyElements [0..1]  # Container for CRYPTO key elements
      container CryptoKeyElement [1..*]  # Configuration of a CryptoKeyElement
        integer CryptoKeyElementId: 0..4294967295, set at pre-compile, symbolic-name-value=true  # Identifier of the CRYPTO key element
        integer CryptoKeyElementSize: 1..4294967295, set at pre-compile, default-value=16  # Maximum size of a CRYPTO key element in bytes
        string CryptoKeyElementInitValue [0..1]: set at pre-compile  # Value which will be used to fill the element during initialisation, when the element is not already initialized.
        enumeration CryptoKeyElementReadAccess: {RA_ALLOWED, RA_DENIED, RA_ENCRYPTED, RA_INTERNAL_COPY}, set at pre-compile, default-value=RA_ALLOWED  # Define the reading access rights of the key element. CRYPTO_RA_DENIED = key element cannot be read from outside the Crypto Driver CRYPTO_RA INTERNAL_COPY = key element can be copied to another key element in the same crypto driver. CRYPTO_RA_ALLOWED = key element can be read as plaintext CRYPTO_RA_ENCRYPTED = key element can be read encrypted. E.g. SHE Ram- Key export.
        boolean CryptoKeyElementAllowPartialAccess: set at pre-compile, default-value=false  # Enable or disable writing and reading the key element with data smaller than the size of the element. - True: enable partial access of the key element - False: disable partial access of the key element
        boolean CryptoKeyElementPersist: set at pre-compile, default-value=false  # Enable or disable persisting of the key element in non-volatile storage. - True: enable persisting of the key element. - False: disable persisting of the key element.
        enumeration CryptoKeyElementWriteAccess: {WA_ALLOWED, WA_DENIED, WA_ENCRYPTED, WA_INTERNAL_COPY}, set at pre-compile, default-value=WA_ALLOWED  # Define the writing access rights of the key element CRYPTO_WA_DENIED = key element cannot be written from outside the Crypto Driver CRYPTO_WA INTERNAL_COPY = key element can be filled with another key element in the same crypto driver. CRYPTO_WA_ALLOWED = key element can be rewritten as plaintext CRYPTO_WA_ENCRYPTED = key element can be written encrypted. E.g. SHE load key.
        reference CryptoKeyElementVirtualTargetRef [0..1]: set at pre-compile, destination=CryptoKeyElement  # Refers to a key element which will contain the actual data. If the Reference is configured, the key element will be a virtual key element.
    container CryptoKeyTypes [0..1]  # Container for CRYPTO key types
      container CryptoKeyType [1..*]  # Configuration of a CryptoKeyType
        reference CryptoKeyElementRef [1..*]: set at pre-compile, destination=CryptoKeyElement  # Refers to a pointer in the CRYPTOCrypto Key Element, which holds the data of the crypto key element.
    container CryptoKeys [0..1]  # Container for CRYPTO keys
      container CryptoKey [1..*]  # Configuration of a CryptoKey
        integer CryptoKeyId: 0..4294967295, set at pre-compile, symbolic-name-value=true, default-value=0  # Identifier of the CRYPTO key
        integer CryptoKeyDeriveIterations: 1..4294967295, set at pre-compile, default-value=1  # Holds the number of iterations to be performed by the key derivation primitive
        reference CryptoKeyTypeRef: set at pre-compile, destination=CryptoKeyType  # Refers to a pointer in the CRYPTO to a CryptoKeyType. The CryptoKeyType provides the information which key elements are contained in a CryptoKey.
    container CryptoPrimitives [0..1]  # Container for CRYPTO primitives
      container CryptoPrimitive [0..*]  # Configuration of a CryptoPrimitive
        enumeration CryptoPrimitiveAlgorithmFamily [1..*]: {CRYPTO_ALGOFAM_NOT_SET, CRYPTO_ALGOFAM_SHA1, CRYPTO_ALGOFAM_SHA2_224, CRYPTO_ALGOFAM_SHA2_256, CRYPTO_ALGOFAM_SHA2_384, CRYPTO_ALGOFAM_SHA2_512, CRYPTO_ALGOFAM_SHA2_512_224, CRYPTO_ALGOFAM_SHA2_512_256, CRYPTO_ALGOFAM_SHA3_224, CRYPTO_ALGOFAM_SHA3_256, CRYPTO_ALGOFAM_SHA3_384, CRYPTO_ALGOFAM_SHA3_512, CRYPTO_ALGOFAM_SHAKE128, CRYPTO_ALGOFAM_SHAKE256, CRYPTO_ALGOFAM_RIPEMD160, CRYPTO_ALGOFAM_BLAKE_1_256, CRYPTO_ALGOFAM_BLAKE_1_512, CRYPTO_ALGOFAM_BLAKE_2s_256, CRYPTO_ALGOFAM_BLAKE_2s_512, CRYPTO_ALGOFAM_3DES, CRYPTO_ALGOFAM_AES, CRYPTO_ALGOFAM_CHACHA, CRYPTO_ALGOFAM_RSA, CRYPTO_ALGOFAM_ED25519, CRYPTO_ALGOFAM_BRAINPOOL, CRYPTO_ALGOFAM_ECCNIST, CRYPTO_ALGOFAM_SECURECOUNTER, CRYPTO_ALGOFAM_RNG, CRYPTO_ALGOFAM_SIPHASH, CRYPTO_ALGOFAM_ECIES, CRYPTO_ALGOFAM_CUSTOM}, set at pre-compile  # Determines the algorithm family used for the crypto service.
        enumeration CryptoPrimitiveAlgorithmMode [1..*]: {CRYPTO_ALGOMODE_NOT_SET, CRYPTO_ALGOMODE_ECB, CRYPTO_ALGOMODE_CBC, CRYPTO_ALGOMODE_CFB, CRYPTO_ALGOMODE_OFB, CRYPTO_ALGOMODE_CTR, CRYPTO_ALGOMODE_GCM, CRYPTO_ALGOMODE_XTS, CRYPTO_ALGOMODE_RSAES_OAEP, CRYPTO_ALGOMODE_RSAES_PKCS1_v1_5, CRYPTO_ALGOMODE_RSASSA_PSS, CRYPTO_ALGOMODE_RSASSA_PKCS1_v1_5, CRYPTO_ALGOMODE_8ROUNDS, CRYPTO_ALGOMODE_12ROUNDS, CRYPTO_ALGOMODE_20ROUNDS, CRYPTO_ALGOMODE_HMAC, CRYPTO_ALGOMODE_CMAC, CRYPTO_ALGOMODE_GMAC, CRYPTO_ALGOMODE_CTRDRBG, CRYPTO_ALGOMODE_SIPHASH_2_4, CRYPTO_ALGOMODE_SIPHASH_4_8, CRYPTO_ALGOMODE_CUSTOM}, set at pre-compile  # Determines the algorithm mode used for the crypto service
        enumeration CryptoPrimitiveService [1..*]: {CRYPTO_MAC_VERIFY, CRYPTO_MAC_GENERATE, CRYPTO_SIGNATURE_VERIFY, CRYPTO_SIGNATURE_GENERATE, CRYPTO_ENCRYPT, CRYPTO_DECRYPT, CRYPTO_AEADENCRYPT, CRYPTO_AEADDECRYPT, CRYPTO_HASH, CRYPTO_RANDOM}, set at pre-compile  # Determines the crypto service used for defining the capabilities
        enumeration CryptoPrimitiveAlgorithmSecondaryFamily [1..*]: {CRYPTO_ALGOFAM_NOT_SET, CRYPTO_ALGOFAM_SHA1, CRYPTO_ALGOFAM_SHA2_224, CRYPTO_ALGOFAM_SHA2_256, CRYPTO_ALGOFAM_SHA2_384, CRYPTO_ALGOFAM_SHA2_512, CRYPTO_ALGOFAM_SHA2_512_224, CRYPTO_ALGOFAM_SHA2_512_256, CRYPTO_ALGOFAM_SHA3_224, CRYPTO_ALGOFAM_SHA3_256, CRYPTO_ALGOFAM_SHA3_384, CRYPTO_ALGOFAM_SHA3_512, CRYPTO_ALGOFAM_SHAKE128, CRYPTO_ALGOFAM_SHAKE256, CRYPTO_ALGOFAM_RIPEMD160, CRYPTO_ALGOFAM_BLAKE_1_256, CRYPTO_ALGOFAM_BLAKE_1_512, CRYPTO_ALGOFAM_BLAKE_2s_256, CRYPTO_ALGOFAM_BLAKE_2s_512, CRYPTO_ALGOFAM_3DES, CRYPTO_ALGOFAM_AES, CRYPTO_ALGOFAM_CHACHA, CRYPTO_ALGOFAM_RSA, CRYPTO_ALGOFAM_ED25519, CRYPTO_ALGOFAM_BRAINPOOL, CRYPTO_ALGOFAM_ECCNIST, CRYPTO_ALGOFAM_SECURECOUNTER, CRYPTO_ALGOFAM_RNG, CRYPTO_ALGOFAM_SIPHASH, CRYPTO_ALGOFAM_ECIES, CRYPTO_ALGOFAM_CUSTOM}, set at pre-compile  # Determines the algorithm secondary family used for the crypto service
  module config Crypto_Pre: definition=Crypto
    CryptoPrimitives
      14 x CryptoPrimitive, all with CryptoPrimitiveAlgorithmSecondaryFamily=CRYPTO_ALGOFAM_NOT_SET:
        AesGCMEncrypt: CryptoPrimitiveAlgorithmMode=CRYPTO_ALGOMODE_GCM, CryptoPrimitiveService=CRYPTO_AEADENCRYPT, CryptoPrimitiveAlgorithmFamily=CRYPTO_ALGOFAM_AES
        AesGCMDecrypt: CryptoPrimitiveAlgorithmMode=CRYPTO_ALGOMODE_GCM, CryptoPrimitiveService=CRYPTO_AEADDECRYPT, CryptoPrimitiveAlgorithmFamily=CRYPTO_ALGOFAM_AES
        AesEncrypt: CryptoPrimitiveAlgorithmMode=CRYPTO_ALGOMODE_ECB, CryptoPrimitiveService=CRYPTO_ENCRYPT, CryptoPrimitiveAlgorithmFamily=CRYPTO_ALGOFAM_AES, CryptoPrimitiveAlgorithmMode=CRYPTO_ALGOMODE_CBC
        AesDecrypt: CryptoPrimitiveAlgorithmMode=CRYPTO_ALGOMODE_ECB, CryptoPrimitiveService=CRYPTO_DECRYPT, CryptoPrimitiveAlgorithmFamily=CRYPTO_ALGOFAM_AES, CryptoPrimitiveAlgorithmMode=CRYPTO_ALGOMODE_CBC
        SHA1: CryptoPrimitiveAlgorithmMode=CRYPTO_ALGOMODE_NOT_SET, CryptoPrimitiveService=CRYPTO_HASH, CryptoPrimitiveAlgorithmFamily=CRYPTO_ALGOFAM_SHA1
        SHA256: CryptoPrimitiveAlgorithmMode=CRYPTO_ALGOMODE_NOT_SET, CryptoPrimitiveService=CRYPTO_HASH, CryptoPrimitiveAlgorithmFamily=CRYPTO_ALGOFAM_SHA2_256
        SHA512: CryptoPrimitiveAlgorithmMode=CRYPTO_ALGOMODE_NOT_SET, CryptoPrimitiveService=CRYPTO_HASH, CryptoPrimitiveAlgorithmFamily=CRYPTO_ALGOFAM_SHA2_512
        AesCmacGenerate: CryptoPrimitiveAlgorithmMode=CRYPTO_ALGOMODE_CMAC, CryptoPrimitiveService=CRYPTO_MAC_GENERATE, CryptoPrimitiveAlgorithmFamily=CRYPTO_ALGOFAM_AES
        AesCmacVerify: CryptoPrimitiveAlgorithmMode=CRYPTO_ALGOMODE_CMAC, CryptoPrimitiveService=CRYPTO_MAC_VERIFY, CryptoPrimitiveAlgorithmFamily=CRYPTO_ALGOFAM_AES
        RngFips186: CryptoPrimitiveAlgorithmMode=CRYPTO_ALGOMODE_NOT_SET, CryptoPrimitiveService=CRYPTO_RANDOM, CryptoPrimitiveAlgorithmFamily=CRYPTO_ALGOFAM_RNG
        EcDsaGenerate: CryptoPrimitiveAlgorithmMode=CRYPTO_ALGOMODE_NOT_SET, CryptoPrimitiveService=CRYPTO_SIGNATURE_GENERATE, CryptoPrimitiveAlgorithmFamily=CRYPTO_ALGOFAM_ED25519, CryptoPrimitiveAlgorithmSecondaryFamily=CRYPTO_ALGOFAM_SHA2_512
        EcDsaVerify: CryptoPrimitiveAlgorithmMode=CRYPTO_ALGOMODE_NOT_SET, CryptoPrimitiveService=CRYPTO_SIGNATURE_VERIFY, CryptoPrimitiveAlgorithmFamily=CRYPTO_ALGOFAM_ED25519, CryptoPrimitiveAlgorithmSecondaryFamily=CRYPTO_ALGOFAM_SHA2_512
        SipHashGenerate: CryptoPrimitiveService=CRYPTO_MAC_GENERATE, CryptoPrimitiveAlgorithmFamily=CRYPTO_ALGOFAM_SIPHASH, CryptoPrimitiveAlgorithmMode=CRYPTO_ALGOMODE_SIPHASH_2_4
        SipHashVerify: CryptoPrimitiveService=CRYPTO_MAC_VERIFY, CryptoPrimitiveAlgorithmFamily=CRYPTO_ALGOFAM_SIPHASH, CryptoPrimitiveAlgorithmMode=CRYPTO_ALGOMODE_SIPHASH_2_4
    CryptoKeyTypes
      8 x CryptoKeyType:
        Cipher: CryptoKeyElementRef=Crypto_30_LibCv_Cipher_Key, CryptoKeyElementRef=Crypto_30_LibCv_Cipher_IV, CryptoKeyElementRef=Crypto_30_LibCv_Cipher_Proof, CryptoKeyElementRef=Crypto_30_LibCv_Cipher_2ndKey
        KeyExchange_X25519: CryptoKeyElementRef=Crypto_30_LibCv_KeyExchange_Algorithm_X25519, CryptoKeyElementRef=Crypto_30_LibCv_KeyExchange_OwnPubKey, CryptoKeyElementRef=Crypto_30_LibCv_KeyExchange_Base, CryptoKeyElementRef=Crypto_30_LibCv_KeyExchange_PrivKey, CryptoKeyElementRef=Crypto_30_LibCv_KeyExchange_SharedValue
        KeyGenerate: CryptoKeyElementRef=Crypto_30_LibCv_KeyGenerate_Algorithm, CryptoKeyElementRef=Crypto_30_LibCv_KeyGenerate_Seed, CryptoKeyElementRef=Crypto_30_LibCv_KeyGenerate_Key
        Signature: CryptoKeyElementRef=Crypto_30_LibCv_Signature_Key
        Mac: CryptoKeyElementRef=Crypto_30_LibCv_Mac_Key, CryptoKeyElementRef=Crypto_30_LibCv_Mac_Proof
        KeyDerive: CryptoKeyElementRef=Crypto_30_LibCv_KeyDerivation_Password, CryptoKeyElementRef=Crypto_30_LibCv_KeyDerive_Algorithm, CryptoKeyElementRef=Crypto_30_LibCv_KeyDerivation_Salt
        Random_Fips186: CryptoKeyElementRef=Crypto_30_LibCv_Random_Algorithm_Fips186, CryptoKeyElementRef=Crypto_30_LibCv_Random_Seed, CryptoKeyElementRef=Crypto_30_LibCv_Random_Data
        Hash: CryptoKeyElementRef=Crypto_30_LibCv_Hash_Result
    CryptoGeneral
    CryptoKeyElements
      22 x CryptoKeyElement:
        Crypto_30_LibCv_Signature_Key: CryptoKeyElementId=1
        Crypto_30_LibCv_Random_Seed: CryptoKeyElementId=3
        Crypto_30_LibCv_Random_Data: CryptoKeyElementId=1
        Crypto_30_LibCv_KeyGenerate_Seed: CryptoKeyElementId=16
        Crypto_30_LibCv_KeyGenerate_Key: CryptoKeyElementId=1
        Crypto_30_LibCv_KeyExchange_SharedValue: CryptoKeyElementId=1
        Crypto_30_LibCv_KeyExchange_PrivKey: CryptoKeyElementId=9
        Crypto_30_LibCv_Mac_Proof: CryptoKeyElementId=2
        Crypto_30_LibCv_KeyDerivation_Salt: CryptoKeyElementId=13
        Crypto_30_LibCv_KeyExchange_OwnPubKey: CryptoKeyElementId=10
        Crypto_30_LibCv_KeyExchange_Base: CryptoKeyElementId=8
        Crypto_30_LibCv_KeyDerivation_Password: CryptoKeyElementId=1
        Crypto_30_LibCv_Cipher_Key: CryptoKeyElementId=1
        Crypto_30_LibCv_Cipher_IV: CryptoKeyElementId=5
        Crypto_30_LibCv_Cipher_Proof: CryptoKeyElementId=2
        Crypto_30_LibCv_Cipher_2ndKey: CryptoKeyElementId=6
        Crypto_30_LibCv_Mac_Key: CryptoKeyElementId=1
        Crypto_30_LibCv_Hash_Result: CryptoKeyElementId=1
        Crypto_30_LibCv_KeyDerive_Algorithm: CryptoKeyElementId=15, CryptoKeyElementInitValue=0x00, CryptoKeyElementSize=1
        Crypto_30_LibCv_KeyGenerate_Algorithm: CryptoKeyElementId=17, CryptoKeyElementInitValue=0x00, CryptoKeyElementSize=1
        Crypto_30_LibCv_KeyExchange_Algorithm_X25519: CryptoKeyElementId=12, CryptoKeyElementInitValue=0x00, CryptoKeyElementSize=1
        Crypto_30_LibCv_Random_Algorithm_Fips186: CryptoKeyElementId=4, CryptoKeyElementInitValue=0x00, CryptoKeyElementSize=1  # 4
  module config Crypto_Rec: definition=Crypto
    CryptoKeyElements
      24 x CryptoKeyElement:
        Crypto_30_LibCv_Signature_Key: CryptoKeyElementSize=32
        Crypto_30_LibCv_Random_Seed: CryptoKeyElementSize=20
        Crypto_30_LibCv_Random_Data: CryptoKeyElementSize=20
        Crypto_30_LibCv_KeyGenerate_Seed: CryptoKeyElementSize=16
        Crypto_30_LibCv_KeyGenerate_Key: CryptoKeyElementSize=16
        Crypto_30_LibCv_KeyExchange_SharedValue: CryptoKeyElementSize=32
        Crypto_30_LibCv_KeyExchange_PrivKey: CryptoKeyElementSize=32
        Crypto_30_LibCv_Mac_Proof: CryptoKeyElementSize=48
        Crypto_30_LibCv_KeyDerivation_Salt: CryptoKeyElementSize=16
        Crypto_30_LibCv_KeyExchange_PartnerPubKey: CryptoKeyElementSize=32
        Crypto_30_LibCv_KeyExchange_OwnPubKey: CryptoKeyElementSize=32
        Crypto_30_LibCv_KeyExchange_Base: CryptoKeyElementSize=16
        Crypto_30_LibCv_KeyDerivation_Password: CryptoKeyElementSize=16
        Crypto_30_LibCv_KeyDerivation_DerivedKey: CryptoKeyElementSize=16
        Crypto_30_LibCv_Cipher_Key: CryptoKeyElementSize=16
        Crypto_30_LibCv_Cipher_IV: CryptoKeyElementSize=16
        Crypto_30_LibCv_Cipher_Proof: CryptoKeyElementSize=48
        Crypto_30_LibCv_Cipher_2ndKey: CryptoKeyElementSize=16
        Crypto_30_LibCv_Mac_Key: CryptoKeyElementSize=16
        Crypto_30_LibCv_Hash_Result: CryptoKeyElementSize=20
        Crypto_30_LibCv_KeyDerive_Algorithm
        Crypto_30_LibCv_KeyGenerate_Algorithm
        Crypto_30_LibCv_KeyExchange_Algorithm_X25519
        Crypto_30_LibCv_Random_Algorithm_Fips186  # 4
    CryptoKeyTypes
    CryptoDriverObjects
      Crypto_30_LibCv (CryptoDriverObject): CryptoDriverObjectId=1, CryptoDriverObjectQueueSize=1
