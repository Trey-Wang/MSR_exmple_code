AUTOSAR XML (schema 4-3-0)
package /MICROSAR
  module definition vIpcMemCp [0..1]: category=VENDOR_SPECIFIC_MODULE_DEFINITION, variants pre-compile/post-build  # Configuration of the vIpcMemCp (Vector interprocessor communication via shared memory for classic AUTOSAR) module.
    container vIpcMemCpConfig: multiplicity set at pre-compile  # This container contains the global configuration parameter of the vIpcMemCp. It is a MultipleConfigurationContainer, i.e. this container and its sub-containers exit once per configuration set.
      container vIpcMemCpRxChannel [0..*]: multiplicity set at post-build in variant post-build / pre-compile in variant pre-compile  # Rx channel specific configuration parameters of the vIpcMemCp.
        integer vIpcMemCpRxChannelId: 0..65535, multiplicity set at pre-compile, origin=Vector Informatik, set at post-build in variant post-build / pre-compile in variant pre-compile, default-value=0  # This value specifies the unique channel index value beginning with 0.
        string vIpcMemCpRxStartAddress: multiplicity set at pre-compile, origin=Vector Informatik, set at post-build in variant post-build / pre-compile in variant pre-compile  # This parameter defines the start address of the channel buffer. The address can be specified either as a valid decimal (1024) or hexadecimal (0x4000) value, or as a valid linker symbol. Caution: The start address must be 4 bytes aligned. Note: If an external symbol is configured, the file containing the declaration of the symbol has to be added to vIpcMemCpIncludeFiles.
        integer vIpcMemCpRxBufferSize: 32..4294967295, multiplicity set at pre-compile, origin=Vector Informatik, set at post-build in variant post-build / pre-compile in variant pre-compile, default-value=32  # This value specifies the size of the channel buffer in bytes. ATTENTION: The configured size will not be fully usable for payload data due to overhead. 20 bytes are used to store the buffer control structure statically. 4 bytes are used for each message stored in the buffer. This has to be considered during configuration.
        reference vIpcMemCpRxPduRef: multiplicity set at pre-compile, origin=Vector Informatik, set at post-build in variant post-build / pre-compile in variant pre-compile, destination=Pdu  # Reference to a PDU in the global PDU collection.
      container vIpcMemCpTxChannel [0..*]: multiplicity set at post-build in variant post-build / pre-compile in variant pre-compile  # Tx channel specific configuration parameters of the vIpcMemCp.
        integer vIpcMemCpTxChannelId: 0..65535, multiplicity set at pre-compile, origin=Vector Informatik, set at post-build in variant post-build / pre-compile in variant pre-compile, default-value=0  # This value specifies the unique channel index value beginning with 0.
        string vIpcMemCpTxStartAddress: multiplicity set at pre-compile, origin=Vector Informatik, set at post-build in variant post-build / pre-compile in variant pre-compile  # This parameter defines the start address of the channel buffer. The address can be specified either as a valid decimal (1024) or hexadecimal (0x4000) value, or as a valid linker symbol. Caution: The start address must be 4 bytes aligned. Note: If an external symbol is configured, the file containing the declaration of the symbol has to be added to vIpcMemCpIncludeFiles.
        integer vIpcMemCpTxBufferSize: 32..4294967295, multiplicity set at pre-compile, origin=Vector Informatik, set at post-build in variant post-build / pre-compile in variant pre-compile, default-value=32  # This value specifies the size of the channel buffer in bytes. ATTENTION: The configured size will not be fully usable for payload data due to overhead. 20 bytes are used to store the buffer control structure statically. 4 bytes are used for each message stored in the buffer. This has to be considered during configuration.
        reference vIpcMemCpTxPduRef: multiplicity set at pre-compile, origin=Vector Informatik, set at post-build in variant post-build / pre-compile in variant pre-compile, destination=Pdu  # Reference to a PDU in the global PDU collection.
    container vIpcMemCpGeneral: multiplicity set at pre-compile  # General configuration parameters of the vIpcMemCp.
      boolean vIpcMemCpDevErrorDetect: multiplicity set at pre-compile, origin=Vector Informatik, set at pre-compile, default-value=true  # This parameter switches the Development Error Detection and Notification ON or OFF. true: Development error detection is enabled. false: Development error detection is disabled. Note: In general, the development error detection is recommended during pre-test phase. It is not recommended to enable the development error detection in production code due to increased runtime and ROM needs.
      string vIpcMemCpIncludeFiles [0..*]: multiplicity set at pre-compile, origin=Vector Informatik, set at pre-compile  # This parameter defines the include file(s) which contains the declarations of external symbols used for channel start addresses. Insert complete filenames including extension (e.g. MyHeader.h).
      integer vIpcMemCpMinimumDataCopySize: 1..4294967295, multiplicity set at pre-compile, origin=Vector Informatik, set at pre-compile, default-value=8  # This value specifies the minimum data size which can be copied without segmentation in bytes.
      boolean vIpcMemCpSafeBswChecks: multiplicity set at pre-compile, origin=Vector Informatik, set at pre-compile, default-value=false  # Selects whether safety checks are used. These checks improve robustness as e.g. invalid parameter values are detected before a function is executed. This attribute has to be enabled for safety projects where this component is mapped to an ASIL partition.
      string vIpcMemCpUserConfigFile [0..1]: multiplicity set at pre-compile, origin=Vector Informatik, set at pre-compile, default-value=vIpcMemCp_UserCfg.h  # Reference to an external text file that will be included during generation to vIpcMemCp_Cfg.h. The content of the user configuration file will be added at the end of the generated module configuration file and allows altering or extending the generated code. Caution: User configuration files can cause the software module to malfunction and must only be used with great care!
      boolean vIpcMemCpVersionInfoApi: multiplicity set at pre-compile, origin=Vector Informatik, set at pre-compile, default-value=false  # This parameter enables/disables the function vIpcMemCp_GetVersionInfo() to get major, minor and patch version information.
  bsw implementation vIpcMemCp_Impl: programming-language=C, sw-version=1.01.00, used-code-generator=DaVinci Configurator, vendor-id=30, ar-release-version=4.03.00, behavior=vIpcMemCpBehavior, preconfigured-configuration=vIpcMemCp_Pre, recommended-configuration=vIpcMemCp_Rec, vendor-specific-module-def=vIpcMemCp
  module config vIpcMemCp_Pre: definition=vIpcMemCp
  module config vIpcMemCp_Rec: definition=vIpcMemCp
