AUTOSAR XML (schema 4-1-3)
package /MICROSAR
  module definition J1939Rm [0..1]: category=VENDOR_SPECIFIC_MODULE_DEFINITION, refined-module-def=J1939Rm, variants post-build-loadable/pre-compile/post-build-selectable  # Configuration of the J1939Rm (SAE J1939 Request Manager) module.
    container J1939RmConfigSet  # Configuration parameters and sub containers of the J1939Rm module.
      container J1939RmChannel [1..*]  # Contains the parameters for a CAN channel supported by the J1939 Request Manager.
        integer J1939RmAckQueueSize: 0..255, set at post-build in variant post-build-loadable+post-build-selectable / pre-compile in variant pre-compile, default-value=10  # Number of Acknowledgement messages that can be stored for later transmission. When set to 0, only one Acknowledgement message can be transmitted at any time.
        integer J1939RmRequestQueueSize: 0..255, set at post-build in variant post-build-loadable+post-build-selectable / pre-compile in variant pre-compile, default-value=10  # Number of Request messages that can be stored for later transmission. When set to 0, only one Request message can be transmitted at any time.
        integer J1939RmRequestTimeoutMonitors: 0..255, set at pre-compile, default-value=10  # Number of transmitted requests that can be monitored for timeout. Please note: This feature is not yet supported.
        boolean J1939RmIsobusChannel [0..1]: set at post-build in variant post-build-loadable+post-build-selectable / pre-compile in variant pre-compile, origin=Vector Informatik, default-value=false  # ISOBUS Channel | Identifies this channel as an ISOBUS (ISO 11873) channel. If enabled, the handling of the Acknowledge (ACKM) message conforms with ISO 11783, otherwise with SAE J1939. In contrast to J1939, which uses the AddressAcknowledged field (and corresponding fields for the other acknowledgement types), ISO 11783 uses the destination address of the ACKM message to identify the node which originated the acknowledged action.
        integer J1939RmRequest2QueueSize: 0..255, set at post-build in variant post-build-loadable+post-build-selectable / pre-compile in variant pre-compile, origin=Vector Informatik, default-value=10  # Number of Request2 messages that can be stored for later transmission. When set to 0, only one Request2 message can be transmitted at any time.
        symbolic name reference J1939RmComMNetworkHandleRef: set at post-build in variant post-build-loadable+post-build-selectable / pre-compile in variant pre-compile, destination=ComMChannel  # ComM Network Handle Ref | Reference to the channel defined by the ComMChannel providing access to the unique channel index ComMChannelId.
        container J1939RmAckmRxPdu [0..1]: post-build-changeable=true  # ACKM Rx Pdu | Contains the configuration of the I-PDU used to receive the Acknowledgement PG.
          integer J1939RmAckmRxPduId: 0..65535, scope=ECU, set at pre-compile, symbolic-name-value=true, default-value=0  # ACKM Rx Pdu ID | The I-PDU identifier used for RxIndication from PduR.
          reference J1939RmAckmRxPduRef: set at post-build in variant post-build-loadable+post-build-selectable / pre-compile in variant pre-compile, destination=Pdu  # ACKM Rx Pdu Ref | Reference to the Pdu object representing the I-PDU.
        container J1939RmAckmTxPdu [0..1]  # ACKM Tx Pdu | Contains the configuration of the I-PDU used to transmit the Acknowledgement PG.
          integer J1939RmAckmTxPduId: 0..65535, scope=ECU, set at pre-compile, symbolic-name-value=true, default-value=0  # ACKM Tx Pdu ID | The I-PDU identifier used for TxConfirmation from PduR.
          reference J1939RmAckmTxPduRef: set at post-build in variant post-build-loadable+post-build-selectable / pre-compile in variant pre-compile, destination=Pdu  # ACKM Tx Pdu Ref | Reference to the Pdu object representing the I-PDU.
        container J1939RmRqstRxPdu [0..1]  # RQST Rx Pdu | Contains the configuration of the I-PDU used to receive the Request PG.
          integer J1939RmRqstRxPduId: 0..65535, scope=ECU, set at pre-compile, symbolic-name-value=true, default-value=0  # RQST Rx Pdu ID | The I-PDU identifier used for RxIndication from PduR.
          reference J1939RmRqstRxPduRef: set at post-build in variant post-build-loadable+post-build-selectable / pre-compile in variant pre-compile, destination=Pdu  # RQST Rx Pdu Ref | Reference to the Pdu object representing the I-PDU.
        container J1939RmRqstTxPdu [0..1]: post-build-changeable=true  # RQST Tx Pdu | Contains the configuration of the I-PDU used to transmit the Request PG.
          integer J1939RmRqstTxPduId: 0..65535, scope=ECU, set at pre-compile, symbolic-name-value=true, default-value=0  # RQST Tx Pdu ID | The I-PDU identifier used for TxConfirmation from PduR.
          reference J1939RmRqstTxPduRef: set at post-build in variant post-build-loadable+post-build-selectable / pre-compile in variant pre-compile, destination=Pdu  # RQST Tx Pdu Ref | Reference to the Pdu object representing the I-PDU.
        container J1939RmRqst2RxPdu [0..1]: post-build-changeable=true  # RQST2 Rx Pdu | Contains the configuration of the I-PDU used to receive the Request2 PG.
          integer J1939RmRqst2RxPduId: 0..65535, scope=ECU, set at pre-compile, origin=Vector Informatik, symbolic-name-value=true, default-value=0  # RQST2 Rx Pdu ID | The I-PDU identifier used for RxIndication from PduR.
          reference J1939RmRqst2RxPduRef: set at post-build in variant post-build-loadable+post-build-selectable / pre-compile in variant pre-compile, origin=Vector Informatik, destination=Pdu  # RQST2 Rx Pdu Ref | Reference to the Pdu object representing the I-PDU.
        container J1939RmRqst2TxPdu [0..1]: post-build-changeable=true  # RQST2 Tx Pdu | Contains the configuration of the I-PDU used to transmit the Request2 PG.
          integer J1939RmRqst2TxPduId: 0..65535, scope=ECU, set at pre-compile, origin=Vector Informatik, symbolic-name-value=true, default-value=0  # RQST2 Tx Pdu ID | The I-PDU identifier used for TxConfirmation from PduR.
          reference J1939RmRqst2TxPduRef: set at post-build in variant post-build-loadable+post-build-selectable / pre-compile in variant pre-compile, origin=Vector Informatik, destination=Pdu  # RQST2 Tx Pdu Ref | Reference to the Pdu object representing the I-PDU.
      container J1939RmNode [1..*]  # Contains the parameters for the support of a logical J1939 node (identified by an ECU address).
        reference J1939RmNodeChannelRef [1..*]: set at pre-compile, destination=J1939RmChannel  # Channel Ref | Reference to the channels this node has access to.
        symbolic name reference J1939RmNmNodeRef: set at pre-compile, destination=J1939NmNode  # J1939Nm Node Ref | Reference to the corresponding J1939Nm node.
        container J1939RmUser [1..*]: post-build-changeable=true  # Contains the configuration of a module that uses the request and acknowledgement interfaces of J1939Rm.
          boolean J1939RmUserAckIndication: set at post-build in variant post-build-loadable+post-build-selectable / pre-compile in variant pre-compile, default-value=false  # Ack Indication | Enable AckIndication for this module. In case of CDD, the name is <apiServicePrefix>_AckIndication. In case of RTE, the operation AckIndication of the required port J1939Rm_AckIndication_{user} is called. This parameter shall not be set for J1939RmUserType J1939RM_USER_J1939NM, J1939RM_USER_J1939DCM, or J1939RM_USER_COM.
          integer J1939RmUserId [0..1]: 0..65535, scope=ECU, set at pre-compile, symbolic-name-value=true, default-value=0  # Identifier used by a module using J1939Rm. This parameter is only required when the module uses transmission of requests.
          integer J1939RmUserPGN [0..*]: 0..262143, set at post-build in variant post-build-loadable+post-build-selectable / pre-compile in variant pre-compile, default-value=65535  # Request PGN | PGN supported to be requested from this module. The PGNs supported by different modules should usually be disjunctive. This parameter is predefined to AC (0x0EE00) and NM (0x9300) for J1939RmUserType J1939RM_USER_J1939NM and is derived from the J1939Dcm PDUs in the system description for J1939RmUserType J1939RM_USER_J1939DCM. It shall not be set for J1939RmUserType J1939RM_USER_COM.
          boolean J1939RmUserRequestIndication: set at post-build in variant post-build-loadable+post-build-selectable / pre-compile in variant pre-compile, default-value=false  # Request Indication | Enable RequestIndication for this module. In case of J1939Nm or J1939Dcm, the name is fixed. In case of CDD, the name is <apiServicePrefix>_RequestIndication. In case of RTE, J1939Rm will call the operation RequestIndication of the required port J1939Rm_RequestIndication_{user}. This parameter shall not be set for J1939RmUserType J1939RM_USER_COM.
          boolean J1939RmUserSendAck: set at post-build in variant post-build-loadable+post-build-selectable / pre-compile in variant pre-compile, default-value=false  # Send Ack | Enable the SendAck API for this module. In case of RTE, the operation SendAck of the provided port J1939Rm_SendAck_{user} is called. This parameter shall not be set for J1939RmUserType J1939RM_USER_J1939NM or J1939RM_USER_COM.
          boolean J1939RmUserSendRequest: set at post-build in variant post-build-loadable+post-build-selectable / pre-compile in variant pre-compile, default-value=false  # Send Request | Enable the SendRequest API for this module. In case of RTE, the operation SendRequest of the provided port J1939Rm_SendRequest_{user} is called. This parameter shall not be set for J1939RmUserType J1939RM_USER_J1939NM, J1939RM_USER_J1939DCM, or J1939RM_USER_COM.
          boolean J1939RmUserTimeoutSupervision: set at pre-compile, default-value=false  # Timeout Supervision | Enable RequestTimeoutIndication and CancelRequestTimeout for this module. RequestTimeoutIndication: In case of CDD, the name is <apiServicePrefix>_RequestTimeoutIndication. In case of RTE, the operation RequestTimeoutIndication of the required port J1939Rm_RequestTimeoutIndication_{user} is called. CancelRequestTimeout: In case of RTE, the operation CancelRequestTimeout of the provided port J1939Rm_CancelRequestTimeout_{user} is called. This parameter shall not be set for J1939RmUserType J1939RM_USER_J1939NM, J1939RM_USER_J1939DCM, or J1939RM_USER_COM. Please note: This feature is not yet supported.
          enumeration J1939RmUserType: set at pre-compile, default-value=J1939RM_USER_CDD  # Type of module using J1939Rm. J1939RM_USER_COM: Represents the COM module, and can be used to directly trigger transmission of messages configured for transmission by COM. Supported messages are configured using J1939RmComIPdu containers, Request PGN and Ack PGN are not used. J1939RM_USER_J1939DCM: Represents the J1939 Diagnotic Communication Manager. Supported diagnostic messages are configured using Request PGN, J1939RmComIPdu containers and Ack PGN are not used. J1939RM_USER_J1939NM: Represents the J1939 Network Management module. Only the AC (0xEE00) and NM (0x9300) messages are supported and configured using Request PGN, J1939RmComIPdu containers and Ack PGN are not used. J1939RM_USER_CDD: Represents a complex driver (CDD). Supported messages are configured using Request PGN and Ack PGN, J1939RmComIPdu containers are not used. J1939RM_USER_RTE: Represents an SW-C located above the RTE. Supported messages are configured using Request PGN and Ack PGN, J1939RmComIPdu containers are not used.
            J1939RM_USER_COM  # Represents the COM module.
            J1939RM_USER_J1939DCM  # Represents the J1939 Diagnotic Communication Manager.
            J1939RM_USER_J1939NM  # Represents the J1939 Network Management module.
            J1939RM_USER_CDD  # Represents a complex driver (CDD).
            J1939RM_USER_RTE  # Represents an SW-C located above the RTE.
          integer J1939RmUserAckPGN [0..*]: 0..262143, set at post-build in variant post-build-loadable+post-build-selectable / pre-compile in variant pre-compile, default-value=65535  # Ack PGN | PGN supported to be acknowledged to this module. The PGNs supported by different modules should usually be disjunctive. This parameter shall not be set for J1939RmUserType J1939RM_USER_J1939NM, J1939RM_USER_J1939DCM, and J1939RM_USER_COM.
          foreign reference J1939RmUserCddRef [0..1]: set at pre-compile, destination-type=ECUC-MODULE-CONFIGURATION-VALUES  # CDD Ref | Reference to CDD module. This parameter is only required for J1939RmUserType J1939RM_USER_CDD.
          container J1939RmComIPdu [0..*]: post-build-changeable=true  # COM I-Pdu | Contains the configuration of an I-PDU that is to be transmitted on request by COM. This configuration container is only relevant for J1939RmUserType J1939RM_USER_COM.
            integer J1939RmComIPduPGN: 0..262143, set at post-build in variant post-build-loadable+post-build-selectable / pre-compile in variant pre-compile, default-value=65535  # PGN | PGN of the COM I-PDU.
            integer J1939RmComIPduExtId{1..3} [0..1]: 0..255, set at post-build in variant post-build-loadable+post-build-selectable / pre-compile in variant pre-compile, origin=Vector Informatik, default-value=0  # Extended ID Byte {1..3} | Extended Identifier Byte {1..3} of the COM I-PDU. Only relevant for multiplexed PDUs which are requested using Request2.
            symbolic name reference J1939RmComIPduRef: set at post-build in variant post-build-loadable+post-build-selectable / pre-compile in variant pre-compile, destination=ComIPdu  # COM I-Pdu Ref | Reference to the COM I-PDU.
            choice reference J1939RmMultiplexedPduRef [0..1]: set at post-build in variant post-build-loadable+post-build-selectable / pre-compile in variant pre-compile, origin=Vector Informatik, destination=[CanIfTxPduCfg, J1939TpTxNSdu]  # Reference to the multiplexed PDU, which is either a CanIf Tx PDU, or a J1939Tp Tx N-SDU. Only relevant for multiplexed PDUs which are requested using Request2.
    container J1939RmGeneral  # General configuration parameters of the J1939Rm module.
      boolean J1939RmDevErrorDetect: set at pre-compile, default-value=true  # Enables/disables the development error detection. Note: In general, the development error detection is recommended during pre-test phase. It is not recommended to enable the development error detection in production code due to increased runtime and ROM needs.
      float J1939RmMainFunctionPeriod: 0.001..0.255, scope=ECU, set at pre-compile, default-value=0.01  # Execution cycle of J1939Rm_MainFunction.
      boolean J1939RmSupportAckIndication: set at pre-compile, default-value=true  # Enables/disables support of acknowledgement indications.
      boolean J1939RmSupportAckTransmission: set at pre-compile, default-value=true  # Enables/disables support of acknowledgement transmission.
      boolean J1939RmSupportRequestIndication: set at pre-compile, default-value=true  # Enables/disables support of request indications.
      boolean J1939RmSupportRequestTransmission: set at pre-compile, default-value=true  # Enables/disables support of request transmission.
      boolean J1939RmSupportTimeoutSupervision: set at pre-compile, default-value=true  # Enables/disables support of request timeout supervision. Please note: This feature is not yet supported.
      float J1939RmTxConfirmationTimeout: 0..65.535, set at pre-compile, default-value=1.5  # Time to wait for a confirmation after transmission of a message. After this time, TxConfirmation is not expected to be called for the last transmission, and the message is assumed to have been lost.
      boolean J1939RmVersionInfoApi: set at pre-compile, default-value=false  # Version Info API | Enables/disables the function J1939Rm_GetVersionInfo() to get major, minor and patch version information.
      string J1939RmUserConfigurationFile [0..1]: set at pre-compile, origin=Vector Informatik  # Reference to an external user configuration file that will be included during generation. The content of the user configuration file will be added at the end of the generated module configuration file and allows altering or extending the generated code. Caution: User configuration files can cause the software module to malfunction and must only be used with great care!
      boolean J1939RmSupportComUser: set at pre-compile, origin=Vector Informatik, default-value=true  # Support COM User | Enables/disables support for COM users.
      boolean J1939RmSupportRequest2: set at pre-compile, origin=Vector Informatik, default-value=false  # Enables/disables support of the Request2 PG.
      boolean J1939RmRuntimeErrorReport: set at pre-compile, origin=Vector Informatik, default-value=true  # Enables/disables the reporting of runtime errors.
  bsw implementation J1939Rm_Impl: programming-language=C, sw-version=2.02.04, used-code-generator=DaVinci Configurator, vendor-id=30, ar-release-version=4.02.02, behavior=J1939RmBehavior, preconfigured-configuration=J1939Rm_Pre, recommended-configuration=J1939Rm_Rec, vendor-specific-module-def=J1939Rm
  module config J1939Rm_Pre: definition=J1939Rm
  module config J1939Rm_Rec: definition=J1939Rm
