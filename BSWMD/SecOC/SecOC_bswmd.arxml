AUTOSAR XML (schema 4-3-0)
package /MICROSAR
  module definition SecOC [0..1]: category=VENDOR_SPECIFIC_MODULE_DEFINITION, post-build-variant-support=true, refined-module-def=SecOC, variants post-build/pre-compile  # Secure Onboard Communication | Configuration of the SecOC (SecureOnboardCommunication) module.
    container SecOCGeneral: multiplicity set at pre-compile  # Contains the general configuration parameters of the SecOC module.
      boolean SecOCDevErrorDetect: multiplicity set at pre-compile, set at pre-compile, default-value=false  # Pre-processor switch for enabling development error detection support. | * true: detection and notification is enabled. * false: detection and notification is disabled.
      boolean SecOCEnableForcedPassOverride: multiplicity set at pre-compile, set at pre-compile, default-value=false  # If SecOCEnableForcedPassOverride is set to true the API SecOC_VerifyStatusOverride accepts the overrideStatus Pass.
      boolean SecOcIgnoreVerificationResult: multiplicity set at pre-compile, set at pre-compile, default-value=false  # If set to true the result of the authentication process (e.g. MAC Verify) is ignored after the first try and the SecOC proceeds like the result was a success. The calculation of the authenticator is still done, only its result will be ignored. | - true: enabled (verification result is ignored). - false: disabled (verification result is NOT ignored).
      float SecOCMainFunctionPeriodRx: 0..0.255, scope=ECU, multiplicity set at pre-compile, set at pre-compile, default-value=0.01  # Allow to configure the time for the MainFunction of the Rx path (as float in seconds).
      float SecOCMainFunctionPeriodTx: 0..0.255, scope=ECU, multiplicity set at pre-compile, set at pre-compile, default-value=0.01  # Allow to configure the time for the MainFunction of the Tx path (as float in seconds).
      string SecOCMaxAlignScalarType: multiplicity set at pre-compile, set at pre-compile  # The scalar type which has the maximum alignment restrictions on the given platform. This type can be e.g. uint8, uint16 or uint32.
      enumeration SecOCQueryFreshnessValue: {CFUNC, RTE}, multiplicity set at pre-compile, set at pre-compile, default-value=CFUNC  # This parameter specifies if the freshness value shall be determined through a C-function (CDD) or a software component (SW-C). RTE The SecOC queries the freshness for every PDU to process using the Rte service port FreshnessManagement CFUNC The SecOC queries the freshness for every PDU to process using C function.
      function name SecOCVerificationStatusCallout [0..*]: multiplicity set at pre-compile, set at pre-compile  # Entry address of the customer specific call out routine which shall be invoked in case of a verification attempt.
      boolean SecOCVersionInfoApi: multiplicity set at pre-compile, set at pre-compile, default-value=false  # If true the SecOC_GetVersionInfo API is available.
      string SecOCUserConfigFile [0..1]: multiplicity set at pre-compile, origin=Vector Informatik, set at pre-compile  # Reference to an external user configuration file that will be included during generation. The content of the user configuration file will be added at the end of the generated module configuration file and allows altering or extending the generated code. Caution: User configuration files can cause the software module to malfunction and must only be used with great care!
      integer SecOCMaxMessageLinkerSizeOfRxPdus: 0..65535, multiplicity set at pre-compile, origin=Vector Informatik, set at pre-compile, default-value=0  # Max byte size of Message Linker used with Rx Secured Collection Pdus.
      boolean SecOCSafeBswChecks: multiplicity set at pre-compile, origin=Vector Informatik, set at pre-compile, default-value=false  # Selects if safety checks are used. These checks improve robustness as e.g. invalid parameters are checked before function is executed. This attribute has to be enabled for safety projects where this component is mapped to an ASIL partition.
      boolean SecOCPropagateOnlyFinalVerificationStatus: multiplicity set at pre-compile, origin=Vector Informatik, set at pre-compile, default-value=false  # If enabled only the final verification result will be propagated.
      boolean SecOCEnableDevelopmentMode: multiplicity set at pre-compile, origin=Vector Informatik, set at pre-compile, default-value=false  # If the Development Mode is enabled the API SecOC_SetDevelopmentMode(True/False) is available. If the Development Mode is started with the API SecOC_SetDevelopmentMode(True) all received Pdus will be forwared to the Upper Layer, even if the verifcation fails.
      boolean SecOCUseGetRxFreshness: multiplicity set at pre-compile, origin=Vector Informatik, set at pre-compile, default-value=false  # This parameter enables the useage of the GetRxFreshness API.
      boolean SecOCUseGetRxFreshnessAuthData: multiplicity set at pre-compile, origin=Vector Informatik, set at pre-compile, default-value=false  # This parameter enables the useage of the GetRxFreshnessAuthData API.
      boolean SecOCUseGetTxFreshness: multiplicity set at pre-compile, origin=Vector Informatik, set at pre-compile, default-value=false  # This parameter enables the useage of the GetTxFreshness API.
      boolean SecOCUseGetTxFreshnessTruncData: multiplicity set at pre-compile, origin=Vector Informatik, set at pre-compile, default-value=false  # This parameter enables the useage of the GetTxFreshnessTruncData API.
      boolean SecOCUseSPduTxConfirmation: multiplicity set at pre-compile, origin=Vector Informatik, set at pre-compile, default-value=false  # This parameter enables the useage of the SPduTxConfirmation API.
    container SecOCGeneration: multiplicity set at pre-compile  # Contains the generation configuration parameters of the module SecOC.
      enumeration SecOCOutOfBoundsWriteProtectionStrategy: multiplicity set at pre-compile, origin=Vector Informatik, set at pre-compile, default-value=NONE  # This parameter is used to configure a strategy to protect the code to write out of bounds. NONE: no protection strategy is generated in the data access. INDEX_SATURATION: arrays are blown up and the data access index is saturated by an appropriate mask. The advantage is the speed of the data access, but own data elements at other indexes of the same variable can be overridden. INDEX_CHECKING: the data access index is validated by a runtime check. The advantage is that values are never written to incorrect indexes of the data access.
        NONE  # none
        INDEX_SATURATION  # index saturation
        INDEX_CHECKING  # index checking
      boolean SecOCOutOfBoundsWriteSanitizer: multiplicity set at pre-compile, origin=Vector Informatik, set at pre-compile, default-value=false  # This parameter activates/deactivates the generation of runtime checks which call a DET error notification function to find easily out of bounds write problems. FALSE: no checks are generated in the data access. TRUE: the data access is enriched with DET checks to validate indexes.
      boolean SecOCOutOfBoundsReadSanitizer: multiplicity set at pre-compile, origin=Vector Informatik, set at pre-compile, default-value=false  # This parameter activates/deactivates the generation of runtime checks which call a DET error notification function to find easily out of bounds read problems. FALSE: no checks are generated in the data access. TRUE: the data access is enriched with DET checks to validate indexes.
      boolean SecOCShortSymbols: multiplicity set at pre-compile, origin=Vector Informatik, set at pre-compile, default-value=false  # This parameter activates/deactivates the capability to generate shortened symbol names. FALSE: symbol names are generated in a human readable style based on the MIP, tags and variant names. TRUE: symbol names are generated based on the MIP and a CRC32.
      boolean SecOCInterfacesForDeactivatedData: multiplicity set at pre-compile, origin=Vector Informatik, set at pre-compile, default-value=false  # This parameter activates/deactivates the capability to generate bsw data interfaces for deactivated data elements. This is an advantage for the BSW developer to reduce the time to market with a development environment using auto completition and to investigate potential interfaces. FALSE: data interfaces are not generated if the data elementis deactivated. TRUE: data interfaces are generated as e.g. emty macros.
      boolean SecOCReferringKeysInComments: multiplicity set at pre-compile, origin=Vector Informatik, set at pre-compile, default-value=false  # This parameter activates/deactivates the capability to generate referring keys in comments. This is an advantage for the developer to investigate indirections, but this feature reduces the overall readability of the generated data. FALSE: referring keys are not generated in comments. TRUE: referring keys are generated in comments.
    container SecOCRxPduProcessing [0..*]: multiplicity set at post-build in variant post-build / pre-compile in variant pre-compile, post-build-variant-multiplicity=true  # Contains the parameters to configure the RxPdus to be verified by the SecOC module.
      integer SecOCAuthDataFreshnessLen [0..1]: 0..65535, scope=ECU, multiplicity set at post-build in variant post-build / pre-compile in variant pre-compile, set at post-build in variant post-build / pre-compile in variant pre-compile  # The length of the external authentic PDU data in bits (uint16).
      integer SecOCAuthDataFreshnessStartPosition [0..1]: 0..65535, scope=ECU, multiplicity set at post-build in variant post-build / pre-compile in variant pre-compile, set at post-build in variant post-build / pre-compile in variant pre-compile  # This value determines the start position in bits (uint16) of the Authentic PDU that shall be passed on to the Freshness SWC. The bit position starts counting from the MSB of the first byte of the PDU.
      integer SecOCAuthenticationBuildAttempts: 0..65535, multiplicity set at pre-compile, set at post-build in variant post-build / pre-compile in variant pre-compile, default-value=1  # This parameter specifies the number of authentication build attempts.
      integer SecOCAuthenticationVerifyAttempts: 0..65535, multiplicity set at pre-compile, set at post-build in variant post-build / pre-compile in variant pre-compile, default-value=1  # This parameter specifies the number of authentication verify attempts that are to be carried out when the verification of the authentication information failed for a given Secured I-PDU. If zero is set, then only one authentication verification attempt is done.
      integer SecOCAuthInfoTxLength: 1..65535, multiplicity set at pre-compile, post-build-variant-value=true, set at post-build in variant post-build / pre-compile in variant pre-compile  # This parameter defines the length in bits of the authentication code to be included in the payload of the Secured I-PDU.
      integer SecOCDataId: 0..65535, multiplicity set at pre-compile, post-build-variant-value=true, set at post-build in variant post-build / pre-compile in variant pre-compile  # This parameter defines a unique numerical identifier for the Secured I-PDU.
      integer SecOCFreshnessValueId: 0..65535, multiplicity set at pre-compile, post-build-variant-value=true, set at post-build in variant post-build / pre-compile in variant pre-compile, default-value=0  # This parameter defines the Id of the Freshness Value. | The Freshness Value might be a normal counter or a time value.
      integer SecOCFreshnessValueLength: 0..64, multiplicity set at pre-compile, post-build-variant-value=true, set at post-build in variant post-build / pre-compile in variant pre-compile  # This parameter defines the complete length in bits of the Freshness Value. As long as the key doesn't change the counter shall not overflow. The length of the counter shall be determined based on the expected life time of the corresponding key and frequency of usage of the counter.
      integer SecOCFreshnessValueTxLength: 0..64, multiplicity set at pre-compile, post-build-variant-value=true, set at post-build in variant post-build / pre-compile in variant pre-compile  # This parameter defines the length in bits of the Freshness Value to be included in the payload of the Secured I-PDU. This length is specific to the least significant bits of the complete Freshness Counter. If the parameter is 0 no Freshness Value is included in the Secured I-PDU.
      enumeration SecOCReceptionOverflowStrategy: {REPLACE}, multiplicity set at pre-compile, set at pre-compile, default-value=REPLACE  # This parameter defines the overflow strategy for receiving PDUs
      integer SecOCReceptionQueueSize [0..1]: 0..0, multiplicity set at pre-compile, set at pre-compile, default-value=0  # This parameter defines the queue size in case the overflow strategy for receiving PDUs is set to QUEUE.
      boolean SecOCUseAuthDataFreshness: scope=ECU, multiplicity set at pre-compile, set at post-build in variant post-build / pre-compile in variant pre-compile, default-value=false  # A Boolean value that indicates if a part of the Authentic-PDU shall be passed on to the SWC that verifies and generates the Freshness. If it is set to TRUE, the values SecOCAuthDataFreshnessStartPosition and SecOCAuthDataFreshnessLen must be set to specify the bit position and length within the Authentic-PDU.
      enumeration SecOCVerificationStatusPropagationMode: {BOTH, FAILURE_ONLY, NONE}, multiplicity set at pre-compile, post-build-variant-value=true, set at post-build in variant post-build / pre-compile in variant pre-compile  # This parameter is used to describe the propagation of the status of each verification attempt from the SecOC module to SWCs.
      symbolic name reference SecOCRxAuthServiceConfigRef: multiplicity set at pre-compile, set at post-build in variant post-build / pre-compile in variant pre-compile, destination=CsmJob  # This reference is used to define which crypto service function is called for authentication.
      reference SecOCSameBufferPduRef [0..1]: multiplicity set at pre-compile, set at pre-compile, destination=SecOCSameBufferPduCollection  # This reference is used to collect Pdus that are using the same SecOC buffer.
      container SecOCRxAuthenticPduLayer: multiplicity set at pre-compile  # This container specifies the Pdu that is transmitted by the SecOC module to the PduR after the Mac was verified.
        enumeration SecOCPduType: {SECOC_IFPDU}, multiplicity set at pre-compile, set at pre-compile, default-value=SECOC_IFPDU  # This parameter defines API Type to use for communication with PduR.
        reference SecOCRxAuthenticLayerPduRef: multiplicity set at pre-compile, post-build-variant-value=true, set at post-build in variant post-build / pre-compile in variant pre-compile, destination=Pdu  # Reference to the global Pdu.
      choice container SecOCRxSecuredPduLayer: multiplicity set at pre-compile  # Choice between normal Secured I-PDUs and Secured PDU Collections.
        container SecOCRxSecuredPdu [0..1]: multiplicity set at pre-compile  # This container specifies the Pdu that is received by the SecOC module from the PduR. For this Pdu the Mac verification is provided.
          integer SecOCRxSecuredLayerPduId: 0..65535, multiplicity set at pre-compile, set at pre-compile, symbolic-name-value=true, default-value=0  # PDU identifier assigned by SecOC module. Used by PduR for SecOC_PduRRxIndication.
          reference SecOCRxSecuredLayerPduRef: multiplicity set at pre-compile, post-build-variant-value=true, set at post-build in variant post-build / pre-compile in variant pre-compile, destination=Pdu  # Reference to the global Pdu.
        container SecOCRxSecuredPduCollection [0..1]: multiplicity set at post-build in variant post-build / pre-compile in variant pre-compile  # This container specifies two Pdus that are received by the SecOC module from the PduR and a message linking between them. | SecOCRxAuthenticPdu contains the original Authentic I-PDU, i.e. the secured data, and the SecOCRxCryptographicPdu contains the Authenticator, i.e. the actual Authentication Information.
          container SecOCRxAuthenticPdu: multiplicity set at pre-compile  # This container specifies the Authentic Pdu that is received by the SecOC module from the PduR.
            integer SecOCRxAuthenticPduId: 0..65535, multiplicity set at pre-compile, set at pre-compile, symbolic-name-value=true, default-value=0  # PDU identifier of the Authentic I-PDU assigned by SecOC module. Used by PduR for SecOC_PduRRxIndication.
            reference SecOCRxAuthenticPduRef: multiplicity set at pre-compile, post-build-variant-value=true, set at post-build in variant post-build / pre-compile in variant pre-compile, destination=Pdu  # Reference to the global Pdu.
          container SecOCRxCryptographicPdu: multiplicity set at pre-compile  # This container specifies the Cryptographic Pdu that is received by the SecOC module from the PduR.
            integer SecOCRxCryptographicPduId: 0..65535, multiplicity set at pre-compile, set at pre-compile, symbolic-name-value=true, default-value=0  # PDU identifier of the Cryptographic I-PDU assigned by SecOC module. Used by PduR for SecOC_PduRRxIndication.
            reference SecOCRxCryptographicPduRef: multiplicity set at pre-compile, post-build-variant-value=true, set at post-build in variant post-build / pre-compile in variant pre-compile, destination=Pdu  # Reference to the global Pdu.
          container SecOCUseMessageLink [0..1]: multiplicity set at post-build in variant post-build / pre-compile in variant pre-compile  # SecOC links an Authentic I-PDU and Cryptographic I-PDU together by repeating a specific part (Message Linker) of the Authentic I-PDU in the Cryptographic I-PDU.
            integer SecOCMessageLinkLen: 0..65535, multiplicity set at pre-compile, set at post-build in variant post-build / pre-compile in variant pre-compile, default-value=0  # Length of the Message Linker inside the Authentic I-PDU in bits.
            integer SecOCMessageLinkPos: 0..65535, multiplicity set at pre-compile, set at post-build in variant post-build / pre-compile in variant pre-compile, default-value=0  # The position of the Message Linker inside the Authentic I-PDU in bits.
    container SecOCSameBufferPduCollection [0..0]: multiplicity set at pre-compile  # SecOCBuffer configuration that may be used by a collection of Pdus. Note: This container is not used by the generator.
      integer SecOCBufferLength: 0..4294967295, multiplicity set at pre-compile, set at pre-compile  # This parameter defines the Buffer in bytes that is used by the SecOC module. Note: This parameter is not used by the generator.
    container SecOCTxPduProcessing [0..*]: multiplicity set at post-build in variant post-build / pre-compile in variant pre-compile, post-build-variant-multiplicity=true  # Contains the parameters to configure the TxPdus to be secured by the SecOC module.
      integer SecOCAuthenticationBuildAttempts: 1..65535, multiplicity set at pre-compile, set at post-build in variant post-build / pre-compile in variant pre-compile, default-value=1  # This parameter specifies the number of authentication build attempts.
      integer SecOCAuthInfoTxLength: 1..65535, multiplicity set at pre-compile, post-build-variant-value=true, set at post-build in variant post-build / pre-compile in variant pre-compile  # This parameter defines the length in bits of the authentication code to be included in the payload of the Secured I-PDU.
      integer SecOCDataId: 0..65535, multiplicity set at pre-compile, post-build-variant-value=true, set at post-build in variant post-build / pre-compile in variant pre-compile  # This parameter defines a unique numerical identifier for the Secured I-PDU.
      integer SecOCFreshnessValueId: 0..65535, multiplicity set at pre-compile, post-build-variant-value=true, set at post-build in variant post-build / pre-compile in variant pre-compile, default-value=0  # This parameter defines the Id of the Freshness Value. | The Freshness Value might be a normal counter or a time value.
      integer SecOCFreshnessValueLength: 0..64, multiplicity set at pre-compile, post-build-variant-value=true, set at post-build in variant post-build / pre-compile in variant pre-compile  # This parameter defines the complete length in bits of the Freshness Value. As long as the key doesn't change the counter shall not overflow. The length of the counter shall be determined based on the expected life time of the corresponding key and frequency of usage of the counter.
      integer SecOCFreshnessValueTxLength: 0..64, multiplicity set at pre-compile, post-build-variant-value=true, set at post-build in variant post-build / pre-compile in variant pre-compile  # This parameter defines the length in bits of the Freshness Value to be included in the payload of the Secured I-PDU. This length is specific to the least significant bits of the complete Freshness Counter. If the parameter is 0 no Freshness Value is included in the Secured I-PDU.
      boolean SecOCProvideTxTruncatedFreshnessValue: multiplicity set at pre-compile, set at post-build in variant post-build / pre-compile in variant pre-compile, default-value=false  # This parameter specifies if the Tx query freshness function provides the truncated freshness info instead of generating this by SecOC In this case, SecOC shall add this data to the Authentic PDU instead of truncating the freshness value.
      boolean SecOCUseTxConfirmation: multiplicity set at pre-compile, set at post-build in variant post-build / pre-compile in variant pre-compile, default-value=false  # A Boolean value that indicates if the function SecOC_SPduTxConfirmation shall be called for this PDU.
      reference SecOCSameBufferPduRef [0..1]: multiplicity set at pre-compile, set at pre-compile, destination=SecOCSameBufferPduCollection  # This reference is used to collect Pdus that are using the same SecOC buffer.
      symbolic name reference SecOCTxAuthServiceConfigRef: multiplicity set at pre-compile, set at post-build in variant post-build / pre-compile in variant pre-compile, destination=CsmJob  # This reference is used to define which crypto service function is called for authentication.
      container SecOCTxAuthenticPduLayer: multiplicity set at pre-compile  # This container specifies the Pdu that is received by the SecOC module from the PduR. For this Pdu the Mac generation is provided.
        enumeration SecOCPduType: {SECOC_IFPDU}, multiplicity set at pre-compile, set at pre-compile, default-value=SECOC_IFPDU  # This parameter defines API Type to use for communication with PduR.
        integer SecOCTxAuthenticLayerPduId: 0..65535, multiplicity set at pre-compile, set at pre-compile, symbolic-name-value=true, default-value=0  # PDU identifier assigned by SecOC module. Used by PduR for SecOC_PduRTransmit.
        reference SecOCTxAuthenticLayerPduRef: multiplicity set at pre-compile, post-build-variant-value=true, set at post-build in variant post-build / pre-compile in variant pre-compile, destination=Pdu  # Reference to the global Pdu.
      choice container SecOCTxSecuredPduLayer: multiplicity set at pre-compile  # This container specifies the Pdu that is transmitted by the SecOC module to the PduR after the Mac was generated.
        container SecOCTxSecuredPdu [0..1]: multiplicity set at pre-compile  # This container specifies one Pdu that is transmitted by the SecOC module to the PduR after the Mac was generated. This Pdu contains the cryptographic information.
          integer SecOCTxSecuredLayerPduId: 0..65535, multiplicity set at pre-compile, set at pre-compile, symbolic-name-value=true, default-value=0  # PDU identifier assigned by SecOC module. Used by PduR for confirmation (SecOC_PduRTxConfirmation) and for TriggerTransmit.
          reference SecOCTxSecuredLayerPduRef: multiplicity set at pre-compile, post-build-variant-value=true, set at post-build in variant post-build / pre-compile in variant pre-compile, destination=Pdu  # Reference to the global Pdu.
        container SecOCTxSecuredPduCollection [0..1]: multiplicity set at pre-compile  # This container specifies the Pdu that is transmitted by the SecOC module to the PduR after the Mac was generated. Two separate Pdus are transmitted to the PduR: | Authentic I-PDU and Cryptographic I-PDU.
          container SecOCTxAuthenticPdu: multiplicity set at pre-compile  # This container specifies the Authetic Pdu that is transmitted by the SecOC module to the PduR after the Mac was generated.
            integer SecOCTxAuthenticPduId: 0..65535, multiplicity set at pre-compile, set at pre-compile, symbolic-name-value=true, default-value=0  # PDU identifier of the Authentic I-PDU assigned by SecOC module. Used by PduR for confirmation (SecOC_PduRTxConfirmation) and for TriggerTransmit.
            reference SecOCTxAuthenticPduRef: multiplicity set at pre-compile, post-build-variant-value=true, set at post-build in variant post-build / pre-compile in variant pre-compile, destination=Pdu  # Reference to the global Pdu.
          container SecOCTxCryptographicPdu: multiplicity set at pre-compile  # This container specifies the Cryptographic Pdu that is transmitted by the SecOC module to the PduR after the Mac was generated.
            integer SecOCTxCryptographicPduId: 0..65535, multiplicity set at pre-compile, set at pre-compile, symbolic-name-value=true, default-value=0  # PDU identifier of the Cryptographic I-PDU assigned by SecOC module. Used by PduR for confirmation (SecOC_PduRTxConfirmation) and for TriggerTransmit.
            reference SecOCTxCryptographicPduRef: multiplicity set at pre-compile, post-build-variant-value=true, set at post-build in variant post-build / pre-compile in variant pre-compile, destination=Pdu  # Reference to the global Pdu.
          container SecOCUseMessageLink [0..1]: multiplicity set at post-build in variant post-build / pre-compile in variant pre-compile  # SecOC links an Authentic I-PDU and Cryptographic I-PDU together by repeating a specific part (Message Linker) of the Authentic I-PDU in the Cryptographic I-PDU.
            integer SecOCMessageLinkLen: 0..65535, multiplicity set at pre-compile, set at post-build in variant post-build / pre-compile in variant pre-compile, default-value=0  # Length of the Message Linker inside the Authentic I-PDU in bits.
            integer SecOCMessageLinkPos: 0..65535, multiplicity set at pre-compile, set at post-build in variant post-build / pre-compile in variant pre-compile, default-value=0  # The position of the Message Linker inside the Authentic I-PDU in bits.
  bsw implementation SecOC_Impl: programming-language=C, sw-version=5.04.00, used-code-generator=DaVinci Configurator, vendor-id=30, ar-release-version=4.03.00, behavior=SecOCBehavior, preconfigured-configuration=SecOC_Pre, recommended-configuration=SecOC_Rec, vendor-specific-module-def=SecOC
  module config SecOC_Pre: definition=SecOC
  module config SecOC_Rec: definition=SecOC
