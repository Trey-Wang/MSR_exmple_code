AUTOSAR XML (schema 4-0-3)
# COPYRIGHT
# Copyright (c) 2015 by Vector Informatik GmbH. All rights reserved.
# This software is copyright protected and proprietary to Vector Informatik GmbH.
# Vector Informatik GmbH grants to you only those rights as set out in the license conditions.
package /MICROSAR/CddDrm
  module definition Cdd [0..1]: category=VENDOR_SPECIFIC_MODULE_DEFINITION, api-service-prefix=CddDrm, refined-module-def=Cdd, variants pre-compile  # Configuration of the Drm (Diagnostic Request Manager) module.
    container CddComStackContribution  # Contribution of COM Stack modules.
      container CddPduRLowerLayerContribution [0..1]  # PduR Lower Layer Contribution | Parameters that are necessary for the configuration of a Complex Driver that serves as the LowerLayer of the Pdu Router module.
        container CddPduRLowerLayerRxPdu [1..*]  # PduR Lower Layer Rx Pdu | Rx PDU that is received by the Complex Driver and forwarded to the PduR. CddPhysicalRequests
          integer CddPduRLowerLayerHandleId: 0..65535, set at pre-compile, symbolic-name-value=true, default-value=0  # PduR Lower Layer Handle Id | ECU wide unique, symbolic handle for the Pdu.
          reference CddPduRLowerLayerPduRef: set at pre-compile, destination=Pdu  # PduR Lower Layer Pdu Ref | Reference to the "global" Pdu structure to allow harmonization of handle IDs in the COM-Stack.
        container CddPduRLowerLayerTxPdu [1..*]  # PduR Lower Layer Tx Pdu | Tx PDU that is received by the Complex Driver from the PduR. CddPhysicalResponses
          integer CddPduRLowerLayerHandleId: 0..65535, set at pre-compile, symbolic-name-value=true, default-value=0  # PduR Lower Layer Handle Id | ECU wide unique, symbolic handle for the Pdu.
          reference CddPduRLowerLayerPduRef: set at pre-compile, destination=Pdu  # PduR Lower Layer Pdu Ref | Reference to the "global" Pdu structure to allow harmonization of handle IDs in the COM-Stack.
    container CddGeneral  # This container contains the general configuration (parameters) of the Drm.
      integer CddNumberOfChannels: 1..253, set at pre-compile, origin=Vector Informatik, default-value=1  # This value specifies the limit of active connections at the same time. Note: If ECU Detection is enabled, the minimum value of this parameter is 2.
      float CddTaskTime: 0.01..0.255, set at pre-compile, origin=Vector Informatik, default-value=0.01  # MainTimer Function Period | This value specifies the cyclic call of the main function.
      boolean CddDevErrorDetect: set at pre-compile, origin=Vector Informatik, default-value=true  # Development Error Detect | Activate/Deactivate the Development Error Detection and Notification. If this option is enabled, integration errors are reported to the DET module (e.g. calling APIs with invalid arguments that would cause a malfunction of the Drm module). In a production system this option can be disabled as all code should be tested to correctly use the Drm API.
      boolean CddVersionInfoApi: set at pre-compile, origin=Vector Informatik, default-value=false  # This switch turns the API to get the component version ON or OFF. true: Version API ON false: Version API OFF
      boolean CddCancelApi: set at pre-compile, origin=Vector Informatik, default-value=false  # If enabled the Drm supports an API to cancel an ongoing request processing.
      float CddRequestDelayTime [0..1]: 0.01..2.55, set at pre-compile, origin=Vector Informatik, default-value=0.2  # This value specifies the delay time before the next request is sent. The timer is reloaded with this value when all request data was successful copied to the PduR. Restrictions: If connection separation time is configured this parameter cannot be activated too.
      boolean CddUseNvm [0..1]: set at pre-compile, origin=Vector Informatik, default-value=true  # If enabled the Drm stores data in non-volatile memory, e.g. ECU detection.
      boolean CddEcuDetectionSupport: set at pre-compile, origin=Vector Informatik, default-value=false  # This parameter switches the ECU Detection on or off. Note: If this switch is set to true, the UseNvm parameter and EcuDetection container is mandatory and must be configured.
      string CddHeaderFileInclusion [1..*]: set at pre-compile, origin=Vector Informatik  # Name of the header file(s) to be included by the Drm module containing the used C-callback declarations. The different callout configurations allow to specify a C-Callback. Therefore you need to add a header file here with the appropriate declaration of the function.
      boolean CddCancelReceiveApi: set at pre-compile, origin=Vector Informatik, default-value=false  # This parameter defines whether Receive Cancellation is enabled or disabled. If this switch is disabled, the API 'CddDrm_CancelReceive' is not available. The cancel receive feature is not supported but needed by DCM.
      boolean CddCancelTransmitApi: set at pre-compile, origin=Vector Informatik, default-value=false  # This parameter defines whether Transmit Cancellation is enabled or disabled. If this switch is disabled, the API 'CddDrm_CancelTransmit' is not available, reducing resource consumption.
      boolean CddChangeParameterApi: set at pre-compile, origin=Vector Informatik, default-value=false  # This parameter defines whether Change Parameter is enabled or disabled. If this switch is disabled, the API 'CddDrm_ChangeParameter' is not available. The change parameter feature is not supported but needed by DCM.
      string CddUserConfigFile [0..1]: set at pre-compile, origin=Vector Informatik, default-value=CddDrm_UserConfig.ucf  # Reference to an external text file that will be included during generation to CddDrm_Cfg.h. The content of the user configuration file will be added at the end of the generated module configuration file and allows altering or extending the generated code. Caution: User configuration files can cause the software module to malfunction and must only be used with great care!
      boolean CddUseFirewallUserDefinedServices: set at pre-compile, origin=Vector Informatik, default-value=false  # This parameter enables a callback so the application can verify if the user defined service is allowed or not. Note: If user defined services enabled in firewall, the callback is mandatory.
      integer CddCompiledConfigId [0..1]: 0..65535, set at pre-compile, origin=Vector Informatik, default-value=0  # Change this value to force the Drm to clear all NV data on next initialization (startup). This is useful if the flash eeprom emulation is not cleared during flashing of a new software version. If this value is missing the Drm will clear its NV data, if the component major or minor version will change.
      container CddDedicatedApiServiceSupport  # Dedicated Diagnostic Service APIs
        boolean CddSupportSvcApi_10: set at pre-compile, origin=Vector Informatik, default-value=true  # Support Service 0x10 | DiagnosticSessionControl true: Service enabled false: Service disabled
        boolean CddSupportSvcApi_11: set at pre-compile, origin=Vector Informatik, default-value=true  # Support Service 0x11 | ECU Reset true: Service enabled false: Service disabled
        boolean CddSupportSvcApi_22: set at pre-compile, origin=Vector Informatik, default-value=true  # Support Service 0x22 | ReadDataByIdentifier true: Service enabled false: Service disabled
        boolean CddSupportSvcApi_27: set at pre-compile, origin=Vector Informatik, default-value=true  # Support Service 0x27 | SecurityAccess true: Service enabled false: Service disabled
        boolean CddSupportSvcApi_28: set at pre-compile, origin=Vector Informatik, default-value=true  # Support Service 0x28 | CommunicationControl true: Service enabled false: Service disabled
        boolean CddSupportSvcApi_3E: set at pre-compile, origin=Vector Informatik, default-value=true  # Support Service 0x3E | TesterPresent true: Service enabled false: Service disabled
        boolean CddSupportSvcApi_85: set at pre-compile, origin=Vector Informatik, default-value=true  # Support Service 0x85 | ControlDTCSetting true: Service enabled false: Service disabled
        boolean CddSupportSvcApi_1904: set at pre-compile, origin=Vector Informatik, default-value=true  # Support Service 0x1904 | ReadDTCInformation sub-function: 0x04 true: Service enabled false: Service disabled
        boolean CddSupportSvcApi_31: set at pre-compile, origin=Vector Informatik, default-value=true  # Support Service 0x31 | RoutineControl true: Service enabled false: Service disabled
        boolean CddSupportSvcApi_34: set at pre-compile, origin=Vector Informatik, default-value=true  # Support Service 0x34 | RequestDownload true: Service enabled false: Service disabled
        boolean CddSupportSvcApi_36: set at pre-compile, origin=Vector Informatik, default-value=true  # Support Service 0x36 | TransferData true: Service enabled false: Service disabled
        boolean CddSupportSvcApi_37: set at pre-compile, origin=Vector Informatik, default-value=true  # Support Service 0x37 | RequestTransferExit true: Service enabled false: Service disabled
        boolean CddSupportSvcApi_1902: set at pre-compile, origin=Vector Informatik, default-value=true  # Support Service 0x1902 | ReadDTCInformation sub-function: 0x02 true: Service enabled false: Service disabled
      container CddNvRamBlockId [0..1]  # NvRam BlockId | This container represents a non-volatile memory block used by the Drm. If no permanent storage is required, no block needs to be configured.
        enumeration CddNvRamBlockIdType: {DRM_NVBLOCK_ECU_DETECTION}, set at pre-compile, origin=Vector Informatik, default-value=DRM_NVBLOCK_ECU_DETECTION  # NvRam BlockId Type | Usage kind of this NvBlock. This parameter is used to identify which block data needs to be stored.
        symbolic name reference CddNvRamBlockIdRef: set at pre-compile, origin=Vector Informatik, destination=NvMBlockDescriptor  # NvRam BlockId Ref | This reference contains the link to a non-volatile memory block.
      container CddCallback  # This container contain all callbacks that can be configured in the Drm.
        function name CddResponseNotification: set at pre-compile, origin=Vector Informatik, default-value=Drm_ResponseNotification  # Specifies the function name in the application which is called when the request processing has finished. E.g. a response was received or a timeout has occured.
        function name CddTxConfirmation [0..1]: set at pre-compile, origin=Vector Informatik  # Specifies the function name in the application which is called when all request data was transferred to the PduR. Note: Callback is only called, if request is triggered by application.
        function name CddEcuDetectionFinished [0..1]: set at pre-compile, origin=Vector Informatik  # This callback will be triggered from Drm after ECU Detection is finished. Note: Do not configure this callback, if ECU Detection is disabled.
        function name CddFirewallUserCallback [0..1]: set at pre-compile, origin=Vector Informatik  # Specifies a callback to the application, to verify if user defined service is allowed or not.
      container CddEcuDetection [0..1]  # This container contains all parameters related to the ECU detection.
        integer CddDetectionRequest [1..7]: 0..255, set at pre-compile, origin=Vector Informatik, requires-index=true  # This value specifies the request bytes, which will be used to detect ECUs.
        integer CddDetectionBufferSize: 3..255, set at pre-compile, origin=Vector Informatik, default-value=7  # Response Buffer Size | Specifies the Drm internal response buffer, that is only used for ECU Detection. Note: If the buffer is not large enough to receive the response data, the respective ECU is set to not detected.
    container CddConfig  # This container contains communication related configuration (parameters).
      container CddConnection [1..254]  # This container contains the connection specific configuration (parameters) of the Drm. A connection represents a diagnosable ECU in the vehicle network.
        float CddP2: 0.01..2.55, set at pre-compile, origin=Vector Informatik, default-value=0.5  # P2 Time | This value specifies the default P2 Time.
        float CddP2Extended: 0.01..2.55, set at pre-compile, origin=Vector Informatik, default-value=2  # P2 Extended Time | This value specifies the extended P2 time.
        integer CddMaxRCRRP [0..1]: 1..255, set at pre-compile, origin=Vector Informatik, default-value=10  # Max. allowed RCRRP | This value specifies the maximum number of allowed RCRRP messages.
        float CddSeparationTime [0..1]: 0.01..2.55, set at pre-compile, origin=Vector Informatik, default-value=0.2  # This value specifies the delay time between a diagnostic response and the next possible request for this connection. The timer is reloaded with this value when the allocated channel for this connection was closed. The channel can be closed for the following reasons: - Tx error between Drm and PduR - Rx error between Drm and PduR - Response timeout - External tester detected - Cancel API(s) has been called - RCRRP limit reached Restrictions: If RequestDelayTime is configured, the connection separation time cannot be activated too.
        reference CddFirewallListRef [0..1]: set at pre-compile, origin=Vector Informatik, destination=CddFirewallLists  # This value references the firewall list.
        container CddPhysical  # The physical request and response Pdu for the ECU.
          reference CddPhysicalResponseRef: set at pre-compile, origin=Vector Informatik, destination=CddPduRLowerLayerTxPdu  # Response Pdu that is received by the Drm from the PduR.
          reference CddPhysicalRequestRef: set at pre-compile, origin=Vector Informatik, destination=CddPduRLowerLayerRxPdu  # Request Pdu that is forwarded to the PduR.
      container CddFirewallLists [0..65535]  # This container contains the firewall configuration (parameters) of the Drm.
        enumeration CddFirewallServiceIds [1..*]: set at pre-compile, origin=Vector Informatik  # Diagnostic services configured in this blacklist will be rejected for service processing.
          Service_0x10  # Diagnostic Session Control
          Service_0x11  # ECU Reset
          Service_0x14  # Clear Diagnostic Information
          Service_0x19  # Read DTC Information
          Service_0x22  # Read Data By Identifier
          Service_0x23  # Read Memory By Address
          Service_0x24  # Read Scaling Data By Identifier
          Service_0x27  # Security Access
          Service_0x28  # Communication Control
          Service_0x2A  # Read Data By Periodic Identifier
          Service_0x2C  # Dynamically Define Data Identifier
          Service_0x2E  # Write Data By Identifier
          Service_0x2F  # Input Output Control By Identifier
          Service_0x31  # Routine Control
          Service_0x34  # Request Download
          Service_0x35  # Request Upload
          Service_0x36  # Transfer Data
          Service_0x37  # Request Transfer Exit
          Service_0x38  # Request File Transfer
          Service_0x3D  # Write Memory By Address
          Service_0x3E  # Tester Present
          Service_0x83  # Access Timing Parameter
          Service_0x84  # Secured Transmission
          Service_0x85  # Control DTC Settings
          Service_0x86  # Response on Event
          Service_0x87  # Link control
  module config Cdd_Pre: definition=Cdd
  module config Cdd_Rec: definition=Cdd
  bsw implementation Cdd_Impl: programming-language=C, sw-version=1.00.00, used-code-generator=DaVinci Configurator, vendor-id=30, ar-release-version=4.01.02, behavior=CddDrmBehavior, preconfigured-configuration=Cdd_Pre, recommended-configuration=Cdd_Rec, vendor-specific-module-def=Cdd
