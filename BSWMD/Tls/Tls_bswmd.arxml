AUTOSAR XML (schema 4-0-3)
package /MICROSAR
  module definition Tls [0..1]: category=VENDOR_SPECIFIC_MODULE_DEFINITION, variants pre-compile  # Configuration of the Transport Layer Security (Tls).
    container TlsGeneral
      boolean TlsDevErrorDetect: set at pre-compile, origin=Vector Informatik, default-value=true  # Dev Error Detect | If 'Development Error Detection' is enabled, all development errors are reported to the Development Error Tracer (DET). The errors are described in the [TechnicalReference_Asr_Tls.pdf]. Note: In general, the development error detection is recommended during pre-test phase. It is not recommended to enable the development error detection in production code due to increased runtime and ROM needs.
      boolean TlsVersionInfoApi: set at pre-compile, origin=Vector Informatik, default-value=false  # Version Info API | If 'TlsVersionInfoApi' is enabled, the function Tls_GetVersionInfo() is available to get major, minor and patch version information.
      boolean TlsProdErrorDetect: set at pre-compile, origin=Vector Informatik, default-value=true  # Prod Error Detect | If 'Production Error Detection' is enabled, production relevant errors are reported to the Diagnostics Event Manager (DEM). Disable this option, if no DEM is present in your system.
      string TlsUserConfigFile [0..1]: set at pre-compile, origin=Vector Informatik  # User Config File | If a file path will be specified, the file is read and its contents are put at the end of the Tls config file.
      boolean TlsVersionInfoApiMacro: set at pre-compile, origin=Vector Informatik, default-value=false  # Version Info API Macro | If 'TlsVersionInfoApiMacro' is enabled, macro will be used to get major, minor and patch version information. RESTRICTIONS: 'TlsVersionInfoApiMacro' is only available, if 'TlsVersionInfoApi' is set to 'true'.
      boolean TlsRsaWithAes128CbcSha: set at pre-compile, origin=Vector Informatik, default-value=true  # TLS_RSA_WITH_AES_128_CBC_SHA | If 'TlsRsaWithAes128CbcSha' is enabled, TLS_RSA_WITH_AES_128_CBC_SHA ciphersuite is supported.
      boolean TlsRsaWithNullSha: set at pre-compile, origin=Vector Informatik, default-value=true  # TLS_RSA_WITH_NULL_SHA | If 'TlsRsaWithNullSha' is enabled, TLS_RSA_WITH_NULL_SHA ciphersuite is supported.
      boolean TlsEnableClientCertSupport: set at pre-compile, origin=Vector Informatik, default-value=true  # Enable Client Certificate Support | If 'TlsEnableClientCertSupport' is enabled, Client-authenticated TLS handshake will be possible.
      integer TlsMaxServRsaPubKeyExpSize: 1..256, set at pre-compile, origin=Vector Informatik, default-value=3  # Maximum Server RSA Pbulic Key Exponent Size | Maximum RSA Public Key Exponent Size supported for Servers Certificate in Byte
      integer TlsMaxServPubKeySize: 64..256, set at pre-compile, origin=Vector Informatik, default-value=256  # Maximum Server RSA or ECC Key Size | Maximum RSA Public Key Modulus Size or ECC Key Size supported for Servers Certificate in Byte. ECC key size is currently fixed to 64 Byte.
      string TlsRandArrayFct: set at pre-compile, origin=Vector Informatik, default-value=Appl_Crypto_GetRandArray  # Random Array Function | Random number generator used by TLS
      string TlsRandFctIncludeFile: set at pre-compile, origin=Vector Informatik, default-value=Appl_Rand.h  # Random Function Include File | Random number generator include file
      boolean TlsEcdhEcdsaWithAes128CbcSha: set at pre-compile, origin=Vector Informatik, default-value=true  # TLS_ECDH_ECDSA_WITH_AES_128_CBC_SHA | If 'TlsEcdhEcdsaWithAes128CbcSha' is enabled, TLS_ECDH_ECDSA_WITH_AES_128_CBC_SHA ciphersuite is supported.
      string TlsTime32Fct: set at pre-compile, origin=Vector Informatik, default-value=Appl_TlsGetTime32  # Time Function | Time function used by TLS to get the current time as uint32
      string TlsTime32IncludeFile: set at pre-compile, origin=Vector Informatik, default-value=Appl_Time.h  # Time Function Include File | Time function include file
      boolean TlsRealTimeClockSupport: set at pre-compile, origin=Vector Informatik, default-value=true  # Real Time Clock Support | If 'TlsRealTimeClockSupport' is enabled, certificates valid dates will be checked.
      integer TlsNvmExchData: 0..65535, set at pre-compile, origin=Vector Informatik, default-value=0  # NvM Exchange Data Buffer Size [byte] | Buffer for NvM data exchange. Value should be the size of the largest TLS NvM block.
      boolean TlsRsaWithAes128CbcSha256: set at pre-compile, origin=Vector Informatik, default-value=true  # TLS_RSA_WITH_AES_128_CBC_SHA_256 | If 'TlsRsaWithAes128CbcSha256' is enabled, TLS_RSA_WITH_AES_128_CBC_SHA256 ciphersuite is supported.
      boolean TlsEcdhEcdsaWithAes128CbcSha256: set at pre-compile, origin=Vector Informatik, default-value=true  # TLS_ECDH_ECDSA_WITH_AES_128_CBC_SHA_256 | If 'TlsEcdhEcdsaWithAes128CbcSha256' is enabled, TLS_ECDH_ECDSA_WITH_AES_128_CBC_SHA256 ciphersuite is supported.
      boolean TlsEnableProtocolVer1_0: set at pre-compile, origin=Vector Informatik, default-value=true  # Enable Protocol Version 1.0 | If 'TlsEnableProtocolVer1_0' is enabled, TLS is able to establish a TLS connection using protocol version 1.0.
      boolean TlsEnableProtocolVer1_2: set at pre-compile, origin=Vector Informatik, default-value=false  # Enable Protocol Version 1.2 | If 'TlsEnableProtocolVer1_2' is enabled, TLS is able to establish a TLS connection using protocol version 1.2.
      boolean TlsRsaWithNullSha256: set at pre-compile, origin=Vector Informatik, default-value=true  # TLS_RSA_WITH_NULL_SHA_256 | If 'TlsRsaWithNullSha256' is enabled, TLS_RSA_WITH_NULL_SHA256 ciphersuite is supported.
      boolean TlsEcdhEcdsaWithNullSha: set at pre-compile, origin=Vector Informatik, default-value=true  # TLS_ECDH_ECDSA_WITH_NULL_SHA | If 'TlsEcdhEcdsaWithNullSha' is enabled, TLS_ECDH_ECDSA_WITH_NULL_SHA ciphersuite is supported.
      float TlsMainFunctionPeriod: 0.001..30, set at pre-compile, origin=Vector Informatik, default-value=0.005  # Main Function Period | Specifies the period that the MainFunction has to be triggered with.
      boolean TlsEcdheEcdsaWithAes128CbcSha: set at pre-compile, origin=Vector Informatik, default-value=true  # TLS_ECDHE_ECDSA_WITH_AES_128_CBC_SHA | If 'TlsEcdheEcdsaWithAes128CbcSha' is enabled, TLS_ECDHE_ECDSA_WITH_AES_128_CBC_SHA ciphersuite is supported.
      boolean TlsEcdheEcdsaWithAes128CbcSha256: set at pre-compile, origin=Vector Informatik, default-value=true  # TLS_ECDHE_ECDSA_WITH_AES_128_CBC_SHA256 | If 'TlsEcdheEcdsaWithAes128CbcSha256' is enabled, TLS_ECDHE_ECDSA_WITH_AES_128_CBC_SHA256 ciphersuite is supported.
      boolean TlsSupportGetNvmBlockIdForUsedRootCert: set at pre-compile, origin=Vector Informatik, default-value=false  # Enable Get NvM Block ID of used Root Cert API | Enable an API to read the NVM block id of the root certificate used to validate the server certificate (received in the ServerCertificate message).
      boolean TlsSupportRootCertUpdate: set at pre-compile, origin=Vector Informatik, default-value=false  # Enable Root Certificate Update Indication API | Enable an API to inform TLS that an NVM block containing a TLS root certificate was updated. TLS then will update its internal certificate descriptor for this root certificate.
      boolean TlsEnableSccErrorEventCbk: set at pre-compile, origin=Vector Informatik, default-value=false  # Enable SCC Error Event Callback | Enable a special error event indication to the module SCC. SCC has to implement a corresponding Callback API. Note: This may only be relevant for a charger environment ECU for electric vehicles that implements the Vector module SCC. The use may be OEM specific.
      boolean TlsOcspEnable: set at pre-compile, origin=Vector Informatik, default-value=false  # OCSP Enable | Enable support for OCSP. TLS implements the so-called 'OCSP stapling' according to RFC 6066 chapter 8 and RFC 2560 / 6960. This mechanism is used to check the validity of received certificates. Note: OCSP has to be enabled for each connection to work on a specific connection.
      integer TlsOcspMaxCertChainLen: 0..255, set at pre-compile, origin=Vector Informatik, default-value=3  # OCSP Max Certificate Chain Length | Maximum length of the certificate chain received in the handshake message 'server_certificate'
      integer TlsAssumedTimePrecision: 0..4000, set at pre-compile, origin=Vector Informatik, default-value=60  # Assumed Time Precision | Assumed precision of the local time (in seconds). Allowed values are 0 to 4000. The precision value is needed for comparison with received timestamps during the handshake.
      boolean TlsEcdheEcdsaWithAes128GcmSha256: set at pre-compile, origin=Vector Informatik, default-value=true  # TLS_ECDHE_ECDSA_WITH_AES_128_GCM_SHA256 | If 'TlsEcdheEcdsaWithAes128GcmSha256' is enabled, TLS_ECDHE_ECDSA_WITH_AES_128_GCM_SHA256 ciphersuite is supported.
      boolean TlsCrlEnable: set at pre-compile, origin=Vector Informatik, default-value=false  # CRL Enable | Enable support for CRL (Certificate Revocation List). TLS implements CRL according to RFC 5280 chapter 5. This mechanism is used to check the validity of received certificates. Note: Only the validity of the server certificate is checked, not the validity of any other element of the certificate chain!
      integer TlsCrlNvmExchData: 0..65535, set at pre-compile, origin=Vector Informatik, default-value=0  # CRL NvM Exchange Data Buffer Size [byte] | Buffer for NvM data exchange used for CRLs. Value should be the size of the largest TLS CRL NvM block.
      integer TlsHeartbeatPeriod [0..1]: 1..3600, set at pre-compile, origin=Vector Informatik, default-value=20  # Heartbeat Period Default Value | TLS implements the so-called 'TLS Heartbeat Extension' according to RFC 6520. This mechanism is used to check if the connection is still alive. This paraneter specifies the default sending period for the heartbeat. The default period can be overwritten by a call of Tls_ChangeParameter. The time is given in seconds. If this config parameter exists then the feature is enabled, otherwise it is disabled. Note: In addition to this global setting, the heartbeat has to be enabled for each connection to work on a specific connection during runtime.
      boolean TlsSupportMasterSecretAccess: set at pre-compile, origin=Vector Informatik, default-value=false  # Support Master Secret Access | Enabling this feature grants access to the TLS master secret via an API. Warning: This feature has to be disabled for any productive code due to security reasons!
    container TlsConfigSet
      container TlsConnectionConfig [0..*]
        integer TlsConnectionId: 0..255, set at pre-compile, origin=Vector Informatik, symbolic-name-value=true, default-value=0  # Connection Index | Tls Connection Id
        integer TlsRxMaxPayloadSize: 0..65535, set at pre-compile, origin=Vector Informatik, default-value=2000  # RX Max Payload Size | The size of the buffer were the TLS record layer payload is collected until all record layer TCP segments are received. This buffer must store the biggest possible TLS RX payload Note: TLS will stream the TCP segment data into this buffer until a complete TLS record layer is received. There for this buffer should be equal or bigger than the according TCP RX buffer.
        integer TlsTxMaxPayloadSize: 1..65535, set at pre-compile, origin=Vector Informatik, default-value=2000  # TX Max Payload Size | The maximum payload that shall be transmitted on this connection. This value will not generate a buffer, it is only used for TCP buffer configuration to add necessary TLS overhead. Note: TLS needs to store a complete TLS message inside the TCP buffer. There for the TX payload size must be equal to the TCP TX buffer size.
        boolean TlsOcspEnableForCon: set at pre-compile, origin=Vector Informatik, default-value=false  # OCSP Enabled for this Connection | Enable the usage of OCSP for the specified connection
        integer TlsOcspMaxRespAge: 1..2147483647, set at pre-compile, origin=Vector Informatik, default-value=2419200  # OCSP Max Response Age | Maximum age of an OCSP response that can be accepted. It specifies the maximum difference between the current local time and the value of 'thisUpdate' in the OCSP response. This value is given in 'seconds'. Example: The ISO15118 specifies a value of 'not older than 4 weeks' (2419200 seconds).
        integer TlsRxMaxRecordSize: 1..65535, set at pre-compile, origin=Vector Informatik, default-value=2053  # RX Max Record Size | The calculated 'RX Max Record Size' is only for notification and has no effect for the configuration (only readable). TlsRxMaxRecordSize = TlsRxMaxPayloadSize + TlsOverhead (Header, MAC and Padding)
        integer TlsTxMaxRecordSize: 1..65535, set at pre-compile, origin=Vector Informatik, default-value=2053  # TX Max Record Size | The calculated 'TX Max Record Size' is only for notification (only readable). TlsTxMaxRecordSize = TlsTxMaxPayloadSize + TlsOverhead (Header, MAC and Padding) The 'TX Max Record Size' defines together with the 'RX TCP Socket Buffer Size' which 'TcpIpTcpSocketBuffer' is used for the Tls: The 'TX Max Record Size' (Tls module) has to be the same value as the 'Socket Tx Buffer Size' (TcpIp module) and the 'RX TCP Socket Buffer Size' (Tls module) has to be the same value as the 'Socket Rx Buffer Size' (TcpIp module).
        integer TlsTcpIpTcpSocketRxBufferSize: 1..65535, set at pre-compile, origin=Vector Informatik, default-value=300  # RX TCP Socket Buffer Size | The 'RX TCP Socket Buffer Size' defines together with the 'TX Max Record Size' which 'TcpIpTcpSocketBuffer' is used for the Tls: The 'RX TCP Socket Buffer Size' (Tls module) has to be the same value as the 'Socket Rx Buffer Size' (TcpIp module) and the 'TX Max Record Size' (Tls module) has to be the same value as the 'Socket Tx Buffer Size' (TcpIp module).
      container TlsServerRootCertificateConfig [1..*]
        reference TlsNvmBlockDescriptor: set at pre-compile, origin=Vector Informatik, destination=NvMBlockDescriptor  # NvM Block Descriptor | Choose NvM block descriptor reference of the Server Root Certificate which is used to load and store the Certificate non-volatile data.
      container TlsCrlConfig [0..*]  # Configuration for CRL (Certificate Revocation List).
        reference TlsCrlNvmBlockDescriptor: set at pre-compile, origin=Vector Informatik, destination=NvMBlockDescriptor  # CRL NvM Block Descriptor | Choose NvM block descriptor reference of the stored CRL (Certificate Revocation List) which is used to load and store the CRL non-volatile data.
  bsw implementation Tls_Impl: programming-language=C, sw-version=8.02.00, used-code-generator=DaVinci Configurator, vendor-id=30, ar-release-version=4.00.03, behavior=TlsBehavior, preconfigured-configuration=Tls_Pre, recommended-configuration=Tls_Rec, vendor-specific-module-def=Tls
  module config Tls_Pre: definition=Tls
  module config Tls_Rec: definition=Tls
