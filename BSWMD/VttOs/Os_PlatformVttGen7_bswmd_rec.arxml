AUTOSAR XML (schema 4-2-1)
package /MICROSAR
  module config Os_Rec: definition=Os
    SystemTimer (OsCounter): OsCounterMaxAllowedValue=2147483647, OsCounterMinCycle=1, OsCounterType=HARDWARE, OsSecondsPerTick=0.001
    OsOS: OsSystemTimer=SystemTimer, OsMasterCore=OsCore0
    OsPublishedInformation
      VTT (OsDerivativeInformation)
        STM0 (OsHardwareTimer): OsHardwareTimerUnit=STM, OsHardwareTimerHighResPossible=1
          STM0_Ch0 (OsHardwareTimerChannel)
        PIT0 (OsHardwareTimer): OsHardwareTimerUnit=PIT, OsHardwareTimerHighResPossible=0
          PIT0_Ch0 (OsHardwareTimerChannel)
        OsPhysicalCore0 (OsPhysicalCore)
    OsCore0 (OsCore): OsCoreIsAutosar=1, OsCorePhysicalCoreRef=OsPhysicalCore0
