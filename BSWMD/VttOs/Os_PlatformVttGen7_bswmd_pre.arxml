AUTOSAR XML (schema 4-2-1)
package /MICROSAR
  module config Os_Pre: definition=Os
    OSDEFAULTAPPMODE (OsAppMode)
    OS_APPMODE_ANY (OsAppMode)
    OsPublishedInformation: OsKernelVersion=7, OsPlatformName=VTT
      VTT (OsDerivativeInformation): OsExceptionVectorTableAlignment=0, OsInterruptVectorTableAlignment=0, OsHardwareManuals=N/A
        OsSystemIntCtrl: OsSystemIntCtrlPrioOrder=ASC, OsSystemIntCtrlMaxPrios=200, OsSystemIntCtrlBaseAddress=0, OsSystemIntCtrlMaxSources=10000
    OsOS: OsGenerateMemMap=EMPTY, OsGenerateMemMapForThreads=0
