AUTOSAR XML (schema 4-2-1)
package /MICROSAR/VTT
  module config VTTOs_Pre: definition=VTTOs
    OsOS: OsGenerateMemMap=EMPTY, OsGenerateMemMapForThreads=0
