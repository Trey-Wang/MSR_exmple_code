AUTOSAR XML (schema 4-0-3)
package /MICROSAR
  bsw implementation Brs_Impl: programming-language=C, used-code-generator=DaVinci Configurator, vendor-id=30, ar-release-version=4.00.03, preconfigured-configuration=Brs_Pre, recommended-configuration=Brs_Rec, vendor-specific-module-def=Brs
  module definition Brs [0..1]: category=VENDOR_SPECIFIC_MODULE_DEFINITION, variants pre-compile  # Basic Runtime System | Configuration of the Basic Runtime System.
    container BrsGeneral  # General configuration parameters of the BRS.
      boolean BrsEnableTgfSupport: set at pre-compile, origin=Vector Informatik, default-value=false  # Support TGF
      boolean BrsEnableOsSupport: set at pre-compile, origin=Vector Informatik, default-value=true  # Use Autosar-OS conform Tasks; disable this, if no OS should be used
      boolean BrsEnableOsEmulation: set at pre-compile, origin=Vector Informatik, default-value=false  # Support of OS emulation
      boolean BrsEnableTfwSupport: set at pre-compile, origin=Vector Informatik, default-value=false  # Enable support of the TestFramework (TFW) of module zCantate_TFW. Via the define BRSASR_ENABLE_TFW_SUPPORT, the TFW specific cyclic function will be called within BrsAsrMain.c
      boolean BrsEnableSupportLEDs: set at pre-compile, origin=Vector Informatik, default-value=false  # Enable Support LEDs | Use the functionality of a blinking live-LED for the used EvalBoard
      boolean BrsEnableSafeContextSupport: set at pre-compile, origin=Vector Informatik, default-value=false  # Enable support of SafeContext OS
      boolean BrsEnableMcalTrustedOnly: set at pre-compile, origin=Vector Informatik, default-value=false  # Enable support of MCALs that can not be initialized in non-trusted OS-Application
      boolean BrsEnableMultiCoreSupport: set at pre-compile, origin=Vector Informatik, default-value=false  # Enable support of MultiCore OS
      boolean BrsEnableSafeWdgSupport: set at pre-compile, origin=Vector Informatik, default-value=false  # Enable support of SafeWatchdog Stack
      boolean BrsEnableSafeWdgMultiCoreSupport: set at pre-compile, origin=Vector Informatik, default-value=false  # Enable support of MultiCore SafeWatchdog Stack
      boolean BrsEnableHLPTestSupport: set at pre-compile, origin=Vector Informatik, default-value=false  # Enable support of the HLP TestSuite. Via the define BRS_ENABLE_HLPTEST_SUPPORT, the HLP TestSuite specific init and cyclic functions will be called within BrsAsrMain.c
      boolean BrsEnableTcmSupport: set at pre-compile, origin=Vector Informatik, default-value=false  # Enable support of the Test Control Module (TCM). Via the define BRS_ENABLE_TCM_SUPPORT, the TCM specific init and cyclic functions will be called within BrsAsrMain.c
      boolean BrsEnableExternalWakeup: set at pre-compile, origin=Vector Informatik, default-value=false  # Enable support of additional Pins for external wakeup functionality within BrsHw. This functionality has to be supported by your platform BrsHw implementation (check BrsHw_availability.xlsx)
    container BrsHwConfig
      integer BrsOscClock: 0..18446744073709551615, set at pre-compile, origin=Vector Informatik, default-value=0  # Sets the Brs C define BRS_OSC_CLK and the Makefile.Cfg5.include variable MAIN_OSC_CLK.
      integer BrsTimebaseClock: 0..18446744073709551615, set at pre-compile, origin=Vector Informatik, default-value=0  # Sets the Brs C define BRS_TIMEBASE_CLOCK and the Makefile.Cfg5.include variable TIMEBASE_CLOCK.
      integer BrsPeriphClock: 0..18446744073709551615, set at pre-compile, origin=Vector Informatik, default-value=0  # Sets the Brs C define BRS_PERIPH_CLOCK and the Makefile.Cfg5.include variable PERIPH_CLOCK.
    container BrsTcc [0..1]
      container BrsComIfUpperLayerRxPdu  # This container specifies Rx PDU that is received by the BRS through communication stack.
        integer BrsComIfHandleId: 0..65535, set at pre-compile, origin=Vector Informatik, symbolic-name-value=true, default-value=0  # ECU wide unique, symbolic handle for the Pdu.
        reference BrsComIfPduRef: set at pre-compile, origin=Vector Informatik, destination=Pdu  # Reference to the "global" Pdu structure to allow harmonization of handle IDs in the COM-Stack.
      container BrsComIfUpperLayerTxPdu  # This container specifies Tx PDU that is transmitted by the CDD through communication stack.
        integer BrsComIfHandleId: 0..65535, set at pre-compile, origin=Vector Informatik, symbolic-name-value=true, default-value=0  # ECU wide unique, symbolic handle for the Pdu.
        reference BrsComIfPduRef: set at pre-compile, origin=Vector Informatik, destination=Pdu  # Reference to the "global" Pdu structure to allow harmonization of handle IDs in the COM-Stack.
  module config Brs_Rec: definition=Brs
  module config Brs_Pre: definition=Brs
