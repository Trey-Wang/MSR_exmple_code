AUTOSAR XML (schema 4-3-0)
# COPYRIGHT
# Copyright (c) 2017 by Vector Informatik GmbH. All rights reserved.
# This software is copyright protected and proprietary to Vector Informatik GmbH.
# Vector Informatik GmbH grants to you only those rights as set out in the license conditions.
package /MICROSAR
  module definition CryIf [0..1]: category=VENDOR_SPECIFIC_MODULE_DEFINITION, refined-module-def=CryIf, variants pre-compile  # Configuration of the Crypto Interface.
    container CryIfChannel [1..*]: multiplicity set at pre-compile  # Container for incorporation of CryIfChannel.
      integer CryIfChannelId: 0..4294967295, multiplicity set at pre-compile, set at pre-compile, symbolic-name-value=true, default-value=0  # Identifier of the crypto channel. | Specifies to which crypto channel the CSM queue is connected to.
      symbolic name reference CryIfDriverObjectRef: multiplicity set at pre-compile, set at pre-compile, destination=CryptoDriverObject  # This parameter refers to a Crypto Driver Object. | Specifies to which Crypto Driver Object the crypto channel is connected to
    container CryIfGeneral: multiplicity set at pre-compile  # Container for incorporation of CryIfGeneral.
      boolean CryIfDevErrorDetect: multiplicity set at pre-compile, set at pre-compile, default-value=true  # Switches the development error detection and notification on or off. | true: detection and notification is enabled. false: detection and notification is disabled.
      boolean CryIfVersionInfoApi: multiplicity set at pre-compile, set at pre-compile, default-value=false  # Pre-processor switch to enable and disable availability of the API CryIf_GetVersionInfo(). | True: API CryIf_GetVersionInfo() is available False: API CryIf_GetVersionInfo() is not available.
      integer CryIfMaxNumberOfKeyElements: 1..4294967295, multiplicity set at pre-compile, origin=Vector Informatik, set at pre-compile, default-value=10  # Maximum number of key elements in one key which needs to be copied from one driver to another.
      integer CryIfMaxSizeOfKeyElement: 1..4294967295, multiplicity set at pre-compile, origin=Vector Informatik, set at pre-compile, default-value=32  # Size of the largest key element which needs to be copied from one driver to another.
    container CryIfKey [1..*]: multiplicity set at pre-compile  # Container for incorporation of CryIfKey.
      integer CryIfKeyId: 0..4294967295, multiplicity set at pre-compile, set at pre-compile, symbolic-name-value=true, default-value=0  # Identifier of the CryIf key. | Specifies to which CryIf key the CSM key is mapped to.
      symbolic name reference CryIfKeyRef: multiplicity set at pre-compile, set at pre-compile, destination=CryptoKey  # This parameter refers to the crypto driver key. | Specifies to which crypto driver key the CryIf key is mapped to.
  bsw implementation CryIf_Impl: programming-language=C, sw-version=2.01.00, used-code-generator=DaVinci Configurator, vendor-id=30, ar-release-version=4.03.00, behavior=Behavior, preconfigured-configuration=CryIf_Pre, recommended-configuration=CryIf_Rec, vendor-specific-module-def=CryIf
  module config CryIf_Pre: definition=CryIf
  module config CryIf_Rec: definition=CryIf, implementation-config-variant=VARIANT-PRE-COMPILE
