AUTOSAR XML (schema 4-2-1)
# COPYRIGHT
# Copyright (c) 2017 by Vector Informatik GmbH. All rights reserved.
# This software is copyright protected and proprietary to Vector Informatik GmbH.
# Vector Informatik GmbH grants to you only those rights as set out in the license conditions.
package /MICROSAR
  bsw implementation vCanCcGbt_Impl: programming-language=C, sw-version=1.00.02, used-code-generator=DaVinci Configurator, vendor-id=30, ar-release-version=4.02.02, behavior=vCanCcGbBehavior, preconfigured-configuration=vCanCcGbt_Pre, recommended-configuration=vCanCcGbt_Rec, vendor-specific-module-def=vCanCcGbt
  module definition vCanCcGbt: category=VENDOR_SPECIFIC_MODULE_DEFINITION, post-build-variant-support=true, variants pre-compile/link-time/post-build  # Vector CAn Charge Communication GB/T 27930 | Configuration of the vCanCcGbt (Vector CAN Charge Communication GB/T 27930) module.
    container vCanCcGbtGeneral: multiplicity set at pre-compile  # General configuration parameters of the vCanCcGbt module.
      boolean vCanCcGbtDevErrorDetect: multiplicity set at pre-compile, origin=Vector Informatik, set at pre-compile, default-value=true  # Enables/disables the development error detection. Note: In general, the development error detection is recommended during pre-test phase. It is not recommended to enable the development error detection in production code due to increased runtime and ROM needs.
      float vCanCcGbtMainFunctionPeriod: 0.001..0.255, scope=ECU, multiplicity set at pre-compile, origin=Vector Informatik, set at pre-compile, default-value=0.01  # Execution cycle of vCanCcGbt_MainFunction.
      float vCanCcGbtTxConfirmationTimeout: 0..65.535, multiplicity set at pre-compile, origin=Vector Informatik, set at pre-compile, default-value=1.5  # Time to wait for a confirmation after transmission of a message. After this time, TxConfirmation is not expected to be called for the last transmission, and the message is assumed to have been lost.
      boolean vCanCcGbtVersionInfoApi: multiplicity set at pre-compile, origin=Vector Informatik, set at pre-compile, default-value=false  # Version Info API | Enables/disables the function vCanCcGbt_GetVersionInfo() to get major, minor and patch version information.
      string vCanCcGbtUserConfigurationFile [0..1]: multiplicity set at pre-compile, origin=Vector Informatik, set at pre-compile  # Reference to an external user configuration file that will be included during generation. The content of the user configuration file will be added at the end of the generated module configuration file and allows altering or extending the generated code. Caution: User configuration files can cause the software module to malfunction and must only be used with great care!
      boolean vCanCcGbtRuntimeErrorReport: multiplicity set at pre-compile, origin=Vector Informatik, set at pre-compile, default-value=true  # Enables/disables the reporting of runtime errors.
      integer vCanCcGbtInstanceId: 0..255, origin=Vector Informatik, set at pre-compile, default-value=0  # Id to configure the DET Instance Id. Can be used to distinguish the vCanCcGbt from other modules that used the CDD module Id.
    container vCanCcGbtConfigSet: multiplicity set at pre-compile  # Configuration parameters and sub containers of the vCanCcGbt module.
      symbolic name reference vCanCcGbtComMChannelRef: multiplicity set at pre-compile, origin=Vector Informatik, post-build-variant-value=true, set at post-build in variant link-time+post-build / pre-compile in variant pre-compile, destination=ComMChannel  # ComM Channel Ref | Reference to the channel defined by the ComMChannel providing access to the unique channel index ComMChannelId.
      container vCanCcGbtBclTxPdu: multiplicity set at pre-compile  # BCL Tx PDU | Contains the configuration of the I-PDU used to transmit the BCL message.
        integer vCanCcGbtBclTxPduId: 0..65535, scope=ECU, multiplicity set at pre-compile, origin=Vector Informatik, set at pre-compile, symbolic-name-value=true, default-value=0  # BCL Tx PDU ID | The I-PDU identifier used for TxConfirmation from PduR.
        reference vCanCcGbtBclTxPduRef: multiplicity set at pre-compile, origin=Vector Informatik, post-build-variant-value=true, set at post-build in variant link-time+post-build / pre-compile in variant pre-compile, destination=Pdu  # BCL Tx PDU Ref | Reference to the Pdu object representing the I-PDU.
      container vCanCcGbtBcpTxPdu: multiplicity set at pre-compile  # BCP Tx PDU | Contains the configuration of the I-PDU used to transmit the BCP message.
        integer vCanCcGbtBcpTxPduId: 0..65535, scope=ECU, multiplicity set at pre-compile, origin=Vector Informatik, set at pre-compile, symbolic-name-value=true, default-value=0  # BCP Tx PDU ID | The I-PDU identifier used for TxConfirmation from PduR.
        reference vCanCcGbtBcpTxPduRef: multiplicity set at pre-compile, origin=Vector Informatik, post-build-variant-value=true, set at post-build in variant link-time+post-build / pre-compile in variant pre-compile, destination=Pdu  # BCP Tx PDU Ref | Reference to the Pdu object representing the I-PDU.
      container vCanCcGbtBcsTxPdu: multiplicity set at pre-compile  # BCS Tx PDU | Contains the configuration of the I-PDU used to transmit the BCS message.
        integer vCanCcGbtBcsTxPduId: 0..65535, scope=ECU, multiplicity set at pre-compile, origin=Vector Informatik, set at pre-compile, symbolic-name-value=true, default-value=0  # BCS Tx PDU ID | The I-PDU identifier used for TxConfirmation from PduR.
        reference vCanCcGbtBcsTxPduRef: multiplicity set at pre-compile, origin=Vector Informatik, post-build-variant-value=true, set at post-build in variant link-time+post-build / pre-compile in variant pre-compile, destination=Pdu  # BCS Tx PDU Ref | Reference to the Pdu object representing the I-PDU.
      container vCanCcGbtBemTxPdu: multiplicity set at pre-compile  # BEM Tx PDU | Contains the configuration of the I-PDU used to transmit the BEM message.
        integer vCanCcGbtBemTxPduId: 0..65535, scope=ECU, multiplicity set at pre-compile, origin=Vector Informatik, set at pre-compile, symbolic-name-value=true, default-value=0  # BEM Tx PDU ID | The I-PDU identifier used for TxConfirmation from PduR.
        reference vCanCcGbtBemTxPduRef: multiplicity set at pre-compile, origin=Vector Informatik, post-build-variant-value=true, set at post-build in variant link-time+post-build / pre-compile in variant pre-compile, destination=Pdu  # BEM Tx PDU Ref | Reference to the Pdu object representing the I-PDU.
      container vCanCcGbtBhmTxPdu: multiplicity set at pre-compile  # BHM Tx PDU | Contains the configuration of the I-PDU used to transmit the BHM message.
        integer vCanCcGbtBhmTxPduId: 0..65535, scope=ECU, multiplicity set at pre-compile, origin=Vector Informatik, set at pre-compile, symbolic-name-value=true, default-value=0  # BHM Tx PDU ID | The I-PDU identifier used for TxConfirmation from PduR.
        reference vCanCcGbtBhmTxPduRef: multiplicity set at pre-compile, origin=Vector Informatik, post-build-variant-value=true, set at post-build in variant link-time+post-build / pre-compile in variant pre-compile, destination=Pdu  # BHM Tx PDU Ref | Reference to the Pdu object representing the I-PDU.
      container vCanCcGbtBmtTxPdu: multiplicity set at pre-compile  # BMT Tx PDU | Contains the configuration of the I-PDU used to transmit the BMT message.
        integer vCanCcGbtBmtTxPduId: 0..65535, scope=ECU, multiplicity set at pre-compile, origin=Vector Informatik, set at pre-compile, symbolic-name-value=true, default-value=0  # BMT Tx PDU ID | The I-PDU identifier used for TxConfirmation from PduR.
        reference vCanCcGbtBmtTxPduRef: multiplicity set at pre-compile, origin=Vector Informatik, post-build-variant-value=true, set at post-build in variant link-time+post-build / pre-compile in variant pre-compile, destination=Pdu  # BMT Tx PDU Ref | Reference to the Pdu object representing the I-PDU.
      container vCanCcGbtBmvTxPdu: multiplicity set at pre-compile  # BMV Tx PDU | Contains the configuration of the I-PDU used to transmit the BMV message.
        integer vCanCcGbtBmvTxPduId: 0..65535, scope=ECU, multiplicity set at pre-compile, origin=Vector Informatik, set at pre-compile, symbolic-name-value=true, default-value=0  # BMV Tx PDU ID | The I-PDU identifier used for TxConfirmation from PduR.
        reference vCanCcGbtBmvTxPduRef: multiplicity set at pre-compile, origin=Vector Informatik, post-build-variant-value=true, set at post-build in variant link-time+post-build / pre-compile in variant pre-compile, destination=Pdu  # BMV Tx PDU Ref | Reference to the Pdu object representing the I-PDU.
      container vCanCcGbtBrmTxPdu: multiplicity set at pre-compile  # BRM Tx PDU | Contains the configuration of the I-PDU used to transmit the BRM message.
        integer vCanCcGbtBrmTxPduId: 0..65535, scope=ECU, multiplicity set at pre-compile, origin=Vector Informatik, set at pre-compile, symbolic-name-value=true, default-value=0  # BRM Tx PDU ID | The I-PDU identifier used for TxConfirmation from PduR.
        reference vCanCcGbtBrmTxPduRef: multiplicity set at pre-compile, origin=Vector Informatik, post-build-variant-value=true, set at post-build in variant link-time+post-build / pre-compile in variant pre-compile, destination=Pdu  # BRM Tx PDU Ref | Reference to the Pdu object representing the I-PDU.
      container vCanCcGbtBroTxPdu: multiplicity set at pre-compile  # BRO Tx PDU | Contains the configuration of the I-PDU used to transmit the BRO message.
        integer vCanCcGbtBroTxPduId: 0..65535, scope=ECU, multiplicity set at pre-compile, origin=Vector Informatik, set at pre-compile, symbolic-name-value=true, default-value=0  # BRO Tx PDU ID | The I-PDU identifier used for TxConfirmation from PduR.
        reference vCanCcGbtBroTxPduRef: multiplicity set at pre-compile, origin=Vector Informatik, post-build-variant-value=true, set at post-build in variant link-time+post-build / pre-compile in variant pre-compile, destination=Pdu  # BRO Tx PDU Ref | Reference to the Pdu object representing the I-PDU.
      container vCanCcGbtBsdTxPdu: multiplicity set at pre-compile  # BSD Tx PDU | Contains the configuration of the I-PDU used to transmit the BSD message.
        integer vCanCcGbtBsdTxPduId: 0..65535, scope=ECU, multiplicity set at pre-compile, origin=Vector Informatik, set at pre-compile, symbolic-name-value=true, default-value=0  # BSD Tx PDU ID | The I-PDU identifier used for TxConfirmation from PduR.
        reference vCanCcGbtBsdTxPduRef: multiplicity set at pre-compile, origin=Vector Informatik, post-build-variant-value=true, set at post-build in variant link-time+post-build / pre-compile in variant pre-compile, destination=Pdu  # BSD Tx PDU Ref | Reference to the Pdu object representing the I-PDU.
      container vCanCcGbtBsmTxPdu: multiplicity set at pre-compile  # BSM Tx PDU | Contains the configuration of the I-PDU used to transmit the BSM message.
        integer vCanCcGbtBsmTxPduId: 0..65535, scope=ECU, multiplicity set at pre-compile, origin=Vector Informatik, set at pre-compile, symbolic-name-value=true, default-value=0  # BSM Tx PDU ID | The I-PDU identifier used for TxConfirmation from PduR.
        reference vCanCcGbtBsmTxPduRef: multiplicity set at pre-compile, origin=Vector Informatik, post-build-variant-value=true, set at post-build in variant link-time+post-build / pre-compile in variant pre-compile, destination=Pdu  # BSM Tx PDU Ref | Reference to the Pdu object representing the I-PDU.
      container vCanCcGbtBspTxPdu: multiplicity set at pre-compile  # BSP Tx PDU | Contains the configuration of the I-PDU used to transmit the BSP message.
        integer vCanCcGbtBspTxPduId: 0..65535, scope=ECU, multiplicity set at pre-compile, origin=Vector Informatik, set at pre-compile, symbolic-name-value=true, default-value=0  # BSP Tx PDU ID | The I-PDU identifier used for TxConfirmation from PduR.
        reference vCanCcGbtBspTxPduRef: multiplicity set at pre-compile, origin=Vector Informatik, post-build-variant-value=true, set at post-build in variant link-time+post-build / pre-compile in variant pre-compile, destination=Pdu  # BSP Tx PDU Ref | Reference to the Pdu object representing the I-PDU.
      container vCanCcGbtBstTxPdu: multiplicity set at pre-compile  # BST Tx PDU | Contains the configuration of the I-PDU used to transmit the BST message.
        integer vCanCcGbtBstTxPduId: 0..65535, scope=ECU, multiplicity set at pre-compile, origin=Vector Informatik, set at pre-compile, symbolic-name-value=true, default-value=0  # BST Tx PDU ID | The I-PDU identifier used for TxConfirmation from PduR.
        reference vCanCcGbtBstTxPduRef: multiplicity set at pre-compile, origin=Vector Informatik, post-build-variant-value=true, set at post-build in variant link-time+post-build / pre-compile in variant pre-compile, destination=Pdu  # BST Tx PDU Ref | Reference to the Pdu object representing the I-PDU.
      container vCanCcGbtCcsRxPdu: multiplicity set at pre-compile  # CCS Rx PDU | Contains the configuration of the I-PDU used to receive the CCS message.
        integer vCanCcGbtCcsRxPduId: 0..65535, scope=ECU, multiplicity set at pre-compile, origin=Vector Informatik, set at pre-compile, symbolic-name-value=true, default-value=0  # CCS Rx PDU ID | The I-PDU identifier used for RxIndication from PduR.
        reference vCanCcGbtCcsRxPduRef: multiplicity set at pre-compile, origin=Vector Informatik, post-build-variant-value=true, set at post-build in variant link-time+post-build / pre-compile in variant pre-compile, destination=Pdu  # CCS Rx PDU Ref | Reference to the Pdu object representing the I-PDU.
      container vCanCcGbtCemRxPdu: multiplicity set at pre-compile  # CEM Rx PDU | Contains the configuration of the I-PDU used to receive the CEM message.
        integer vCanCcGbtCemRxPduId: 0..65535, scope=ECU, multiplicity set at pre-compile, origin=Vector Informatik, set at pre-compile, symbolic-name-value=true, default-value=0  # CEM Rx PDU ID | The I-PDU identifier used for RxIndication from PduR.
        reference vCanCcGbtCemRxPduRef: multiplicity set at pre-compile, origin=Vector Informatik, post-build-variant-value=true, set at post-build in variant link-time+post-build / pre-compile in variant pre-compile, destination=Pdu  # CEM Rx PDU Ref | Reference to the Pdu object representing the I-PDU.
      container vCanCcGbtChmRxPdu: multiplicity set at pre-compile  # CHM Rx PDU | Contains the configuration of the I-PDU used to receive the CHM message.
        integer vCanCcGbtChmRxPduId: 0..65535, scope=ECU, multiplicity set at pre-compile, origin=Vector Informatik, set at pre-compile, symbolic-name-value=true, default-value=0  # CHM Rx PDU ID | The I-PDU identifier used for RxIndication from PduR.
        reference vCanCcGbtChmRxPduRef: multiplicity set at pre-compile, origin=Vector Informatik, post-build-variant-value=true, set at post-build in variant link-time+post-build / pre-compile in variant pre-compile, destination=Pdu  # CHM Rx PDU Ref | Reference to the Pdu object representing the I-PDU.
      container vCanCcGbtCmlRxPdu: multiplicity set at pre-compile  # CML Rx PDU | Contains the configuration of the I-PDU used to receive the CML message.
        integer vCanCcGbtCmlRxPduId: 0..65535, scope=ECU, multiplicity set at pre-compile, origin=Vector Informatik, set at pre-compile, symbolic-name-value=true, default-value=0  # CML Rx PDU ID | The I-PDU identifier used for RxIndication from PduR.
        reference vCanCcGbtCmlRxPduRef: multiplicity set at pre-compile, origin=Vector Informatik, post-build-variant-value=true, set at post-build in variant link-time+post-build / pre-compile in variant pre-compile, destination=Pdu  # CML Rx PDU Ref | Reference to the Pdu object representing the I-PDU.
      container vCanCcGbtCrmRxPdu: multiplicity set at pre-compile  # CRM Rx PDU | Contains the configuration of the I-PDU used to receive the CRM message.
        integer vCanCcGbtCrmRxPduId: 0..65535, scope=ECU, multiplicity set at pre-compile, origin=Vector Informatik, set at pre-compile, symbolic-name-value=true, default-value=0  # CRM Rx PDU ID | The I-PDU identifier used for RxIndication from PduR.
        reference vCanCcGbtCrmRxPduRef: multiplicity set at pre-compile, origin=Vector Informatik, post-build-variant-value=true, set at post-build in variant link-time+post-build / pre-compile in variant pre-compile, destination=Pdu  # CRM Rx PDU Ref | Reference to the Pdu object representing the I-PDU.
      container vCanCcGbtCroRxPdu: multiplicity set at pre-compile  # CRO Rx PDU | Contains the configuration of the I-PDU used to receive the CRO message.
        integer vCanCcGbtCroRxPduId: 0..65535, scope=ECU, multiplicity set at pre-compile, origin=Vector Informatik, set at pre-compile, symbolic-name-value=true, default-value=0  # CRO Rx PDU ID | The I-PDU identifier used for RxIndication from PduR.
        reference vCanCcGbtCroRxPduRef: multiplicity set at pre-compile, origin=Vector Informatik, post-build-variant-value=true, set at post-build in variant link-time+post-build / pre-compile in variant pre-compile, destination=Pdu  # CRO Rx PDU Ref | Reference to the Pdu object representing the I-PDU.
      container vCanCcGbtCsdRxPdu: multiplicity set at pre-compile  # CSD Rx PDU | Contains the configuration of the I-PDU used to receive the CSD message.
        integer vCanCcGbtCsdRxPduId: 0..65535, scope=ECU, multiplicity set at pre-compile, origin=Vector Informatik, set at pre-compile, symbolic-name-value=true, default-value=0  # CSD Rx PDU ID | The I-PDU identifier used for RxIndication from PduR.
        reference vCanCcGbtCsdRxPduRef: multiplicity set at pre-compile, origin=Vector Informatik, post-build-variant-value=true, set at post-build in variant link-time+post-build / pre-compile in variant pre-compile, destination=Pdu  # CSD Rx PDU Ref | Reference to the Pdu object representing the I-PDU.
      container vCanCcGbtCstRxPdu: multiplicity set at pre-compile  # CST Rx PDU | Contains the configuration of the I-PDU used to receive the CST message.
        integer vCanCcGbtCstRxPduId: 0..65535, scope=ECU, multiplicity set at pre-compile, origin=Vector Informatik, set at pre-compile, symbolic-name-value=true, default-value=0  # CST Rx PDU ID | The I-PDU identifier used for RxIndication from PduR.
        reference vCanCcGbtCstRxPduRef: multiplicity set at pre-compile, origin=Vector Informatik, post-build-variant-value=true, set at post-build in variant link-time+post-build / pre-compile in variant pre-compile, destination=Pdu  # CST Rx PDU Ref | Reference to the Pdu object representing the I-PDU.
      container vCanCcGbtCtsRxPdu: multiplicity set at pre-compile  # CTS Rx PDU | Contains the configuration of the I-PDU used to receive the CTS message.
        integer vCanCcGbtCtsRxPduId: 0..65535, scope=ECU, multiplicity set at pre-compile, origin=Vector Informatik, set at pre-compile, symbolic-name-value=true, default-value=0  # CTS Rx PDU ID | The I-PDU identifier used for RxIndication from PduR.
        reference vCanCcGbtCtsRxPduRef: multiplicity set at pre-compile, origin=Vector Informatik, post-build-variant-value=true, set at post-build in variant link-time+post-build / pre-compile in variant pre-compile, destination=Pdu  # CTS Rx PDU Ref | Reference to the Pdu object representing the I-PDU.
  module config vCanCcGbt_Pre: definition=vCanCcGbt
  module config vCanCcGbt_Rec: definition=vCanCcGbt
