AUTOSAR XML (schema 4-0-3)
package /MICROSAR
  module config Fee_Rec: definition=Fee
    FeeGeneral: FeeSafeBswChecks=1
