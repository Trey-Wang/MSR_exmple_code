AUTOSAR XML (schema 4-2-2)
package /MICROSAR
  module definition FvM [0..1]: category=VENDOR_SPECIFIC_MODULE_DEFINITION, api-service-prefix=FvM, post-build-variant-support=true, refined-module-def=FvM, variants pre-compile  # Freshness Value Manager | The Freshness Value Manager proides freshness values to the SecOC.
    container FvMFreshnessValueRxProcessing [0..*]: multiplicity set at pre-compile  # Freshness value Processings for reception side.
      reference FvMProcessingRef: multiplicity set at pre-compile, origin=Vector Informatik, set at pre-compile, destination=SecOCRxPduProcessing  # Reference to the related SecOC processing.
      choice container FvMFreshnessValueUseCase: multiplicity set at pre-compile  # Freshness value use case choice container.
        container FvMJasparAttributes [0..1]: multiplicity set at pre-compile  # Jaspar Freshness Value UseCase Attributes.
          integer FvMMessageCounterBitSize: 0..16, multiplicity set at pre-compile, origin=Vector Informatik, set at pre-compile, default-value=8  # Message Counter bit size.
          integer FvMResetFlagBitSize: 0..8, multiplicity set at pre-compile, origin=Vector Informatik, set at pre-compile, default-value=2  # Reset flag bit size.
        container FvMSyncMessage [0..1]: multiplicity set at pre-compile  # Freshness Value Sync Message Container.
    container FvMFreshnessValueTxProcessing [0..*]: multiplicity set at pre-compile  # Freshness value Processings for transmission side.
      reference FvMProcessingRef: multiplicity set at pre-compile, origin=Vector Informatik, set at pre-compile, destination=SecOCTxPduProcessing  # Reference to the related SecOC processing.
      choice container FvMFreshnessValueUseCase: multiplicity set at pre-compile  # Freshness value use case choice container.
        container FvMJasparAttributes [0..1]: multiplicity set at pre-compile  # Jaspar Freshness Value UseCase Attributes.
          integer FvMMessageCounterBitSize: 0..16, multiplicity set at pre-compile, origin=Vector Informatik, set at pre-compile, default-value=8  # Message Counter bit size.
          integer FvMResetFlagBitSize: 0..8, multiplicity set at pre-compile, origin=Vector Informatik, set at pre-compile, default-value=2  # Reset flag bit size.
    container FvMGeneral: multiplicity set at pre-compile  # Freshness Value Manager General Attributes Container.
      boolean FvMDevErrorDetect: multiplicity set at pre-compile, origin=Vector Informatik, set at pre-compile, default-value=true  # Pre-processor switch for enabling development error detection support.
      boolean FvMVersionInfoApi: multiplicity set at pre-compile, origin=Vector Informatik, set at pre-compile, default-value=false  # If true the SecOC_GetVersionInfo API is available.
      float FvMStartUpAcceptanceTime [0..1]: 0..3600, multiplicity set at pre-compile, origin=Vector Informatik, set at pre-compile, default-value=0  # This parameter defines the time during start up in which all messages are accepted. The "accept all messages" behavior is stopped if a valid sync message is received or the time runns out. If this is feature is not configured, only valid messages will be accepted.
      float FvMMainFunctionPeriod [0..1]: 0..0.255, multiplicity set at pre-compile, origin=Vector Informatik, set at pre-compile, default-value=0.01  # Mainfunction Period time.
      boolean FvMSafeBswChecks: multiplicity set at pre-compile, origin=Vector Informatik, set at pre-compile, default-value=false  # Selects if safety checks are used. These checks improve robustness as e.g. invalid parameters are checked before function is executed. This attribute has to be enabled for safety projects where this component is mapped to an ASIL partition.
    container FvMJasparGeneral [0..1]: multiplicity set at pre-compile  # Freshness Value Manager Jaspar Freshness Value Use Case General Attributes Container.
      integer FvMTripCounterBitSize: 0..24, multiplicity set at pre-compile, origin=Vector Informatik, set at pre-compile, default-value=16  # Trip Counter bit size.
      integer FvMResetCounterBitSize: 0..48, multiplicity set at pre-compile, origin=Vector Informatik, set at pre-compile, default-value=20  # Reset Counter bit size.
      integer FvMClearAcceptanceWindow: 0..255, multiplicity set at pre-compile, origin=Vector Informatik, set at pre-compile, default-value=0  # This parameter defines the amount of Sync messages that can be lost before an trip counter overflow.
      function name FvMTripCounterReachMaxNotification [0..1]: multiplicity set at pre-compile, origin=Vector Informatik, set at pre-compile, default-value=Appl_FvM_TripCounterReachMax  # This function is called if the Trip Coutner value is updated to its MAX value.
      function name FvMResetCounterReachMaxNotification [0..1]: multiplicity set at pre-compile, origin=Vector Informatik, set at pre-compile, default-value=Appl_FvM_ResetCounterReachMax  # This function is called if the Reset Coutner value is updated to its MAX value.
      function name FvMRxMessageCounterReachMaxNotification [0..1]: multiplicity set at pre-compile, origin=Vector Informatik, set at pre-compile, default-value=Appl_FvM_RxMessageCounterReachMax  # This function is called if a Message Couter reaches the the MAX value.
      function name FvMTxMessageCounterReachMaxNotification [0..1]: multiplicity set at pre-compile, origin=Vector Informatik, set at pre-compile, default-value=Appl_FvM_TxMessageCounterReachMax  # This function is called if a Message Couter reaches the the MAX value.
      boolean FvMTxUseDefaultFreshnessValueDuringStartUp: multiplicity set at pre-compile, origin=Vector Informatik, set at pre-compile, default-value=false  # If enabled the the FvM will return a default freshness value during strart up until the first sync message is received. If disabled the FvM will returns E_NOT_OK if a Tx Freshness value is requested.
      symbolic name reference FvMTripCounterNvMBlockDescriptor [0..1]: multiplicity set at pre-compile, origin=Vector Informatik, set at pre-compile, destination=NvMBlockDescriptor  # Not used yet
    container FvMGeneration: multiplicity set at pre-compile
      enumeration FvMOutOfBoundsWriteProtectionStrategy: multiplicity set at pre-compile, origin=Vector Informatik, set at pre-compile, default-value=NONE  # This parameter is used to configure a strategy to protect the code to write out of bounds. NONE: no protection strategy is generated in the data access. INDEX_SATURATION: arrays are blown up and the data access index is saturated by an appropriate mask. The advantage is the speed of the data access, but own data elements at other indexes of the same variable can be overridden. INDEX_CHECKING: the data access index is validated by a runtime check. The advantage is that values are never written to incorrect indexes of the data access.
        NONE  # none
        INDEX_SATURATION  # index saturation
        INDEX_CHECKING  # index checking
      boolean FvMOutOfBoundsWriteSanitizer: multiplicity set at pre-compile, origin=Vector Informatik, set at pre-compile, default-value=false  # This parameter activates/deactivates the generation of runtime checks which call a DET error notification function to find easily out of bounds write problems. FALSE: no checks are generated in the data access. TRUE: the data access is enriched with DET checks to validate indexes.
      boolean FvMOutOfBoundsReadSanitizer: multiplicity set at pre-compile, origin=Vector Informatik, set at pre-compile, default-value=false  # This parameter activates/deactivates the generation of runtime checks which call a DET error notification function to find easily out of bounds read problems. FALSE: no checks are generated in the data access. TRUE: the data access is enriched with DET checks to validate indexes.
      boolean FvMShortSymbols: multiplicity set at pre-compile, origin=Vector Informatik, set at pre-compile, default-value=false  # This parameter activates/deactivates the capability to generate shortened symbol names. FALSE: symbol names are generated in a human readable style based on the MIP, tags and variant names. TRUE: symbol names are generated based on the MIP and a CRC32.
      boolean FvMInterfacesForDeactivatedData: multiplicity set at pre-compile, origin=Vector Informatik, set at pre-compile, default-value=false  # This parameter activates/deactivates the capability to generate bsw data interfaces for deactivated data elements. This is an advantage for the BSW developer to reduce the time to market with a development environment using auto completition and to investigate potential interfaces. FALSE: data interfaces are not generated if the data elementis deactivated. TRUE: data interfaces are generated as e.g. emty macros.
      boolean FvMReferringKeysInComments: multiplicity set at pre-compile, origin=Vector Informatik, set at pre-compile, default-value=false  # This parameter activates/deactivates the capability to generate referring keys in comments. This is an advantage for the developer to investigate indirections, but this feature reduces the overall readability of the generated data. FALSE: referring keys are not generated in comments. TRUE: referring keys are generated in comments.
  bsw implementation FvM_Impl: programming-language=C, sw-version=2.03.00, used-code-generator=DaVinci Configurator, vendor-id=30, ar-release-version=4.02.02, behavior=FvMBehavior, preconfigured-configuration=FvM_Pre, recommended-configuration=FvM_Rec, vendor-specific-module-def=FvM
  module config FvM_Pre: definition=FvM
  module config FvM_Rec: definition=FvM
