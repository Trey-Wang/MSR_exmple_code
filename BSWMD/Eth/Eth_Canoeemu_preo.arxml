AUTOSAR XML (schema 4-0-3)
package /MICROSAR/Eth_Canoeemu
  module config Eth_Pre: definition=Eth
  module config Eth_Rec: definition=Eth
