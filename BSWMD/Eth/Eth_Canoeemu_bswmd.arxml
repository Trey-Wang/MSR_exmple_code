AUTOSAR XML (schema 4-1-1)
package /MICROSAR/Eth_Canoeemu
  module definition Eth [0..*]: category=VENDOR_SPECIFIC_MODULE_DEFINITION, refined-module-def=Eth, variants pre-compile  # Ethernet Controller Driver | Configuration of the ETH (Ethernet Controller Driver) module.
    container EthGeneral  # General configuration parameters of the ETH module.
      boolean EthDevErrorDetect: set at pre-compile, default-value=true  # Dev Error Detect | This parameter switches the Development Error Detection and Notification ON or OFF. true: Development error detection is enabled. false: Development error detection is disabled. Note: In general, the development error detection is recommended during pre-test phase. It is not recommended to enable the development error detection in production code due to increased runtime and ROM needs.
      boolean EthVersionInfoApi: set at pre-compile, default-value=false  # Version Info API | This parameter enables/disables the function Eth_GetVersionInfo() to get major, minor and patch version information.
      boolean EthVersionInfoApiMacro [0..1]: set at pre-compile, default-value=false  # Version Info API Macro | Parameter not used. This parameter defines if Eth_GetVersionInfo() is implemented as a macro.
      string EthUserConfigFile [0..1]: set at pre-compile, origin=Vector Informatik  # User Config File | Reference to an external text file that will be included during generation to Eth_Cfg.h. The content of the user configuration file will be added at the end of the generated module configuration file and allows altering or extending the generated code. Caution: User configuration files can cause the software module to malfunction and must only be used with great care!
      boolean EthEnableMibCounter: set at pre-compile, origin=Vector Informatik, default-value=true  # Enable Mib Counter | This parameter defines if the MIB (Management information base) counter support is enabled. MIB counters are administrated by the Ethernet controller and log statistical transmission and reception information, e.g. packet loss rates.
      boolean EthEnableRxInterrupt: set at pre-compile, origin=Vector Informatik, default-value=true  # Enable Rx Interrupt | This parameter defines if the receive interrupt is used. If enabled, the driver gets immediately informed about a frame reception, leading to a low latency between frame reception and the processing of its content. If disabled, polling mode is used. In contrast to the interrupt mode, polling leads to a higher latency. Restrictions: 'EthEnableRxInterrupt' and 'EthIfEnableRxInterrupt' must be set to the same value.
      boolean EthEnableTxInterrupt: set at pre-compile, origin=Vector Informatik, default-value=true  # Enable Tx Interrupt | This parameter defines if the transmit interrupt is used. If enabled, the driver gets immediately informed when a frame transmission is done, leading to a low latency between frame transmission and the indication to upper layers that the frame was transmitted. If disabled, polling mode is used. In contrast to the interrupt mode, polling leads to a higher latency. Restrictions: 'EthEnableTxInterrupt' and 'EthIfEnableTxInterrupt' must be set to the same value.
      boolean EthEnableApiOptimization: set at pre-compile, origin=Vector Informatik, default-value=false  # Enable API Optimization | This parameter defines if the API Optimization is enabled. If enabled, the controller index parameter that is used for nearly all Ethernet Controller Driver APIs is omitted. API Optimization is applicable if only one EthCtrlConfig is configured. That leads to a controller index parameter of zero in any case an API is called. If more than one EthCtrlConfig is used, the controller index parameter is needed and API Optimization must not be enabled.
      integer EthIndex: 0..255, set at pre-compile, default-value=0  # This value specifies the instance ID of this module instance. If only one instance is present it shall have the ID 0. The instance ID is a unique identifier for an Ethernet Controller Driver. If multiple drivers are used in a system, these drivers are identifies by different instance IDs.
      integer EthMaxCtrlsSupported: 1..255, set at pre-compile, default-value=1  # This value specifies the number of controller configurations (EthCtrlConfig containers) per driver. For each Ethernet Controller IC in a system that is driven by this Ethernet Driver, a separate EthCtrlConfig must be added.
      boolean EthUpdatePhysAddrFilter: set at pre-compile, default-value=false  # Enables/Disables optional API Eth_UpdatePhysAddrFilter. The API is used to enable and disable the frame reception filter for multicast addresses. If the filter for a certain multicast address is enabled, all frames are received that are destined for that address.
      boolean EthEnableExplicitBufferMapping: set at pre-compile, origin=Vector Informatik, default-value=false  # This parameter defines if RX and TX Ethernet buffers of different controllers and descriptor queues can be mapped to different memory locations. The final mapping is done via AUTOSAR Memory Map, whereas the user must implement the buffer specific memory sections within the memory map by himself.
      boolean EthRuntimeMeasurementSupport: set at pre-compile, origin=Vector Informatik, default-value=false  # If enabled runtime measurement points are added to the BSW module code and are added to the module configuration of MICROSAR RTM. The available measurement points can be seen and configured in the RTM module configuration. Availability of the MICROSAR RTM module is a prerequisite to make use of the runtime measurement functionality. Runtime measurement should be disabled in production code as measurement points may inflict additional runtime.
      enumeration EthOsIsrCategory: {CATEGORY_1, CATEGORY_2, NO_OS_SUPPORT}, set at pre-compile, origin=Vector Informatik, default-value=CATEGORY_2  # This parameter specifies how the interrupt routines will be handled. If CATEGORY_1 or CATEGORY_2 is selected the Os will handle the interrupts according to the seleted category. For interrupt handling without support from Os the value NO_OS_SUPPORT must be selected.
      enumeration EthRuntimeEnvironment: {ETH_AUTOSAR_OS}, set at pre-compile, origin=Vector Informatik, default-value=ETH_AUTOSAR_OS  # Runtime Environment | This parameter defines the runtime environment the Ethernet driver is executed on. ETH_AUTOSAR_OS: The driver is executed in a common AUTOSAR OS environment.
      string EthAdditionalIncludes [0..*]: set at pre-compile, origin=Vector Informatik  # Additional Includes | This parameter defines an additional file to be included in the Eth_Lcfg.h.
    container EthConfigSet  # This container includes containers and parameters that are related to the EthIf configuration.
      container EthCtrlConfig [1..*]  # This container includes the configuration of the individual controller. For each Ethernet Controller IC in a system that is driven by this Ethernet Driver, a separate EthCtrlConfig container must be added.
        boolean EthCtrlEnableMii: set at pre-compile, default-value=true  # Enable MII | This parameter defines if the Media Independent Interface (MII) for transceiver access is enabled. MII access is used to read and write transceiver specific registers. One of the most common information that is hold by a transceiver register is the link state. Reading the link state requires an access to the MII interface. Restrictions: Must be enabled if a transceiver driver module is configured.
        boolean EthCtrlEnableRxInterrupt: set at pre-compile, default-value=true  # Enable Rx Interrupt | This parameter defines if the receive interrupt for the specific controller is enabled. If enabled, the driver gets immediately informed about a frame reception, leading to a low latency between frame reception and the processing of its content. If disabled, polling mode is used. In contrast to the interrupt mode, polling leads to a higher latency. Restrictions: 'EthCtrlEnableRxInterrupt' must be equal for all controllers and equal to 'EthEnableRxInterrupt'
        boolean EthCtrlEnableTxInterrupt: set at pre-compile, default-value=true  # Enable Tx Interrupt | This parameter defines if the transmit interrupt for the specific controller is enabled. If enabled, the driver gets immediately informed when a frame transmission is done, leading to a low latency between frame transmission and the indication to upper layers that the frame was transmitted. If disabled, polling mode is used. In contrast to the interrupt mode, polling leads to a higher latency. Restrictions: 'EthCtrlEnableTxInterrupt' must be equal for all controllers and equal to 'EthEnableTxInterrupt'
        boolean EthCtrlEnableMacWriteAccess: set at pre-compile, origin=Vector Informatik, default-value=false  # Enable MAC-Address Write Access | This parameter defines if access to an NvM block containing the MAC address and the corresponding API is enabled. Usually the MAC address can be changed during runtime by a call to Eth_SetPhysAddr. This call is not persistent and must be repeated each time the ECU restarts. Enabling this option leads to a persistant storage of the MAC address within a non-volatile memory. The NvM block that holds the address is specified by the reference parameter EthCtrlNvmBlockDescriptor.
        integer EthCtrlIdx: 0..255, set at pre-compile, symbolic-name-value=true, default-value=0  # Controller Index | This value specifies the ID of the configured controller. Each EthCtrlConfig gets a unique ID for identification
        integer EthCtrlRxBufLenByte: 64..1522, set at pre-compile, default-value=1522  # Rx Buffer Length | This value specifies the maximum receive buffer length. The value is set automatically depending on the EthRxBufConfig container(s). The EthRxBufConfig containers allow a more granular configuration of reception buffers. Restrictions: Value has to be the maximum value of all 'EthCtrlRxBufLenByte' in 'EthRxBufConfig' containers.
        integer EthCtrlTxBufLenByte: 64..1522, set at pre-compile, default-value=1522  # Tx Buffer Length | This value specifies the maximum transmit buffer length. The value is set automatically depending on the EthTxBufConfig container(s). The EthTxBufConfig containers allow a more granular configuration of transmission buffers. Resctrictions: Value has to be the maximum value of all 'EthCtrlTxBufLenByte' in 'EthTxBufConfig' containers.
        integer EthRxBufTotal: 0..255, set at pre-compile, default-value=2  # Rx Buffer Count | This value specifies the number of receive buffers. Resctrictions: Value has to be the sum of all values of 'EthRxBufTotal' in container 'EthRxBufConfig'.
        integer EthTxBufTotal: 0..255, set at pre-compile, default-value=2  # Tx Buffer Count | This value specifies the number of transmit buffers. Restrictions: Value has to be the sum of all values of 'EthTxBufTotal' in container 'EthTxBufConfig'.
        string EthCtrlCanoeBusName: set at pre-compile, origin=Vector Informatik, default-value=Ethernet  # This parameter defines the CANoe bus name, the node is connected to. The channel name needs to be consistent to the CANoe bus name.
        string EthCtrlPhysAddr [0..1]: set at pre-compile  # Physical Address (MAC-Address) | This parameter defines the Controller Physical Hardware Address (MAC-Address). The input format has to match xx:xx:xx:xx:xx:xx, where x stands for a hex value between 0 and F.
        boolean EthCtrlPreControllerInitCallout: set at pre-compile, origin=Vector Informatik, default-value=false  # Pre Controller Init Callout | This parameter defines if a callout is generated, which can be used to add special startup handling before Eth_ControllerInit is execeuted.
        boolean EthCtrlPostControllerInitCallout: set at pre-compile, origin=Vector Informatik, default-value=false  # Post Controller Init Callout | This parameter defines if a callout is generated, which can be used to add special startup handling after Eth_ControllerInit is execeuted.
        reference EthCtrlNvmBlockDescriptor [0..1]: set at pre-compile, origin=Vector Informatik, destination=NvMBlockDescriptor  # NvM Block Descriptor | Reference to an NvM block descriptor which is used to store the MAC address persistently after a call to Eth_SetPhysAddr. The NvM descriptor is only necessary if the option EthCtrlEnableMacWriteAccess is enabled.
        container EthRxBufConfig [1..*]  # This container includes configuration of an RX buffer. Each RX buffer is used to hold one reception frame. By default, 2 RX buffers are used that is sufficient for low data rates. The higher the expected data rates the more buffers are necessary to avoid packet losses.
          integer EthRxSegmentNumber: 2..65535, set at pre-compile, origin=Vector Informatik, default-value=2  # Number of Rx Segments | This value defines the number of Rx segments the receiver buffer is assembled of.
          integer EthRxSegmentSize: 60..1522, set at pre-compile, origin=Vector Informatik, default-value=1518  # Rx Buffer Segment Size | This parameter defines the size of a segment the receive buffer is built of. Multiple of these segments are used to hold a complete Ethernet frame.
          integer EthRxMaxFrameSize: 60..1522, set at pre-compile, origin=Vector Informatik, default-value=1518  # Maximum Rx Frame Size | This parameter defines the maximum length of an Ethernet frame, which is allowed to be received.
        container EthTxBufConfig [1..*]  # This container includes configuration of a TX buffer. Each TX buffer is used to hold one transmission frame. By default, 2 TX buffers are used that is sufficient for low data rates. The higher the expected data rates the more buffers are necessary to avoid packet losses.
          integer EthCtrlTxBufLenByte: 64..1522, set at pre-compile, origin=Vector Informatik, default-value=1518  # Maximum Tx Buffer Size | This value limits the maximum length (including Ethernet header + payload + CRC) of the Ethernet frame in bytes. In case VLAN is enabled the Ethernet header length is 18, otherwise 14. The maximum payload length is 1500 bytes and the minimum length is 46 bytes. The CRC consists of 4 bytes. Example: - Configuring a buffer that shall hold a VLAN tagged Ethernet frame with a maximum payload of 1500 bytes, the overall frame length is 1500 bytes payload + 18 bytes header + 4 bytes CRC = 1522 bytes. - Configuring a buffer that shall hold an Ethernet frame without VLAN tag and a minimum payload of 46 bytes, the overall frame length is 46 bytes payload + 14 bytes header + 4 bytes CRC = 64 bytes.
          integer EthTxBufTotal: 2..255, set at pre-compile, origin=Vector Informatik, default-value=2  # Number of Tx Buffers | This value specifies the number of transmit buffers. Each TX buffer is used to hold one transmission frame. By default, 2 TX buffers are used that is sufficient for low data rates. The higher the expected data rates the more buffers are necessary to avoid packet losses.
        container EthDemEventParameterRefs [0..1]  # This container includes the references to DemEventParameter elements which shall be invoked using the API Dem_ReportErrorStatus API in case the corresponding error occurs. The EventId is taken from the referenced DemEventParameter's DemEventId value.
          symbolic name reference ETH_E_ACCESS [0..1]: set at pre-compile, origin=Vector Informatik, destination=DemEventParameter  # Reference to the DemEventParameter which shall be issued when the error ETH_E_ACCESS has occurred.
        container EthCtrlOffloading  # This container includes the configuration for checksum offloading.
          boolean EthCtrlEnableOffloadChecksumIPv4: set at pre-compile, default-value=false  # This parameter defines that the IPv4 checksum calculation is offloaded to the ethernet controller and calculated by hardware.
          boolean EthCtrlEnableOffloadChecksumICMP: set at pre-compile, default-value=false  # This parameter defines that the ICMP checksum calculation is offloaded to the ethernet controller and calculated by hardware.
          boolean EthCtrlEnableOffloadChecksumTCP: set at pre-compile, default-value=false  # This parameter defines that the checksum calculation for IPv4 encapsulated TCP segments is offloaded to the ethernet controller and calculated by hardware.
          boolean EthCtrlEnableOffloadChecksumUDP: set at pre-compile, default-value=false  # This parameter defines that the checksum calculation for IPv4 encapsulated UDP is offloaded to the ethernet controller and calculated by hardware.
          boolean EthCtrlEnableOffloadChecksumTCPv6: set at pre-compile, origin=Vector Informatik, default-value=false  # Ctrl Enable Offload Checksum IPv6 encapsulated TCP | This parameter defines that the checksum calculation for IPv6 encapsulated TCPis offloaded to the ethernet controller and calculated by hardware.
          boolean EthCtrlEnableOffloadChecksumICMPv6: set at pre-compile, origin=Vector Informatik, default-value=false  # Ctrl Enable Offload Checksum ICMPv6 | This parameter defines that the ICMPv6 checksum calculation is offloaded to the ethernet controller and calculated by hardware.
          boolean EthCtrlEnableOffloadChecksumIPv6HeaderRouting: set at pre-compile, origin=Vector Informatik, default-value=false  # This parameter defines that the checksum offloading for protocols encapsulated in IPv6 with Routing extension header is enabled.
          boolean EthCtrlEnableOffloadChecksumIPv6HeaderDestinationOptions: set at pre-compile, origin=Vector Informatik, default-value=false  # This parameter defines that the checksum offloading for protocols encapsulated in IPv6 with Destination Options extension header is enabled.
          boolean EthCtrlEnableOffloadChecksumIPv6HeaderHopByHopOptions: set at pre-compile, origin=Vector Informatik, default-value=false  # This parameter defines that the checksum offloading for protocols encapsulated in IPv6 with Hop by Hop Options extension header is enabled.
          boolean EthCtrlEnableOffloadChecksumUDPv6: set at pre-compile, origin=Vector Informatik, default-value=false  # Ctrl Enable Offload Checksum IPv6 encapsulated UDP | This parameter defines that the checksum calculation for IPv6 encapsulated UDP is offloaded to the ethernet controller and calculated by hardware.
        choice container EthRuntimeEnvironment
          container EthAutosarOs [0..1]
            integer EthRegBaseAddress: 0..18446744073709551615, set at pre-compile, origin=Vector Informatik, default-value=0  # Register Base Address | This parameter defines the register base address for the Ethernet controller used.
  bsw implementation Eth_Impl: programming-language=C, sw-version=5.00.00, used-code-generator=DaVinci Configurator, vendor-id=30, ar-release-version=4.01.01, behavior=EthBehavior, preconfigured-configuration=Eth_Pre, recommended-configuration=Eth_Rec, vendor-specific-module-def=Eth
  module config Eth_Pre: definition=Eth
  module config Eth_Rec: definition=Eth
