AUTOSAR XML (schema 4-3-0)
# COPYRIGHT
# Copyright (c) 2017 by Vector Informatik GmbH. All rights reserved.
# This software is copyright protected and proprietary to Vector Informatik GmbH.
# Vector Informatik GmbH grants to you only those rights as set out in the license conditions.
package /MICROSAR
  bsw implementation vIpc_Impl: programming-language=C, sw-version=0.02.00, used-code-generator=DaVinci Configurator, vendor-id=30, ar-release-version=4.03.00, behavior=vIpcBehavior, preconfigured-configuration=vIpc_Pre, recommended-configuration=vIpc_Rec, vendor-specific-module-def=vIpc
  module definition vIpc [0..1]: category=VENDOR_SPECIFIC_MODULE_DEFINITION, variants pre-compile  # Configuration of the vIpc (vector Interprocessor communication) module.
    container vIpcGeneral  # General configuration parameters of vIpc.
      boolean vIpcDevErrorDetect: origin=Vector Informatik, default-value=true  # This parameter switches the Development Error Detection and Notification ON or OFF. true: Development error detection is enabled. false: Development error detection is disabled.
      boolean vIpcSafeBswChecks: origin=Vector Informatik, default-value=false  # Selects whether safety checks are used. These checks improve robustness as e.g. invalid parameter values are detected before a function is executed. This attribute has to be enabled for safety projects where this component is mapped to an ASIL partition.
      float vIpcMainFunctionCycle: 0..65535, origin=Vector Informatik, default-value=0.005
      string vIpcUserConfigFile [0..1]: origin=Vector Informatik, default-value=vIpc_UserCfg.h  # Reference to an external text file that will be included into vIpc_Cfg.h during generation. The content of the user configuration file will be added at the end of the generated module configuration file and allows altering or extending the generated code. Caution: User configuration files can cause the software module to malfunction and must only be used with great care!
      boolean vIpcRuntimeErrorReport: origin=Vector Informatik, default-value=true
    container vIpcConfig  # This container includes one or several multiple configuration sets.
      container vIpcRxChannel [0..*]  # vIpcRxChannel is a representation of a physical channel that will receive a data stream from another vIpc instance.
        integer vIpcRxChannelId: 0..65535, origin=Vector Informatik, symbolic-name-value=true, default-value=0  # Handle id that is used for Rx functions by the lower layer.
        reference vIpcRxPduRef: origin=Vector Informatik, destination=Pdu  # Reference to a PDU in the global PDU collection.
        reference vIpcRxLowerLayerRef: origin=Vector Informatik, destination=vIpcLowerLayer  # Reference to Lower Layer Module containing references to type of lower layer.
        container vIpcRxConnection [1..*]  # vIpcRxConnection represents virtual data sources that are tunneled via a physical channel.
          integer vIpcRxAddress: origin=Vector Informatik  # Local address to enable demultiplexing from one physical channel to multiple connections. This address has to correspond to an address on a Tx connection on the same physical channel.
          reference vIpcRxSduRef: origin=Vector Informatik, destination=Pdu  # Reference to a PDU in the global PDU collection.
          reference vIpcRxUpperLayerRef: origin=Vector Informatik, destination=vIpcUpperLayer  # Reference to Upper Layer Module containing references to type of upper layer.
      container vIpcTxChannel [0..*]  # vIpcTxChannel is a representation of a physical channel that will transmit a data stream to another vIpc instance.
        integer vIpcNumSeparationCycles: 0..1024, origin=Vector Informatik, default-value=0  # The number of main function cycles between two transmits on the same physical channel
        integer vIpcTxChannelId: 0..65535, origin=Vector Informatik, symbolic-name-value=true, default-value=0  # Handle id that is used for Tx functions by the lower layer.
        enumeration vIpcSchedulingAlgorithm: {FIFO, FP}, origin=Vector Informatik, default-value=FIFO  # Supported: Fifo (FIFO) Fixed priority (FP)
        reference vIpcTxPduRef: scope=ECU, origin=Vector Informatik, destination=Pdu  # Reference to a PDU in the global PDU collection.
        reference vIpcTxLowerLayerRef: origin=Vector Informatik, destination=vIpcLowerLayer  # Reference to Lower Layer Module containing references to type of lower layer.
        container vIpcTxConnection [1..*]  # vIpcRxConnection represents virtual data sinks that are tunneled via a physical channel.
          integer vIpcTxConnectionId: 0..65535, origin=Vector Informatik, symbolic-name-value=true, default-value=0  # Handle id that is used for Tx functions by the upper layer.
          integer vIpcTxAddress: origin=Vector Informatik  # Remote address to enable demultiplexing from one physical channel to multiple connections. This address has to correspond to an address on a Rx connection on the same physical channel.
          integer vIpcPriority [0..1]: 0..255, origin=Vector Informatik, default-value=0  # Only relevant for 'Fixed priority'. Higher numbers mean higher priority.
          reference vIpcTxSduRef: origin=Vector Informatik, destination=Pdu  # Reference to a PDU in the global PDU collection.
          reference vIpcTxUpperLayerRef: origin=Vector Informatik, destination=vIpcUpperLayer  # Reference to Upper Layer Module containing references to type of upper layer.
      container vIpcUpperLayer [1..*]
        enumeration vIpcUpperLayerType: {PDUR, POSIX, CDD}, origin=Vector Informatik, default-value=PDUR  # Type of upper layer. In case a CDD is used, a upper layer reference has to be provided.
        foreign reference vIpcUpperLayerRef: origin=Vector Informatik, destination-type=ECUC-MODULE-CONFIGURATION-VALUES  # Reference to the UpperLayer module description. Customizable only in case of CDD
      container vIpcLowerLayer [1..*]
        foreign reference vIpcLowerLayerRef: origin=Vector Informatik, destination-type=ECUC-MODULE-CONFIGURATION-VALUES  # Reference to the lower layer module description.
  module config vIpc_Pre: definition=vIpc
  module config vIpc_Rec: definition=vIpc
