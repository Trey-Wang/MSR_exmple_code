AUTOSAR XML (schema 4-0-3)
package /MICROSAR
  module config Fls_Rec: definition=Fls
    FlsGeneral: FlsSafeBswChecks=1
