AUTOSAR XML (schema 4-0-3)
package /MICROSAR
  module config EthIf_Pre: definition=EthIf, implementation-config-variant=VARIANT-PRE-COMPILE
  module config EthIf_Rec: definition=EthIf
