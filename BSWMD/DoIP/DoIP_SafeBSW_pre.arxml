AUTOSAR XML (schema 4-2-1)
package /MICROSAR
  module config DoIP_Rec: definition=DoIP
    DoIPGeneral: DoIPSafeBswChecks=1
