AUTOSAR XML (schema 4-2-1)
package /MICROSAR
  module definition DoIP [0..1]: category=VENDOR_SPECIFIC_MODULE_DEFINITION, refined-module-def=DoIP, variants pre-compile  # Configuration of the DoIP (Diagnostic over IP) module.
    container DoIPConfigSet: multiplicity set at pre-compile  # This container contains the configuration parameters and sub containers of the AUTOSAR DoIP module. This container is a MultipleConfigurationContainer, i.e. this container and its sub-containers exist once per configuration set.
      integer DoIPEid [0..1]: 1..281474976710655, set at pre-compile, multiplicity set at pre-compile, set at pre-compile, default-value=1103823438081  # EID | This parameter defines the EID (Entity ID) of the DoIP entity used for vehicle identification. If DoIPUseMacAddressForIdentification is enabled this parameter must not be configured.
      integer DoIPGid [0..1]: 1..281474976710655, set at pre-compile, multiplicity set at pre-compile, set at pre-compile, default-value=1103823438081  # GID | This parameter defines the GID (Group ID) for vehicle identification response/vehicle announcement.
      integer DoIPLogicalAddress: 1..65535, set at pre-compile, multiplicity set at pre-compile, set at pre-compile  # This parameter defines the logical address of the DoIP entity. This address is sent within messages like Routing Activation Response when no specific target address is available.
      container DoIPChannel [1..65535]: multiplicity set at pre-compile  # Configuration of one DoIPChannel. A DoIPChannel describes a link to PDUR,
        boolean DoIPIsDefaultChannel [0..1]: set at pre-compile, multiplicity set at pre-compile, origin=Vector Informatik, set at pre-compile, default-value=true  # This parameter defines whether this channel is used as default channel if multiple channels with same target address value are configured to use Pdu size depending routing. It must exist in mentioned case only.
        reference DoIPChannelSARef: set at pre-compile, multiplicity set at pre-compile, set at pre-compile, destination=DoIPTester  # Reference to the DoIPTester which can communicate over this channel.
        reference DoIPChannelTARef: set at pre-compile, multiplicity set at pre-compile, set at pre-compile, destination=DoIPTargetAddress  # Reference to the DoIPTargetAddress which is sent within DoIP frames.
        container DoIPPduRRxPdu [0..1]: multiplicity set at pre-compile  # This container contains the Rx Pdus to connect with the Rx Pdus of the PDUR.
          integer DoIPPduRRxPduId: 0..65535, set at pre-compile, multiplicity set at pre-compile, set at pre-compile, symbolic-name-value=true, default-value=0  # PduR Rx PDU ID | This parameter defines the Pdu ID required by the API call DoIP_CancelReceive().
          reference DoIPPduRRxPduRef: set at pre-compile, multiplicity set at pre-compile, set at pre-compile, destination=Pdu  # PduR Rx PDU Ref | Reference to the "global" Pdu structure to allow harmonization of handle IDs in the COM-Stack.
        container DoIPPduRTxPdu [0..1]: multiplicity set at pre-compile  # This container contains the Tx Pdus to connect with the Tx Pdus of the PDUR.
          integer DoIPPduRTxPduId: 0..65535, set at pre-compile, multiplicity set at pre-compile, set at pre-compile, symbolic-name-value=true, default-value=0  # PduR Tx PDU ID | This parameter defines the Pdu ID required for DoIP_Transmit() and DoIP_CancelTransmit() function calls.
          enumeration DoIPPduType [0..1]: {DOIP_IFPDU, DOIP_TPPDU}, set at pre-compile, multiplicity set at pre-compile, post-build-variant-multiplicity=true, post-build-variant-value=true, set at pre-compile, default-value=DOIP_TPPDU  # This parameter defines the API Type to use for communication with PduR. DOIP_IFPDU for UUDT messages, DOIP_TPPDU for all other diagnostic messages.
          reference DoIPPduRTxPduRef: set at pre-compile, multiplicity set at pre-compile, set at pre-compile, destination=Pdu  # PduR Tx PDU Ref | Reference to the "global" Pdu structure to allow harmonization of handle IDs in the COM-Stack.
      container DoIPConnections: multiplicity set at pre-compile  # This container includes all lower layer connection specific information, i.e. the single Pdu References, Handle IDs to the SOAD and target adresses which are used to identify a DoIPChannel.
        container DoIPTargetAddress [1..65535]: multiplicity set at pre-compile  # This container includes target addresses that are known by this DoIP entity.
          integer DoIPTargetAddressValue: 1..65535, set at pre-compile, multiplicity set at pre-compile, set at pre-compile, default-value=1  # This parameter defines the logical target address which is sent within DoIP frames.
          integer DoIPTargetMaxBufSize [0..1]: 1..4294967291, set at pre-compile, multiplicity set at pre-compile, origin=Vector Informatik, set at pre-compile, default-value=4095  # This parameter defines the maximum buffer size the DoIP target can provide for buffering incoming messages. If this size is exceeded a DoIP Diagnostic Mesage Negative Acknowledge message with error code 0x04 is sent. The value shall not be configured bigger than DoIPTargetMaxPduSize. In case of UUDT this parameter must not exist.
          integer DoIPTargetMaxPduSize [0..1]: 1..4294967291, set at pre-compile, multiplicity set at pre-compile, origin=Vector Informatik, set at pre-compile, default-value=4095  # This parameter defines the maximum Pdu size which is accepted for this DoIPTargetAddress instance. A second DoIPTesterAddress instance with same target address but different DoIPTargetMaxPduSize can be used to configure Pdu size depending routing. This means the module will choose the DoIPTesterAddress which has the more suitable length. In case of UUDT this parameter must not exist.
          integer DoIPTargetAddressBitMask [0..1]: 1..65535, multiplicity set at pre-compile, origin=Vector Informatik, set at pre-compile, default-value=65535  # This parameter defines a bit mask which is used on reception of a diagnostic message to mask the target address value and choose the channel with matching masked bits. Example: Configured DoIPTagetAddressValue is 0x1234. This parameter is set to 0xFF. All diagnostic messages sent to 0xXY34 are received on this target addres. Note: To behave as specified by AUTOSAR value has to be set to 0xFFFF.
          boolean DoIPTargetAddressVerification: multiplicity set at pre-compile, origin=Vector Informatik, set at pre-compile, default-value=false  # This parameter defines if the DoIPVerifyTargetAddressCallback is called on reception of a diagnostic message.
        container DoIPTcpConnection [2..255]: multiplicity set at pre-compile  # This container includes TCP connection parameter to the lower layer SOAD module.
          container DoIPSoAdTcpRxPdu: multiplicity set at pre-compile  # SoAd Tcp Rx Pdu | This container contains the Rx Pdus for TCP connections.
            integer DoIPSoAdTcpRxPduId: 0..65535, set at pre-compile, multiplicity set at pre-compile, set at pre-compile, symbolic-name-value=true, default-value=0  # SoAd Tcp Rx Pdu Id | This parameter defines the Pdu ID required for the TP API calls. (e.g. DoIP_SoAdTpRxIndication()) to receive TCP data from SOAD.
            reference DoIPSoAdTcpRxPduRef: set at pre-compile, multiplicity set at pre-compile, set at pre-compile, destination=Pdu  # SoAd Tcp Rx Pdu Ref | Reference to the "global" Pdu structure to allow harmonization of handle IDs in the COM-Stack.
          container DoIPSoAdTcpTxPdu: multiplicity set at pre-compile  # SoAd Tcp Tx Pdu | This container contains the Tx Pdus for TCP connections.
            integer DoIPSoAdTcpTxPduId: 0..65535, set at pre-compile, multiplicity set at pre-compile, set at pre-compile, symbolic-name-value=true, default-value=0  # SoAd Tcp Tx Pdu Id | This parameter defines the Pdu ID required for the TP API calls. (e.g. DoIP_SoAdTpTxConfirmation() when TCP data are transmitted to SOAD.
            reference DoIPSoAdTcpTxPduRef: set at pre-compile, multiplicity set at pre-compile, set at pre-compile, destination=Pdu  # SoAd Tcp Tx Pdu Ref | Reference to the "global" Pdu structure to allow harmonization of handle IDs in the COM-Stack.
        container DoIPUdpConnection [1..255]: multiplicity set at pre-compile  # This container includes UDP connection parameter to the lower layer SOAD module.
          container DoIPSoAdUdpRxPdu: multiplicity set at pre-compile  # SoAd Udp Rx Pdu | This container contains the Rx Pdus for UDP connections.
            integer DoIPSoAdUdpRxPduId: 0..65535, set at pre-compile, multiplicity set at pre-compile, set at pre-compile, symbolic-name-value=true, default-value=0  # SoAd Udp Rx Pdu Id | This parameter defines the Pdu ID required for the IF API calls. (e.g. DoIP_SoAdIfRxIndication()) to receive UDP data from SOAD.
            reference DoIPSoAdUdpRxPduRef: set at pre-compile, multiplicity set at pre-compile, set at pre-compile, destination=Pdu  # SoAd Udp Rx Pdu Ref | Reference to the "global" Pdu structure to allow harmonization of handle IDs in the COM-Stack.
          container DoIPSoAdUdpTxPdu: multiplicity set at pre-compile  # SoAd Udp Tx Pdu | This container contains the Tx Pdus for UDP connections.
            integer DoIPSoAdUdpTxPduId: 0..65535, set at pre-compile, multiplicity set at pre-compile, set at pre-compile, symbolic-name-value=true, default-value=0  # SoAd Udp Tx Pdu Id | This parameter defines the Pdu ID required for the IF API calls. (e.g. DoIP_SoAdIfTxConfirmation() when UDP data are transmitted to SOAD.
            reference DoIPSoAdUdpTxPduRef: set at pre-compile, multiplicity set at pre-compile, set at pre-compile, destination=Pdu  # SoAd Udp Tx Pdu Ref | Reference to the "global" Pdu structure to allow harmonization of handle IDs in the COM-Stack.
        container DoIPUdpVehicleAnnouncementConnection [1..255]: multiplicity set at pre-compile  # This container describes the UDP multicast connections to the lower layer SoAd module.
          container DoIPSoAdUdpVehicleAnnouncementTxPdu: multiplicity set at pre-compile  # SoAd Udp Vehicle Announcement Tx Pdu | This container describes the vehicle announcement TxPdu sent via the SoAd.
            integer DoIPSoAdUdpVehicleAnnouncementTxPduId: 0..65535, multiplicity set at pre-compile, set at pre-compile, symbolic-name-value=true, default-value=0  # SoAd Udp Vehicle Announcement Tx Pdu Id | The DoIPSoAdUdpVehicleAnnouncementTxPduId is required by the API call DoIP_SoAdIfTxConfirmation() that is called by the SoAd to confirm that the IPdu has been transmitted successfully.
            reference DoIPSoAdUdpVehicleAnnouncementTxPduRef: multiplicity set at pre-compile, set at pre-compile, destination=Pdu  # SoAd Udp Vehicle Announcement Tx Pdu Ref | Reference to the "global" PDU structure to allow harmonization of handle
      container DoIPRoutingActivation [0..255]: multiplicity set at pre-compile  # This container contains the routing activation possibilities by representing for each container a possible routing activation request message to the DoIP entity and the according references to the activated diagnostic messages (i.e. DoIPTargetAddress).
        integer DoIPRoutingActivationNumber: 0..255, set at pre-compile, multiplicity set at pre-compile, set at pre-compile, default-value=0  # This parameter defines the Routing Activation Number which is received for a DoIP routing activation request message and expected for this Routing Activation instance.
        reference DoIPTargetAddressRef [1..255]: set at pre-compile, multiplicity set at pre-compile, set at pre-compile, destination=DoIPTargetAddress  # Reference to all DoIPTargetAddress which are activated on this routing activation.
        container DoIPRoutingActivationAuthenticationCallback [0..1]: multiplicity set at pre-compile  # This container contains a callback function to call on a Routing Activation Request for Authentication.
          function name DoIPRoutingActivationAuthenticationFunc [0..1]: set at pre-compile, multiplicity set at pre-compile, set at pre-compile  # This parameter defines a callback function to trigger the authentication function for routing activation.
          integer DoIPRoutingActivationAuthenticationReqLength: 0..4, set at pre-compile, multiplicity set at pre-compile, set at pre-compile, default-value=4  # This parameter defines the amount of bytes used to handle to the authentication function on routing activation. If 0 is configured as length the parameter AuthenticationReqData will not be handled to the API.
          integer DoIPRoutingActivationAuthenticationResLength: 0..4, set at pre-compile, multiplicity set at pre-compile, set at pre-compile, default-value=4  # This parameter defines the amount of bytes used to read by the authentication function on routing activation. If 0 is configured as length the parameter AuthenticationResData will not be handled to the API.
          boolean DoIPRoutingActivationAuthenticationParamRemAddr: multiplicity set at pre-compile, origin=Vector Informatik, set at pre-compile, default-value=false  # This parameter defines if an additional function parameter is used when calling callback to forward remote address of tester which has sent the corresponding routing activation request.
        container DoIPRoutingActivationConfirmationCallback [0..1]: multiplicity set at pre-compile  # This container contains a callback function to call on a Routing Activation Request for Confirmation.
          function name DoIPRoutingActivationConfirmationFunc [0..1]: set at pre-compile, multiplicity set at pre-compile, set at pre-compile  # This parameter defines a callback function to trigger the confirmation function for routing activation.
          integer DoIPRoutingActivationConfirmationReqLength: 0..4, set at pre-compile, multiplicity set at pre-compile, set at pre-compile, default-value=4  # This parameter defines the amount of bytes used to handle to the confirmation function on routing activation. If 0 is configured as length the parameter ConfirmedReqData will not be handled to the API.
          integer DoIPRoutingActivationConfirmationResLength: 0..4, set at pre-compile, multiplicity set at pre-compile, set at pre-compile, default-value=4  # This parameter defines the amount of bytes used to read by the confirmation function on routing activation. If 0 is configured as length the parameter ConfirmedResData will not be fetched via the API.
          boolean DoIPRoutingActivationConfirmationParamRemAddr: multiplicity set at pre-compile, origin=Vector Informatik, set at pre-compile, default-value=false  # This parameter defines if an additional function parameter is used when calling callback to forward remote address of tester which has sent the corresponding routing activation request.
      container DoIPTester [1..255]: multiplicity set at pre-compile  # This container includes the properties of the possible connectable testers for the DoIP entity.
        integer DoIPNumByteDiagAckNack: 0..4294967295, set at pre-compile, multiplicity set at pre-compile, set at pre-compile, default-value=256  # This parameter defines the number of user data received within a Diagnostic Message the DoIP entity shall sent back to tester within corresponding Diagnostic Message Acknowledge.
        integer DoIPTesterSA: 1..65535, set at pre-compile, multiplicity set at pre-compile, set at pre-compile, default-value=3584  # This parameter defines the logical source address of tester sent within TCP messages (e.g. Diagnostic Message).
        reference DoIPRoutingActivationRef [1..255]: set at pre-compile, multiplicity set at pre-compile, set at pre-compile, destination=DoIPRoutingActivation  # Reference to a DoIPRoutingActivation describing the possible routing activations of the DoIPTester.
    container DoIPGeneral: multiplicity set at pre-compile  # General configuration parameters of the DoIP.
      float DoIPAliveCheckResponseTimeout: 0..30, set at pre-compile, multiplicity set at pre-compile, set at pre-compile, default-value=0.5  # This parameter defines a timeout for a response to an Alive Check Request before the connection is considered to be disconnected. Represents parameter T_TCP_AliveCheck of ISO 13400-2.
      boolean DoIPDevelopmentErrorDetect: set at pre-compile, multiplicity set at pre-compile, set at pre-compile, default-value=true  # Dev Error Detect | This parameter switches the Development Error Detection and Notification ON or OFF. true: Development error detection is enabled. false: Development error detection is disabled. Note: In general, the development error detection is recommended during pre-test phase. It is not recommended to enable the development error detection in production code due to increased runtime and ROM needs.
      boolean DoIPDhcpOptionVinUse: set at pre-compile, multiplicity set at pre-compile, set at pre-compile, default-value=false  # DHCP Option VIN use | This parameter defines if DoIP module will add the VIN to the DHCP host name if no valid DHCP host name is already set. true: DoIP module will add the VIN. false: DoIP module will not add the VIN (will set value to "DoIP-").
      boolean DoIPEntityStatusMaxByteFieldUse: set at pre-compile, multiplicity set at pre-compile, set at pre-compile, default-value=false  # This parameter defines if the optional support of the max data size element of a diagnostic entity status response. true: DoIP module will add max data size element. false: DoIP module will not add max data size element.
      integer DoIPGIDInvalidityPattern: 0..255, set at pre-compile, multiplicity set at pre-compile, set at pre-compile, default-value=0  # This parameter defines the byte pattern that is used for response messages if no valid GID could be retrieved.
      float DoIPGeneralInactivityTime: 0..1200, set at pre-compile, multiplicity set at pre-compile, set at pre-compile, default-value=300  # This parameter defines a timeout for a inactive TCP connection before DoIP module will close the according socket connection. Inactive means that no data is transmitted or received. Represents parameter T_TCP_General_Inactivity of ISO 13400-2:2012.
      string DoIPHeaderFileInclusion [0..*]: set at pre-compile, multiplicity set at pre-compile, set at pre-compile  # This parameter defines a possibiliy to include header file(s) containing callback declarations.
      string DoIPHostNameSizeMax: set at pre-compile, multiplicity set at pre-compile, set at pre-compile, default-value=DoIP-, max-length=255, min-length=5  # This parameter defines the maximum size of the DHCP HostName in ASCII. The parameter is necessary to reserve the correct amount of bytes for working with the DHCP HostName option. Minimum range is 5 because Dhcp Host Name should be at least "DoIP-" on any configuration.
      float DoIPInitialInactivityTime: 0..300, set at pre-compile, multiplicity set at pre-compile, set at pre-compile, default-value=2  # This parameter defines a timeout for a TCP connection where no routing is activated before DoIP module will close the according socket connection. Represents parameter T_TCP_Initial_Inactivity of ISO 13400-2.
      float DoIPInitialVehicleAnnouncementTime: 0..30, set at pre-compile, multiplicity set at pre-compile, set at pre-compile, default-value=0.5  # This parameter defines a time to wait before sending first Vehicle Anouncement message after IP address assignment. Represents parameter A_DoIP_Announce_Wait of ISO 13400-2
      float DoIPMainFunctionPeriod: 0..0.1, set at pre-compile, multiplicity set at pre-compile, set at pre-compile, default-value=0.005  # This parameter defines the main function call period.
      integer DoIPMaxRequestBytes: 1..18446744073709551615, set at pre-compile, multiplicity set at pre-compile, set at pre-compile, default-value=4095  # This parameter defines the maximum allowed bytes of a DoIP message request without the DoIP header. If a message is received with a bigger size DoIP entity will sent a Generic Negative Acknowledge message with error code 0x02 (Message too large).
      integer DoIPMaxTesterConnections: 1..255, set at pre-compile, multiplicity set at pre-compile, set at pre-compile, default-value=1  # This parameter defines the maximum ammount of tester connections that shall be maintained at one time before alive check is performed. Vector supports multiple local addresses (e.g. IPv4, IPv6, VLANs parallel). This parameter is validated against the configured TcpConnections per local address. The value shall not exceed the number of TcpConnections on the local address with the most TcpConnections.
      integer DoIPMaxUDPRequestPerMessage: 1..255, set at pre-compile, multiplicity set at pre-compile, set at pre-compile, default-value=1  # This parameter captures the maximum amont of UDP Requests necessary to handle parallel within a single UDP connection.
      enumeration DoIPNodeType: {DOIP_GATEWAY, DOIP_NODE}, set at pre-compile, multiplicity set at pre-compile, set at pre-compile, default-value=DOIP_GATEWAY  # This parameter defines the type of the DoIP entity. DOIP_GATEWAY DoIP entity can route diagnostic data to other ECUs DOIP_NODE DoIP entity has a local diagnostic instance only The type is sent within the DoIP entity status response.
      boolean DoIPUseEIDasGID: set at pre-compile, multiplicity set at pre-compile, set at pre-compile, default-value=false  # Use EID as GID | This parameter defines if the DoIP entity shall use its EID if it is the Master for vehicle identification gid on the vehicle identification/vehicle announcement.
      boolean DoIPUseMacAddressForIdentification: set at pre-compile, multiplicity set at pre-compile, set at pre-compile, default-value=false  # This parameter defines whether MAC address shall be used as EID in Vehicle Identification messages. true: Use MAC address as EID. false: Use configured EID (DoIPEid).
      boolean DoIPUseVehicleIdentificationSyncStatus: set at pre-compile, multiplicity set at pre-compile, set at pre-compile, default-value=false  # This parameter defines whether the optional VIN/GID synchronization status is used additionally in the Vehicle Identification/Announcement message.
      float DoIPVehicleAnnouncementInterval: 0..30, set at pre-compile, multiplicity set at pre-compile, set at pre-compile, default-value=0.5  # This parameter defines a time to wait before sending subsequent Vehicle Announcement messages after IP address assignment and a first Vehicle Announcement message is sent. Represents parameter A_DoIP_Announce_Interval of ISO 13400-2.
      integer DoIPVehicleAnnouncementRepetition: 1..255, set at pre-compile, multiplicity set at pre-compile, set at pre-compile, default-value=3  # This parameter defines the amount of repetitions of the Vehicle Announcement message after IP address assignment. Represents parameter A_DoIP_Annunce_Num of ISO 13400-2.
      boolean DoIPVersionInfoApi: set at pre-compile, multiplicity set at pre-compile, set at pre-compile, default-value=false  # Version Info API | This parameter enables/disables the function DoIP_GetVersionInfo() to get major, minor and patch version information. | TRUE: Enables the DoIP_GetVersionInfo() API. FALSE: DoIP_GetVersionInfo() API is not included.
      boolean DoIPVinGidMaster: set at pre-compile, multiplicity set at pre-compile, set at pre-compile, default-value=false  # VIN GID Master | This parameter defines if the DoIP entity is the Vehicle identification Master for the GID (Group ID).
      integer DoIPVinInvalidityPattern: 0..255, set at pre-compile, multiplicity set at pre-compile, set at pre-compile, default-value=0  # VIN Invalidity Pattern | This parameter defines the byte pattern that is used for response messages if no valid VIN could be retrieved.
      enumeration DoIPVersion: set at pre-compile, multiplicity set at pre-compile, origin=Vector Informatik, set at pre-compile, default-value=ISO_13400_2_2012  # DoIP Version | This parameter defines the DoIP protocol version which shall be used for DoIP communication. Following versions are supported: DoIP according to ISO/DIS 13400-2:2010 DoIP according to ISO/FDIS 13400-2:2011 DoIP according to ISO 13400-2:2012
        ISO_DIS_13400_2_2010  # ISO_DIS_13400_2_2010 ISO/DIS 13400­2:2010
        ISO_FDIS_13400_2_2011  # ISO_FDIS_13400_2_2011 ISO/FDIS 13400­2:2011
        ISO_13400_2_2012  # ISO_13400_2_2012 ISO 13400-2:2012
      boolean DoIPSupportEntityState: set at pre-compile, multiplicity set at pre-compile, origin=Vector Informatik, set at pre-compile, default-value=false  # This parameter defines support of DoIP Entity Status messages. If disabled a DoIP Entity Status Request is handled as unknown payload type and will be responded with Generic DoIP Header Negative Acknowledge with error code 0x01.
      boolean DoIPSupportVidWithEId: set at pre-compile, multiplicity set at pre-compile, origin=Vector Informatik, set at pre-compile, default-value=false  # Support VID with EID | This parameter defines support of DoIP Vehicle Identification Request with EID (Entity ID). If disabled a Vehcile Identification Requeset with EID is handled as unknown payload type and will be responded with Generic DoIP Header Negative Acknowledge with error code 0x01.
      boolean DoIPSupportPduSizeRouting: set at pre-compile, multiplicity set at pre-compile, origin=Vector Informatik, set at pre-compile, default-value=false  # Support PDU Size Routing | This parameter defines support of PDU size depended routing. PDU size depended routing means that a specific target address can have multiple destinations (multiple DoIPTargetAddress container with same address). Destination is chosen according to length given in DoIPTargetMaxPduSize.
      string DoIPUserConfigFile [0..1]: set at pre-compile, multiplicity set at pre-compile, origin=Vector Informatik, set at pre-compile  # Reference to an external user configuration file that will be included during generation. The content of the user configuration file will be added at the end of the generated module configuration file and allows altering or extending the generated code. Caution: User configuration files can cause the software module to malfunction and must only be used with great care!
      integer DoIPTcpTxMgtQueueSize: 2..65535, set at pre-compile, multiplicity set at pre-compile, origin=Vector Informatik, set at pre-compile, default-value=2  # TCP Tx Queue Size | This parameter defines the number of TCP transmission requests the DoIP module can handle at the same time. All types of TCP messages will be stored in this queue (not Diagnostic Message only, e.g. Diagnostic Message Acknowledge).
      integer DoIPUdpTxMgtListSize: 1..65535, set at pre-compile, multiplicity set at pre-compile, origin=Vector Informatik, set at pre-compile, default-value=2  # UDP Tx List Size | This parameter defines the number of UDP transmission requests the DoIP module can handle at the same time. All types of UDP messages will be stored in this list. The list is shared by all UDP connections. All inital Vehicle Announcements are handled within one list entry.
      boolean DoIPSupportShutdown: set at pre-compile, multiplicity set at pre-compile, origin=Vector Informatik, set at pre-compile, default-value=false  # This parameter defines a service to shutdown TcpIp stack. Shutdown means that all sockets will be closed and modules will be set to a special shutdown state which can be revoked by an ECU reset.
      boolean DoIPActivationLineDefaultActive: multiplicity set at pre-compile, origin=Vector Informatik, set at pre-compile, default-value=false  # This parameter defines if activation line is assumed as active by default at startup. If value is false DoIPActivationLineStateCallback must exist.
      boolean DoIPSupportOemSpecificPayloadTypes: multiplicity set at pre-compile, origin=Vector Informatik, set at pre-compile, default-value=false  # This parameter enables support of manufacturer-specific payload types on TCP and UDP connection. The manufacturer-specific payload types are in range 0xF000-0xFFFF. If any other unknown payload type is received a generic DoIP header negative acknowledge is sent as specified. All received user data are forwarded via a user defined callback.
      boolean DoIPSafeBswChecks: multiplicity set at pre-compile, origin=Vector Informatik, set at pre-compile, default-value=false  # Selects if safety checks are used. These checks improve robustness as e.g. invalid parameters are checked before function is executed. This attribute has to be enabled for safety projects where this component is mapped to an ASIL partition.
      container DoIPGetVinCallback: multiplicity set at pre-compile  # This container includes a callback function to get the VIN (Vehicle Identification Number) of the DoIP entity.
        function name DoIPGetVinDirect: set at pre-compile, multiplicity set at pre-compile, origin=Vector Informatik, set at pre-compile  # This parameter defines a callback function to get the VIN (Vehicle Identification Number) of the DoIP entity.
      container DoIPShutdownFinishedCallback [0..1]: multiplicity set at pre-compile  # This container includes a callback function to notify an user about a finished shutdown which was previously requested by user.
        function name DoIPShutdownFinishedDirect: set at pre-compile, multiplicity set at pre-compile, origin=Vector Informatik, set at pre-compile  # This parameter defines a callback function to notify an user about a finished shutdown which was previously requested by user.
      container DoIPGetGidCallback [0..1]: multiplicity set at pre-compile  # This container describes the usage of a callback function to get the GID. (If this container is not present no callback function shall be used by DoIP module to retrive the GID.)
        function name DoIPGetGidDirect [0..1]: set at pre-compile, multiplicity set at pre-compile, set at pre-compile  # If the DoIPGetGidDirect parameter exist the DoIP module shall call the configured callback function (<User>_DoIPGetGID) direct. | If the DoIPGetGidDirect parameter does NOT exist the DoIP module shall use a RPort with a CallbackGetGID type of client-server port interface to retrive the GID.
      container DoIPPowerModeCallback: multiplicity set at pre-compile  # This container describes the usage of a callback function to retrieve the current power mode. This container shall always be present.
        function name DoIPPowerModeDirect [0..1]: set at pre-compile, multiplicity set at pre-compile, set at pre-compile  # If the DoIPPowerModeDirect parameter exist the DoIP module shall call the configured callback function (<User>_DoIPGetPowerModeCallback) direct. | If the DoIPPowerModeDirect parameter does NOT present the DoIP module shall use a RPort with a CallbackGetPowerMode type of client-server port interface to retrive the current power mode.
      container DoIPTriggerGidSyncCallback [0..1]: multiplicity set at pre-compile  # This container describes the usage of a callback function to trigger the GID synchronization. (If this container does not exist no callback function shall be used by DoIP module to trigger the GID synchronization.)
        function name DoIPTriggerGidSyncDirect [0..1]: set at pre-compile, multiplicity set at pre-compile, set at pre-compile  # If the DoIPTriggerGidSyncDirect parameter exist the DoIP module shall call the configured callback function (<User>_DoIPTriggerGidSyncCallback) direct. | If the DoIPTriggerGidSyncDirect parameter does NOT present the DoIP module shall use a RPort with a CallbackTriggerGIDSynchnonization type of client-server port interface to trigger the GID synchronization.
      container DoIPActivationLineStateCallback [0..1]: multiplicity set at pre-compile  # This container describes the usage of a callback function to retrieve current activation line state. This callback is called in context of DoIP_ActivationLineSwitch.
        function name DoIPActivationLineStateDirect: multiplicity set at pre-compile, origin=Vector Informatik, set at pre-compile  # This parameter defines a function name for a callback which is called in context of DoIP_ActivationLineSwitch to retrieve activation line state from application.
      container DoIPOemSpecificPayloadTypeCallback [0..1]: multiplicity set at pre-compile  # This container includes a callback function to forward received manufacturer-specific payload types to a user.
        function name DoIPOemSpecificPayloadTypeDirect: set at pre-compile, multiplicity set at pre-compile, origin=Vector Informatik, set at pre-compile  # This parameter defines a callback function to forward received manufacturer-specific payload types to a user and to get the optional response.
        integer DoIPOemSpecificPayloadTypeTcpBufSize: 0..65535, multiplicity set at pre-compile, origin=Vector Informatik, set at pre-compile, default-value=32  # This parameter defines the size of a buffer used to store user data for linearization of manufacturer-specific payload types on TCP connections since received user data may be segmented. The buffer is also used to store the optional response of user.
        integer DoIPOemSpecificPayloadTypeUdpBufSize: 0..65535, multiplicity set at pre-compile, origin=Vector Informatik, set at pre-compile, default-value=32  # This parameter defines the size of a buffer used to store user data for an optional response to a previously received UDP OEM specific payload type.
      container DoIPVerifyTargetAddressCallback [0..1]: multiplicity set at pre-compile  # This container includes a callback function to forward logical target address received within a diagnostic message to a user.
        function name DoIPVerifyTargetAddressDirect: set at pre-compile, multiplicity set at pre-compile, origin=Vector Informatik, set at pre-compile  # This parameter defines a callback function to forward logical target address received within a diagnostic message to a user. Via return value user can indicate if target address is accepted.
      container DoIPVerifyRxPduCallback [0..1]: multiplicity set at pre-compile  # This container contains a callback to verify if a Rx PDU is allowed to be received. The callback forwards local socket address, remote socket address, local tester logical address, remote tester logical address and a configured number of PDU data to an user. If callback fails SoAd drops the received PDU completely. Otherwise DoIP forwards the received diagnostic message.
        function name DoIPVerifyRxPduDirect: multiplicity set at pre-compile, origin=Vector Informatik, set at pre-compile, max-length=255, min-length=0  # This parameter defines the callback name for the Rx PDU verification.
        integer DoIPVerifyRxPduMaxDataLength: 0..255, multiplicity set at pre-compile, origin=Vector Informatik, set at pre-compile, default-value=0  # This parameter defines the number of received PDU data which are forwarded to the user for Rx PDU verification.
  bsw implementation DoIP_Impl: programming-language=C, sw-version=4.04.00, used-code-generator=DaVinci Configurator, vendor-id=30, ar-release-version=4.02.02, behavior=DoIPBehavior, preconfigured-configuration=DoIP_Pre, recommended-configuration=DoIP_Rec, vendor-specific-module-def=DoIP
