AUTOSAR XML (schema 4-0-3)
package /MICROSAR/VTT
  module definition VTTLin [0..1]: category=VENDOR_SPECIFIC_MODULE_DEFINITION, variants pre-compile/post-build-loadable/post-build-selectable  # Configuration of the Lin (LIN driver) module.
    container LinGeneral  # General configuration parameters of the Lin.
      boolean LinDevErrorDetect: set at pre-compile, default-value=true  # Dev Error Detect | This parameter switches the Development Error Detection and Notification ON or OFF. true: Development error detection is enabled. false: Development error detection is disabled. Note: In general, the development error detection is recommended during pre-test phase. It is not recommended to enable the development error detection in production code due to increased runtime and ROM needs.
      boolean LinVersionInfoApi: set at pre-compile, default-value=false  # Version Info Api | This parameter enables/disables the function Lin_GetVersionInfo() to get major, minor and patch version information.
    container LinGlobalConfig  # Global configuration parameters of the Lin.
      container LinChannel [1..*]  # Channel specific configuration parameters of the Lin.
        integer LinChannelId: 0..254, set at pre-compile, symbolic-name-value=true, default-value=0  # Channel Id | This value specifies the identifier of this LIN channel.
        string LinBusName: set at post-build in variant post-build-loadable+post-build-selectable / pre-compile in variant pre-compile, origin=Vector Informatik, default-value=LIN  # Bus Name | This parameter defines the name of this channel. It has to be unique over all LIN channels and has to be the same as the LIN channel within the CANoe configuration.
  bsw implementation VTTLin_Impl: programming-language=C, sw-version=werwrer, used-code-generator=DaVinci Configurator, vendor-id=30, ar-release-version=4.00.03, preconfigured-configuration=VTTLin_Pre, recommended-configuration=VTTLin_Rec, vendor-specific-module-def=VTTLin
  module config VTTLin_Pre: definition=VTTLin
  module config VTTLin_Rec: definition=VTTLin
