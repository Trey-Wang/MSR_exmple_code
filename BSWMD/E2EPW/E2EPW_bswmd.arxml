AUTOSAR XML (schema 4-0-3)
package /MICROSAR
  bsw implementation E2EPW_Impl: programming-language=C, sw-version=1.0.0, vendor-id=30, ar-release-version=4.0.3, preconfigured-configuration=E2EPW_pre, recommended-configuration=E2EPW_rec, vendor-specific-module-def=E2EPW
  module definition E2EPW [0..1]: variants pre-compile  # This is a wrapper in the EcuC for the EndToEnd-Protection Section in the Software Component Template Section. This is required to configure the generator for the EndToEnd-Protection-Wrapper.
    container E2EPWGeneral [0..1]
  module config E2EPW_Pre: definition=E2EPW
  module config E2EPW_Rec: definition=E2EPW
