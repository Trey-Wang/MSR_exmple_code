AUTOSAR XML (schema 4-1-1)
# COPYRIGHT
# Copyright (c) 2015 by Vector Informatik GmbH. All rights reserved.
# This software is copyright protected and proprietary to Vector Informatik GmbH.
# Vector Informatik GmbH grants to you only those rights as set out in the license conditions.
package /MICROSAR
  bsw implementation Srp_Impl: programming-language=C, sw-version=3.01.00, used-code-generator=DaVinci Configurator, vendor-id=30, ar-release-version=4.02.01, behavior=SrpBehavior, vendor-specific-module-def=Srp
  module definition Srp [0..1]: category=VENDOR_SPECIFIC_MODULE_DEFINITION, refined-module-def=Srp, variants pre-compile  # Configuration of the Stream Registration Protocol defined by IEEE802.1Q
    container SrpGeneral  # Configuration of general Parameters used by Srp
      boolean SrpDevErrorDetect: set at pre-compile, origin=Vector Informatik, default-value=true  # If 'Dev Error Detection' is enabled, all development errors are reported to the Development Error Tracer (DET). The errors are described in the [TechnicalReference_Srp.pdf]. Note: In general, the development error detection is recommended during pre-test phase. It is not recommended to enable the development error detection in production code due to increased runtime and ROM needs.
      float SrpMainFunctionPeriod: 0..1.7976931348623157E+308, set at pre-compile, origin=Vector Informatik, default-value=0.005  # Schedule period of the main function Srp_MainFunction. Unit: [s].
      boolean SrpVersionInfo: set at pre-compile, origin=Vector Informatik, default-value=false  # Activate/Deactivate the version information API (Srp_GetVersionInfo) to get major, minor and patch version information. True: version information API activated False: version information API deactivated.
      boolean SrpEnableMultipleMACRegistrationProtocol: set at pre-compile, origin=Vector Informatik, default-value=false  # Enable or Disable the Multiple MAC Registration Protocol
      integer SrpSupportedMSRPStreams: 1..255, set at pre-compile, origin=Vector Informatik, default-value=20  # This parameter specifies the possible amount of Streams managed via the Multiple Stream Registration Protocol. Note: One of the supported MSRP Attributes is always used for the SR Domain Attribute.
      integer SrpSupportedMVRPVLans: 1..255, set at pre-compile, origin=Vector Informatik, default-value=20  # Supported MVRP VLans | This parameter speciefies the amount of supported VLAN-IDs manged via Multiple VLAN Registration Protocol
      integer SrpSupportedMMRPMacAddresses [0..1]: 1..255, set at pre-compile, origin=Vector Informatik, default-value=20  # This parameter specifies the amount of MAC Addresses managed via Multiple MAC Registration Protocol
      string SrpMmrpDestMacAddr [0..1]: set at pre-compile, origin=Vector Informatik, default-value=01:80:C2:00:00:20, max-length=17, min-length=17  # MMRP Destination MAC Address | Destination Physical Hardware Address (MAC-Address) of Srp-MMRPFrames. Input format has to match xx::xx::xx::xx::xx::xx, where x stands for a hex value between 0 and F.
      string SrpMvrpDestMacAddr: set at pre-compile, origin=Vector Informatik, default-value=01:80:C2:00:00:21, max-length=17, min-length=17  # MVRP Destination MAC Address | Destination Physical Hardware Address (MAC-Address) of Srp-MVRPFrames. Input format has to match xx::xx::xx::xx::xx::xx, where x stands for a hex value between 0 and F.
      string SrpMsrpDestMacAddr: set at pre-compile, origin=Vector Informatik, default-value=01:80:C2:00:00:0E, max-length=17, min-length=17  # MSRP Destination MAC Address | Destination Physical Hardware Address (MAC-Address) of Srp-MSRPFrames. Input format has to match xx::xx::xx::xx::xx::xx, where x stands for a hex value between 0 and F.
      string SrpAdditionalIncludes [0..*]: set at pre-compile, origin=Vector Informatik, max-length=32, min-length=1  # Defines header files (filename..h) for the application call-back functions which shall be included. Range of characters is 1...32.
      integer SrpDETInstanceID: 0..255, set at pre-compile, origin=Vector Informatik, default-value=0  # If 'Dev Error Detection' is enabled, all development errors are reported to the Development Error Tracer (DET) with the configured DET Instance ID. The errors are described in the [TechnicalReference_Srp.pdf]. Note: In general, the development error detection is recommended during pre-test phase. It is not recommended to enable the development error detection in production code due to increased runtime and ROM needs.
      enumeration SrpType: {STATIC, DYNAMIC}, set at pre-compile, origin=Vector Informatik, default-value=STATIC  # Srp Type | Select the used Srp Type: STATIC: The maximum available Bandwith is determined during generation, The Srp only provides Bandwidth up to this limit. DYNAMIC: The Bandwith is actually managed by the Ethernet Driver. The Srp always requrest Bandwidth when required.
      string SrpUserConfigFile [0..1]: set at pre-compile, origin=Vector Informatik  # Reference to an external user configuration file that will be included during generation. The content of the user configuration file will be added at the end of the generated module configuration file and allows altering or extending the generated code. Caution: User configuration files can cause the software module to malfunction and must only be used with great care!
      integer SrpSupportedMSRPAttributesTotal: 1..255, set at pre-compile, origin=Vector Informatik, default-value=21
    container SrpConfigSet
      container SrpPortConfig [1..*]
        integer SrpPortIdx: 0..255, set at pre-compile, origin=Vector Informatik, symbolic-name-value=true, default-value=0  # Srp Port Index | Determines the used Srp port index.
        float SrpJoinTime: set at pre-compile, origin=Vector Informatik, default-value=0.2  # Time interval between two transmit opportunities
        float SrpLeaveTime: set at pre-compile, origin=Vector Informatik, default-value=0.6  # The Leave Time specifies how long the Registrar state machine remains in the state "Leaving" before transiton to state "Empty" happens
        float SrpLeaveAllTime: set at pre-compile, origin=Vector Informatik, default-value=10  # Specifies the Time between two LeaveAll events
        reference SrpEthIfController: set at pre-compile, origin=Vector Informatik, destination=EthIfController  # Reference to the used Ethernet Interface Controller
        container SrpMSRPApplicationCallbacks  # Configuration of the Application Callbacks necessary for the Multiple Stream Registration Protocol
          function name SrpRegisterStreamCbk: set at pre-compile, origin=Vector Informatik, default-value=App_RegisterStreamCbk  # Callback used to inform the Application of a Stream declared by another MSRP Participant. The Call-back function has the following signature: void Srp_RegisterStream_Cbk(const Srp_MsrpAttributeInfoType*)
          function name SrpDeregisterStreamCbk: set at pre-compile, origin=Vector Informatik, default-value=App_DeregisterStreamCbk  # Callback used to inform the Application of a Stream declaration withdrawn by another MSRP Participant. The Call-back Function has the following signature: void Srp_DeregisterStream_Cbk(const Srp_MsrpAttributeInfoType*)
          function name SrpRegisterAttachCbk: set at pre-compile, origin=Vector Informatik, default-value=App_RegisterAttachCbk  # Callback used to inform the Application of a Stream registered by another MSRP Participant. The Call-back Function has the following signature: void Srp_RegisterAttach_Cbk(const Srp_MsrpAttributeInfoType*)
          function name SrpDeregisterAttachCbk: set at pre-compile, origin=Vector Informatik, default-value=App_DeregisterAttachCbk  # Callback used to inform the Application of a withdrawn Stream registration by another MSRP Participant. The Call-back Function has the following signature: void Srp_DeregisterAttach_Cbk(const Srp_MsrpAttributeInfoType*)
        container SrpSRClassConfig
          enumeration SrpSRClass: {CLASS_A, CLASS_B}, set at pre-compile, origin=Vector Informatik, default-value=CLASS_A  # The SR class supported by the SRP Port
          integer SrpSRClassPriority: 0..7, set at pre-compile, origin=Vector Informatik, default-value=3  # The Priority of the SR class
          integer SrpSRClassVID: 1..4094, set at pre-compile, origin=Vector Informatik, default-value=2  # The V-Lan identifier of the SR class
