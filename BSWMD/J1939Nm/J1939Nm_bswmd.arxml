AUTOSAR XML (schema 4-1-3)
package /MICROSAR
  module definition J1939Nm [0..1]: category=VENDOR_SPECIFIC_MODULE_DEFINITION, refined-module-def=J1939Nm, variants post-build-loadable/pre-compile/post-build-selectable  # Configuration of the J1939Nm (SAE J1939 Network Management) module.
    container J1939NmConfigSet  # Configuration parameters and sub containers of the J1939Nm module.
      container J1939NmChannel [1..*]  # Physical CAN channel handled by J1939Nm.
        boolean J1939NmChannelUsesDynamicAddressing [0..1]: scope=ECU, set at pre-compile, origin=Vector Informatik, default-value=false  # Enables the dynamic addressing support for this channel. This parameter is only relevant if Dynamic Address Support is active.
        integer J1939NmChannelAnonymousNodes [0..1]: 0..253, set at post-build in variant post-build-loadable+post-build-selectable / pre-compile in variant pre-compile, origin=Vector Informatik, default-value=0  # Anonymous External Nodes | Number of anonymous external nodes supported by J1939Nm on this channel. Each anonymous external node is assigned a unique node ID. This parameter is only relevant if Channel Uses Dynamic Addressing is active.
        boolean J1939NmIsobusChannel [0..1]: scope=ECU, set at post-build in variant post-build-loadable+post-build-selectable / pre-compile in variant pre-compile, origin=Vector Informatik, default-value=false  # ISOBUS Channel | Identifies this channel as an ISOBUS (ISO 11873) channel. If enabled, the timing of the address claiming sequence during startup conforms with ISO 11783, otherwise with SAE J1939.
        boolean J1939NmChannelUsesAddressArbitration: set at post-build in variant post-build-loadable+post-build-selectable / pre-compile in variant pre-compile, default-value=true  # Defines whether the internal nodes attached to this channel shall use an initial address claim, and whether they shall react to contending address claims of other (internal or external) nodes. True: The initial address claim is sent, and the internal node reacts to address claims of other nodes. False: The internal node only sends an address claim upon request, and does not care for contending address claims.
        integer J1939NmNameManagementQueueSize [0..1]: 0..255, set at pre-compile, origin=Vector Informatik, default-value=2  # Name Management Queue Size | Number of Name Management (NM) messages that can be stored for later transmission. When this parameter is not configured or set to 0, only one Name Management message can be transmitted at any time. Please note: This parameter is only relevant if Name Management Support is enabled.
        symbolic name reference J1939NmComMNetworkHandleRef: set at post-build in variant post-build-loadable+post-build-selectable / pre-compile in variant pre-compile, destination=ComMChannel  # ComM Network Handle Ref | Reference to the channel defined by the ComMChannel providing access to the unique channel index ComMChannelId.
        container J1939NmRxPdu  # AC Rx Pdu | Contains the configuration of the PDU used to receive the AddressClaimed PG.
          integer J1939NmRxPduId: 0..65535, scope=ECU, set at pre-compile, symbolic-name-value=true, default-value=0  # AC Rx Pdu ID | The PDU identifier used for RxIndication from CanIf.
          reference J1939NmRxPduRef: set at post-build in variant post-build-loadable+post-build-selectable / pre-compile in variant pre-compile, destination=Pdu  # AC Rx Pdu Ref | Reference to the Pdu object representing the PDU.
        container J1939NmTxPdu  # AC Tx Pdu | Contains the configuration of the PDU used to transmit the AddressClaimed PG.
          integer J1939NmTxPduId: 0..65535, scope=ECU, set at pre-compile, symbolic-name-value=true, default-value=0  # AC Tx Pdu ID | The PDU identifier used for TxConfirmation from CanIf.
          reference J1939NmTxPduRef: set at post-build in variant post-build-loadable+post-build-selectable / pre-compile in variant pre-compile, destination=Pdu  # AC Tx Pdu Ref | Reference to the Pdu object representing the PDU.
        container J1939NmCaPdu [0..1]: post-build-changeable=true  # CA Rx Pdu | Contains the configuration of the PDU used to receive the CommandedAddress PG. This container is only required when the J1939NmAddressConfigurationCapability of any node on this channel is set to J1939NM_AAC or J1939NM_CCA.
          integer J1939NmCaPduId: 0..65535, scope=ECU, set at pre-compile, origin=Vector Informatik, symbolic-name-value=true, default-value=0  # CA Rx Pdu ID | The PDU identifier used for RxIndication from PduR.
          reference J1939NmCaPduRef: set at post-build in variant post-build-loadable+post-build-selectable / pre-compile in variant pre-compile, origin=Vector Informatik, destination=Pdu  # CA Rx Pdu Ref | Reference to the Pdu object representing the PDU.
        container J1939NmNmRxPdu [0..1]  # NM Rx Pdu | Contains the configuration of the PDU used to receive the NameManegement PG. This container is only required when NAME Management Support is enabled.
          integer J1939NmNmRxPduId: 0..65535, scope=ECU, set at pre-compile, origin=Vector Informatik, symbolic-name-value=true, default-value=0  # NM Rx Pdu ID | The PDU identifier used for RxIndication from CanIf.
          reference J1939NmNmRxPduRef: set at post-build in variant post-build-loadable+post-build-selectable / pre-compile in variant pre-compile, origin=Vector Informatik, destination=Pdu  # NM Rx Pdu Ref | Reference to the Pdu object representing the PDU.
        container J1939NmNmTxPdu [0..1]  # NM Tx Pdu | Contains the configuration of the PDU used to transmit the NameManegement PG. This container is only required when NAME Management Support is enabled.
          integer J1939NmNmTxPduId: 0..65535, scope=ECU, set at pre-compile, origin=Vector Informatik, symbolic-name-value=true, default-value=0  # NM Tx Pdu ID | The PDU identifier used for TxConfirmation from CanIf.
          reference J1939NmNmTxPduRef: set at post-build in variant post-build-loadable+post-build-selectable / pre-compile in variant pre-compile, origin=Vector Informatik, destination=Pdu  # NM Tx Pdu Ref | Reference to the Pdu object representing the PDU.
      container J1939NmNode [1..*]  # Internal Node | Logical node representing one function handled by J1939Nm.
        integer J1939NmNodeId: 0..255, scope=ECU, set at pre-compile, symbolic-name-value=true, default-value=0  # Node ID | Unique identifier of this internal node.
        boolean J1939NmNodeNameArbitraryAddressCapable: set at post-build in variant post-build-loadable+post-build-selectable / pre-compile in variant pre-compile, default-value=true  # NAME Field 1 - Arbitrary Address Capable | Arbitrary Address Capable field of the NAME of this internal node.
        integer J1939NmNodeNameECUInstance: 0..7, set at post-build in variant post-build-loadable+post-build-selectable / pre-compile in variant pre-compile, default-value=7  # NAME Field 7 - ECU Instance | ECU Instance field of the NAME of this internal node.
        integer J1939NmNodeNameFunction: 0..255, set at post-build in variant post-build-loadable+post-build-selectable / pre-compile in variant pre-compile, default-value=255  # NAME Field 5 - Function | Function field of the NAME of this internal node.
        integer J1939NmNodeNameFunctionInstance: 0..31, set at post-build in variant post-build-loadable+post-build-selectable / pre-compile in variant pre-compile, default-value=31  # NAME Field 6 - Function Instance | Function Instance field of the NAME of this internal node.
        integer J1939NmNodeNameIdentityNumber: 0..2097151, set at post-build in variant post-build-loadable+post-build-selectable / pre-compile in variant pre-compile, default-value=2097151  # NAME Field 9 - Identity Number | Identity Number field of the NAME of this internal node.
        integer J1939NmNodeNameIndustryGroup: 0..7, set at post-build in variant post-build-loadable+post-build-selectable / pre-compile in variant pre-compile, default-value=7  # NAME Field 2 - Industry Group | Industry Group field of the NAME of this internal node.
        integer J1939NmNodeNameManufacturerCode: 0..2047, set at post-build in variant post-build-loadable+post-build-selectable / pre-compile in variant pre-compile, default-value=2047  # NAME Field 8 - Manufacturer Code | Manufacturer Code field of the NAME of this internal node.
        integer J1939NmNodeNameVehicleSystem: 0..127, set at post-build in variant post-build-loadable+post-build-selectable / pre-compile in variant pre-compile, default-value=127  # NAME Field 4 - Vehicle System | Vehicle System field of the NAME of this internal node.
        integer J1939NmNodeNameVehicleSystemInstance: 0..15, set at post-build in variant post-build-loadable+post-build-selectable / pre-compile in variant pre-compile, default-value=15  # NAME Field 3 - Vehicle System Instance | Vehicle System Instance field of the NAME of this internal node.
        integer J1939NmNodePreferredAddress: 0..253, scope=ECU, set at post-build in variant post-build-loadable+post-build-selectable / pre-compile in variant pre-compile, default-value=253  # Preferred Address | Source address of this internal node used for address claiming.
        boolean J1939NmNodeStartUpDelay: set at post-build in variant post-build-loadable+post-build-selectable / pre-compile in variant pre-compile, default-value=true  # Start-Up Delay | If enabled, the communication will start after a delay of 250ms after transmission of the initial AddressClaimed, depending on the claimed address. If disabled, communication will start immediately at start-up. | Please note: According to J1939/81, the 250ms delay is not required for single address CAs with desired source addresses in the ranges 0..127 or 248..253.
        enumeration J1939NmAddressConfigurationCapability [0..1]: set at post-build in variant post-build-loadable+post-build-selectable / pre-compile in variant pre-compile, origin=Vector Informatik, default-value=J1939NM_NCA  # Address configuration class of this internal node, which must match the status of NAME Field 1 - Arbitrary Address Capable. In the classes J1939NM_AAC and J1939NM_CCA, the J1939Nm will store the last valid address in NVRAM (see J1939NmAddressStorageBlock). In the classes J1939NM_SCA, J1939NM_SVCA, and J1939NM_NCA, the configured PreferredAddress is taken. J1939NM_NCA: Non-Configurable Address CA J1939NM_SVCA: Service Configurable Address CA J1939NM_SCA: Self-Configurable Address CA J1939NM_CCA: Command Configurable Address CA J1939NM_AAC: Arbitrary Address Capable CA
          J1939NM_NCA  # Non-Configurable Address CA
          J1939NM_SVCA  # Service Configurable Address CA
          J1939NM_SCA  # Self-Configurable Address CA
          J1939NM_CCA  # Command Configurable Address CA
          J1939NM_AAC  # Arbitrary Address Capable CA
        enumeration J1939NmAddressSearchAlgorithm [0..1]: set at post-build in variant post-build-loadable+post-build-selectable / pre-compile in variant pre-compile, origin=Vector Informatik, default-value=J1939NM_NONE  # Algorithm for searching an address. Only relevant when Address Configuration Capability is set to J1939NM_AAC. J1939NM_NONE: Go offline after failed address claim. J1939NM_ITER: Try iteratively to get an address, starting with the preferred address. J1939NM_REQUEST: Choose free address after a global request. Use the preferred address if possible. J1939NM_ISO_DIRECT: Use the ISO-11783 compliant address claiming sequence with directed request. J1939NM_ISO_GLOBAL: Use the ISO-11783 compliant address claiming sequence with global request. J1939NM_ISO_DELAYED: Wait 250ms for global request. If received, do not send own request. Otherwise identical to J1939NM_ISO_GLOBAL.
          J1939NM_NONE  # Go offline after failed address claim.
          J1939NM_ITER  # Try iteratively to get an address, starting with the preferred address.
          J1939NM_REQUEST  # Choose free address after a global request. Use the preferred address if possible.
          J1939NM_ISO_DIRECT  # Use the ISO-11783 compliant address claiming sequence with directed request.
          J1939NM_ISO_GLOBAL  # Use the ISO-11783 compliant address claiming sequence with global request.
          J1939NM_ISO_DELAYED  # Wait 250ms for global request. If received, do not send own request. Otherwise identical to J1939NM_ISO_GLOBAL.
        integer J1939NmFirstDynamicAddress: 0..253, set at post-build in variant post-build-loadable+post-build-selectable / pre-compile in variant pre-compile, origin=Vector Informatik, default-value=128  # First address to use when the preferred address could not be claimed.
        integer J1939NmLastDynamicAddress: 0..253, set at post-build in variant post-build-loadable+post-build-selectable / pre-compile in variant pre-compile, origin=Vector Informatik, default-value=247  # Last address to use when the preferred address could not be claimed.
        reference J1939NmNodeChannelRef [1..*]: set at pre-compile, destination=J1939NmChannel  # Channel Ref | Reference to the channels this internal node has access to.
      container J1939NmExternalNode [0..*]: post-build-changeable=true  # Logical node implemented in another ECU. Configures potential communication partners. If this node is connected to more than one channel, the external ECU is linked to the local ECU by each of these channels.
        integer J1939NmExternalNodeId: 0..65535, scope=ECU, set at pre-compile, origin=Vector Informatik, symbolic-name-value=true, default-value=0  # Node ID | Unique identifier of this external node.
        boolean J1939NmExternalNodeNameArbitraryAddressCapable: set at post-build in variant post-build-loadable+post-build-selectable / pre-compile in variant pre-compile, origin=Vector Informatik, default-value=true  # NAME Field 1 - Arbitrary Address Capable | Arbitrary Address Capable field of the NAME of this external node.
        boolean J1939NmExternalNodeNameArbitraryAddressCapableIgnored: set at post-build in variant post-build-loadable+post-build-selectable / pre-compile in variant pre-compile, origin=Vector Informatik, default-value=false  # NAME Field 1 - Arbitrary Address Capable - Ignored | If set, the Arbitrary Address Capable field of the NAME is ignored during node detection.
        integer J1939NmExternalNodeNameECUInstance: 0..7, set at post-build in variant post-build-loadable+post-build-selectable / pre-compile in variant pre-compile, origin=Vector Informatik, default-value=7  # NAME Field 7 - ECU Instance | ECU Instance field of the NAME of this external node.
        boolean J1939NmExternalNodeNameECUInstanceIgnored: set at post-build in variant post-build-loadable+post-build-selectable / pre-compile in variant pre-compile, origin=Vector Informatik, default-value=false  # NAME Field 7 - ECU Instance - Ignored | If set, the ECU Instance field of the NAME is ignored during node detection.
        integer J1939NmExternalNodeNameFunction: 0..255, set at post-build in variant post-build-loadable+post-build-selectable / pre-compile in variant pre-compile, origin=Vector Informatik, default-value=255  # NAME Field 5 - Function | Function field of the NAME of this external node.
        boolean J1939NmExternalNodeNameFunctionIgnored: set at post-build in variant post-build-loadable+post-build-selectable / pre-compile in variant pre-compile, origin=Vector Informatik, default-value=false  # NAME Field 5 - Function - Ignored | If set, the Function field of the NAME is ignored during node detection.
        integer J1939NmExternalNodeNameFunctionInstance: 0..31, set at post-build in variant post-build-loadable+post-build-selectable / pre-compile in variant pre-compile, origin=Vector Informatik, default-value=31  # NAME Field 6 - Function Instance | Function Instance field of the NAME of this external node.
        boolean J1939NmExternalNodeNameFunctionInstanceIgnored: set at post-build in variant post-build-loadable+post-build-selectable / pre-compile in variant pre-compile, origin=Vector Informatik, default-value=false  # NAME Field 6 - Function Instance - Ignored | If set, the Function Instance field of the NAME is ignored during node detection.
        integer J1939NmExternalNodeNameIdentityNumber: 0..2097151, set at post-build in variant post-build-loadable+post-build-selectable / pre-compile in variant pre-compile, origin=Vector Informatik, default-value=2097151  # NAME Field 9 - Identity Number | Identity Number field of the NAME of this external node.
        boolean J1939NmExternalNodeNameIdentityNumberIgnored: set at post-build in variant post-build-loadable+post-build-selectable / pre-compile in variant pre-compile, origin=Vector Informatik, default-value=false  # NAME Field 9 - Identity Number - Ignored | If set, the Identity Number field of the NAME is ignored during node detection.
        integer J1939NmExternalNodeNameIndustryGroup: 0..7, set at post-build in variant post-build-loadable+post-build-selectable / pre-compile in variant pre-compile, origin=Vector Informatik, default-value=7  # NAME Field 2 - Industry Group | Industry Group field of the NAME of this external node.
        boolean J1939NmExternalNodeNameIndustryGroupIgnored: set at post-build in variant post-build-loadable+post-build-selectable / pre-compile in variant pre-compile, origin=Vector Informatik, default-value=false  # NAME Field 2 - Industry Group - Ignored | If set, the Industry Group field of the NAME is ignored during node detection.
        integer J1939NmExternalNodeNameManufacturerCode: 0..2047, set at post-build in variant post-build-loadable+post-build-selectable / pre-compile in variant pre-compile, origin=Vector Informatik, default-value=2047  # NAME Field 8 - Manufacturer Code | Manufacturer Code field of the NAME of this external node.
        boolean J1939NmExternalNodeNameManufacturerCodeIgnored: set at post-build in variant post-build-loadable+post-build-selectable / pre-compile in variant pre-compile, origin=Vector Informatik, default-value=false  # NAME Field 8 - Manufacturer Code - Ignored | If set, the Manufacturer Code field of the NAME is ignored during node detection.
        integer J1939NmExternalNodeNameVehicleSystem: 0..127, set at post-build in variant post-build-loadable+post-build-selectable / pre-compile in variant pre-compile, origin=Vector Informatik, default-value=127  # NAME Field 4 - Vehicle System | Vehicle System field of the NAME of this external node.
        boolean J1939NmExternalNodeNameVehicleSystemIgnored: set at post-build in variant post-build-loadable+post-build-selectable / pre-compile in variant pre-compile, origin=Vector Informatik, default-value=false  # NAME Field 4 - Vehicle System - Ignored | If set, the Vehicle System field of the NAME is ignored during node detection.
        integer J1939NmExternalNodeNameVehicleSystemInstance: 0..15, set at post-build in variant post-build-loadable+post-build-selectable / pre-compile in variant pre-compile, origin=Vector Informatik, default-value=15  # NAME Field 3 - Vehicle System Instance | Vehicle System Instance field of the NAME of this external node.
        boolean J1939NmExternalNodeNameVehicleSystemInstanceIgnored: set at post-build in variant post-build-loadable+post-build-selectable / pre-compile in variant pre-compile, origin=Vector Informatik, default-value=false  # NAME Field 3 - Vehicle System Instance - Ignored | If set, the Vehicle System Instance field of the NAME is ignored during node detection.
        integer J1939NmExternalNodePreferredAddress: 0..253, set at post-build in variant post-build-loadable+post-build-selectable / pre-compile in variant pre-compile, origin=Vector Informatik, default-value=253  # Preferred Address | Virtual source address of this external node.
        reference J1939NmExternalNodeChannelRef [1..*]: set at post-build in variant post-build-loadable+post-build-selectable / pre-compile in variant pre-compile, origin=Vector Informatik, destination=J1939NmChannel  # Channel Ref | Reference to the channels of the local ECU this external node has access to.
        reference J1939NmExternalNodeGatewayedChannelRef [0..*]: set at pre-compile, origin=Vector Informatik, destination=J1939NmChannel  # Gatewayed Channel Ref | Reference to the channels on which messages to/from this external node shall be gatewayed. The address claim from the external node will be replicated on these channels. Please note: This feature is not yet supported.
      container J1939NmSharedAddressSpace [0..*]: post-build-changeable=true  # Set of J1939NmChannels that share a common address space. Please note: This feature is not yet supported.
        reference J1939NmSharedChannel [2..*]: set at post-build in variant post-build-loadable+post-build-selectable / pre-compile in variant pre-compile, origin=Vector Informatik, destination=J1939NmChannel  # Reference to the channels that belong to the shared address space. Address claims will be routed between these channels. Please note: This feature is not yet supported.
    container J1939NmDemEventParameterRefs [0..1]  # Container for the references to DemEventParameter elements which shall be invoked using the API Dem_ReportErrorStatus in case the corresponding error occurs. The EventId is taken from the referenced DemEventParameter's DemEventId value. The standardized errors are provided in the container and can be extended by vendor specific error references.
      symbolic name reference J1939NM_E_ADDRESS_LOST: set at pre-compile, destination=DemEventParameter  # E_ADDRESS_LOST | Reference to the DemEventParameter which shall be issued when the ECU failed to claim one of its addresses.
    container J1939NmGeneral  # General configuration parameters of the J1939Nm module.
      boolean J1939NmDevErrorDetect: set at pre-compile, default-value=true  # Enables/disables the development error detection. Note: In general, the development error detection is recommended during pre-test phase. It is not recommended to enable the development error detection in production code due to increased runtime and ROM needs.
      float J1939NmMainFunctionPeriod: 0.001..0.255, scope=ECU, set at pre-compile, default-value=0.01  # Execution cycle of J1939Nm_MainFunction.
      float J1939NmTxConfirmationTimeout: 0..65.535, set at pre-compile, default-value=1.5  # Time to wait for a confirmation after transmission of a message. After this time, TxConfirmation is not expected to be called for the last transmission, and the message is assumed to have been lost.
      function name J1939NmUserCallout [0..1]: set at pre-compile  # Name of the <User_AddressClaimedIndication> callout function. The callout function is enabled when this parameter is configured.
      string J1939NmUserCalloutHeaderFile [0..1]: set at pre-compile  # Name of the header file which provides the prototype of the <User_AddressClaimedIndication> configured via User Callout.
      boolean J1939NmVersionInfoApi: set at pre-compile, default-value=false  # Version Info API | Enables/disables the function J1939Nm_GetVersionInfo() to get major, minor and patch version information.
      float J1939NmBusOffDelayTickPeriod [0..1]: 0.001..0.255, set at pre-compile, default-value=0.02  # Bus-Off Delay Tick Period | Duration of ticks that are used to time bus-off delays after conflicting address claims. This parameter should be synchronized with the main function period of the CAN State Manager.
      boolean J1939NmDynamicAddressSupport [0..1]: set at pre-compile, origin=Vector Informatik, default-value=false  # Enables/disables support for tracking addresses of external nodes and for dynamic changes of internal node addresses.
      string J1939NmUserConfigurationFile [0..1]: set at pre-compile, origin=Vector Informatik  # Reference to an external user configuration file that will be included during generation. The content of the user configuration file will be added at the end of the generated module configuration file and allows altering or extending the generated code. Caution: User configuration files can cause the software module to malfunction and must only be used with great care!
      float J1939NmAddressRefreshTime [0..1]: 1..65535, set at pre-compile, origin=Vector Informatik, default-value=60  # Time between two address refresh cycles. Address refresh is disabled when this parameter is not present. During address refresh, a request for AddressClaimed is sent to the bus, and after the request timeout, all external nodes that did not respond are removed or set to inactive.
      boolean J1939NmNameManagementSupport: set at pre-compile, origin=Vector Informatik, default-value=false  # NAME Management Support | Enables/disables an API to access and manipulate the table of internal nodes and of active external nodes, and the capability to react to NAME changes using the NM message.
      boolean J1939NmGatewaySupport: set at pre-compile, origin=Vector Informatik, default-value=false  # Enables/disables support for claiming the addresses of routed messages. Please note: This feature is not yet supported.
      boolean J1939NmRuntimeErrorReport: set at pre-compile, origin=Vector Informatik, default-value=true  # Enables/disables the reporting of runtime errors.
      symbolic name reference J1939NmAddressStorageBlock [0..1]: set at pre-compile, origin=Vector Informatik, destination=NvMBlockDescriptor  # Reference to the NVRAM block where the last valid addresses of the internal nodes are stored. This reference is only required if for at least one internal node the Address Configuration Capability is configured to J1939NM_AAC or to J1939NM_CCA.
      symbolic name reference J1939NmNameStorageBlock [0..1]: set at pre-compile, origin=Vector Informatik, destination=NvMBlockDescriptor  # NAME Storage Block | Reference to the NVRAM block where the currently assigned NAMEs of the internal nodes are stored. This reference is only required if name management support is enabled.
  bsw implementation J1939Nm_Impl: programming-language=C, sw-version=3.00.00, used-code-generator=DaVinci Configurator, vendor-id=30, ar-release-version=4.02.02, behavior=J1939NmBehavior, preconfigured-configuration=J1939Nm_Pre, recommended-configuration=J1939Nm_Rec, vendor-specific-module-def=J1939Nm
  module config J1939Nm_Pre: definition=J1939Nm
  module config J1939Nm_Rec: definition=J1939Nm
