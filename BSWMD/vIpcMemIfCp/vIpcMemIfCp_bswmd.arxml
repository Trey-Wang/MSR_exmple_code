AUTOSAR XML (schema 4-3-0)
package /MICROSAR
  module definition vIpcMemIfCp [0..1]: category=VENDOR_SPECIFIC_MODULE_DEFINITION, variants pre-compile/post-build  # Configuration of the vIpcMemIfCp (Vector interprocessor communication interface for shared memory in classic AUTOSAR) module.
    container vIpcMemIfCpConfig: multiplicity set at pre-compile  # This container contains the global configuration parameter of the vIpcMemIfCp. It is a MultipleConfigurationContainer, i.e. this container and its sub-containers exit once per configuration set.
      container vIpcMemIfCpRxChannel [0..*]: multiplicity set at post-build in variant post-build / pre-compile in variant pre-compile  # Rx channel specific configuration parameters of the vIpcMemIfCp.
        integer vIpcMemIfCpRxChannelId: 0..65535, multiplicity set at pre-compile, origin=Vector Informatik, set at post-build in variant post-build / pre-compile in variant pre-compile, default-value=0  # This value specifies the unique channel index value beginning with 0.
        reference vIpcMemIfCpRxPduRef: multiplicity set at pre-compile, origin=Vector Informatik, set at post-build in variant post-build / pre-compile in variant pre-compile, destination=Pdu  # Reference to a PDU in the global PDU collection.
      container vIpcMemIfCpTxChannel [0..*]: multiplicity set at post-build in variant post-build / pre-compile in variant pre-compile  # Tx channel specific configuration parameters of the vIpcMemIfCp.
        integer vIpcMemIfCpTxChannelId: 0..65535, multiplicity set at pre-compile, origin=Vector Informatik, set at post-build in variant post-build / pre-compile in variant pre-compile, default-value=0  # This value specifies the unique channel index value beginning with 0.
        reference vIpcMemIfCpTxPduRef: multiplicity set at pre-compile, origin=Vector Informatik, set at post-build in variant post-build / pre-compile in variant pre-compile, destination=Pdu  # Reference to a PDU in the global PDU collection.
    container vIpcMemIfCpGeneral: multiplicity set at pre-compile  # General configuration parameters of the vIpcMemIfCp.
      boolean vIpcMemIfCpDevErrorDetect: multiplicity set at pre-compile, origin=Vector Informatik, set at pre-compile, default-value=true  # This parameter switches the Development Error Detection and Notification ON or OFF. true: Development error detection is enabled. false: Development error detection is disabled. Note: In general, the development error detection is recommended during pre-test phase. It is not recommended to enable the development error detection in production code due to increased runtime and ROM needs.
      float vIpcMemIfCpRxMainFunctionCycle: 0..65535, multiplicity set at pre-compile, origin=Vector Informatik, set at pre-compile, default-value=0.01  # This value specifies the call cycle for the vIpcMemIfCp_Rx_MainFunction in seconds.
      float vIpcMemIfCpTxMainFunctionCycle: 0..65535, multiplicity set at pre-compile, origin=Vector Informatik, set at pre-compile, default-value=0.01  # This value specifies the call cycle for the vIpcMemIfCp_Tx_MainFunction in seconds.
      boolean vIpcMemIfCpSafeBswChecks: multiplicity set at pre-compile, origin=Vector Informatik, set at pre-compile, default-value=false  # Selects whether safety checks are used. These checks improve robustness as e.g. invalid parameter values are detected before a function is executed. This attribute has to be enabled for safety projects where this component is mapped to an ASIL partition.
      string vIpcMemIfCpUserConfigFile [0..1]: multiplicity set at pre-compile, origin=Vector Informatik, set at pre-compile, default-value=vIpcMemIfCp_UserCfg.h  # Reference to an external text file that will be included during generation to vIpcMemIfCp_Cfg.h. The content of the user configuration file will be added at the end of the generated module configuration file and allows altering or extending the generated code. Caution: User configuration files can cause the software module to malfunction and must only be used with great care!
      function name vIpcMemIfCpUserTxNotificationCbk [0..1]: multiplicity set at pre-compile, origin=Vector Informatik, set at pre-compile, default-value=vIpcMemIfCp_UserTxNotification  # This parameter defines the user callback function for the transmission end notification. This function is called at the end of a transmission and can be used to notify the receiver side about a finished transmission. Prototype: void vIpcMemIfCp_UserTxNotification(PduIdType ChannelId)
      boolean vIpcMemIfCpVersionInfoApi: multiplicity set at pre-compile, origin=Vector Informatik, set at pre-compile, default-value=false  # This parameter enables/disables the function vIpcMemIfCp_GetVersionInfo() to get major, minor and patch version information.
  bsw implementation vIpcMemIfCp_Impl: programming-language=C, sw-version=1.00.00, used-code-generator=DaVinci Configurator, vendor-id=30, ar-release-version=4.03.00, behavior=vIpcMemIfCpBehavior, preconfigured-configuration=vIpcMemIfCp_Pre, recommended-configuration=vIpcMemIfCp_Rec, vendor-specific-module-def=vIpcMemIfCp
  module config vIpcMemIfCp_Pre: definition=vIpcMemIfCp
  module config vIpcMemIfCp_Rec: definition=vIpcMemIfCp
