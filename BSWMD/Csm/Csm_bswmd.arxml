AUTOSAR XML (schema 4-3-0)
# COPYRIGHT
# Copyright (c) 2017 by Vector Informatik GmbH. All rights reserved.
# This software is copyright protected and proprietary to Vector Informatik GmbH.
# Vector Informatik GmbH grants to you only those rights as set out in the license conditions.
package /MICROSAR
  module definition Csm [0..1]: category=VENDOR_SPECIFIC_MODULE_DEFINITION, refined-module-def=Csm, variants pre-compile  # Configuration of the Csm (CryptoServiceManager) module.
    container CsmCallbacks [0..1]: multiplicity set at pre-compile  # Container for callback function configurations
      container CsmCallback [0..*]: multiplicity set at pre-compile  # Container for configuration of a callback function
        function name CsmCallbackFunc: multiplicity set at pre-compile, set at pre-compile  # Callback function to be called if an asynchronous operation has finished. The corresponding job has to be configured to be processed asynchronously.
        integer CsmCallbackId: 0..4294967295, multiplicity set at pre-compile, set at pre-compile, symbolic-name-value=true, default-value=0  # Identifier of the callback function.
    container CsmGeneral: multiplicity set at pre-compile  # Container for common configuration options.
      integer CsmAsymPrivateKeyMaxLength: 1..4294967295, multiplicity set at pre-compile, set at pre-compile, default-value=32  # Maximum length in bytes of an asymmetric public key for all algorithm.
      integer CsmAsymPublicKeyMaxLength: 1..4294967295, multiplicity set at pre-compile, set at pre-compile, default-value=1024  # Maximum length in bytes of an asymmetric key for all algorithm.
      boolean CsmDevErrorDetect: multiplicity set at pre-compile, set at pre-compile, default-value=true  # Switches the development error detection and notification on or off. | * true: detection and notification is enabled. * false: detection and notification is disabled.
      float CsmMainFunctionPeriod: 0..1.7976931348623157E+308, multiplicity set at pre-compile, set at pre-compile, default-value=0.01  # Specifies the period of main function Csm_MainFunction in seconds.
      integer CsmSymKeyMaxLength: 1..4294967295, multiplicity set at pre-compile, set at pre-compile, default-value=16  # Maximum length in bytes of a symmetric key for all algorithm
      boolean CsmUseDeprecated: multiplicity set at pre-compile, set at pre-compile, default-value=false  # Not used and not supported. Decides if the deprecated interfaces shall be used (Backwards combatibility). | true: use deprecated interfaces. false: use normal interfaces.
      boolean CsmVersionInfoApi: multiplicity set at pre-compile, set at pre-compile, default-value=false  # Pre-processor switch to enable and disable availability of the API Csm_GetVersionInfo(). | True: API Csm_GetVersionInfo() is available. False: API Csm_GetVersionInfo() is not available.
      string CsmCustomIncludeFiles [0..*]: multiplicity set at pre-compile, origin=Vector Informatik, set at pre-compile, min-length=3  # Include custom header file.
      boolean CsmCallbackStartNotification: multiplicity set at pre-compile, origin=Vector Informatik, set at pre-compile, default-value=false  # In ASR 4.3.0, only callbacks for Update (if CsmJobPrimitiveCallbackUpdateNotification is enabled) and Finish shall be forwarded to application. If this switch is enabled, Callback is also notified if Start was handled and every Update is notified too (CsmJobPrimitiveCallbackUpdateNotification is ignored).
    container CsmJobs [0..1]: multiplicity set at pre-compile  # Container for configuration of CSM jobs.
      container CsmJob [1..*]: multiplicity set at pre-compile  # Container for configuration of CSM job. The container name serves as a symbolic name for the identifier of a job configuration.
        integer CsmJobId: 0..4294967295, multiplicity set at pre-compile, set at pre-compile, symbolic-name-value=true, default-value=0  # Identifier of the CSM job
        boolean CsmJobPrimitiveCallbackUpdateNotification [0..1]: multiplicity set at pre-compile, set at pre-compile, default-value=false  # This parameter indicates, whether the callback function shall be called, if the UPDATE operation has been finished.
        integer CsmJobPriority: 0..4294967295, multiplicity set at pre-compile, set at pre-compile  # Priority of the job. The higher the value, the higher the job's priority. | The higher the value, the higher the job's priority.
        boolean CsmJobUsePort: multiplicity set at pre-compile, set at pre-compile, default-value=false  # Does the job need RTE interfaces? | True: the job needs RTE interfaces False: the job needs no RTE interfaces
        reference CsmJobKeyRef: multiplicity set at pre-compile, set at pre-compile, destination=CsmKey  # This parameter refers to the key which shall be used for the CsmPrimitive. It's possible to use a CsmKey for different jobs
        reference CsmJobPrimitiveCallbackRef [0..1]: multiplicity set at pre-compile, set at pre-compile, destination=CsmCallback  # This parameter refers to the used CsmCallback. | The referred CsmCallback is called when the crypto job has been finished.
        reference CsmJobPrimitiveRef: multiplicity set at pre-compile, set at pre-compile, destination=CsmPrimitives  # This parameter refers to the used CsmPrimitive. | Different jobs may refer to one CsmPrimitive. The referred CsmPrimitive provides detailed information on the actual cryptographic routine.
        reference CsmJobQueueRef: multiplicity set at pre-compile, set at pre-compile, destination=CsmQueue  # This parameter refers to the queue. | The queue is used if the underlying crypto driver object is busy. The queue refers also to the channel which is used.
    container CsmKeys [0..1]: multiplicity set at pre-compile  # Container for CSM key configurations.
      container CsmKey [0..*]: multiplicity set at pre-compile  # Container for configuration of a CSM key. The container name serves as a symbolic name for the identifier of a key configuration.
        integer CsmKeyId: 0..4294967295, multiplicity set at pre-compile, set at pre-compile, symbolic-name-value=true, default-value=0  # Identifier of the CsmKey
        boolean CsmKeyUsePort: multiplicity set at pre-compile, set at pre-compile, default-value=false  # Does the key need RTE interfaces? | True: RTE interfaces used for this key False: No RTE interfaces used for this key
        symbolic name reference CsmKeyRef: multiplicity set at pre-compile, set at pre-compile, destination=CryIfKey  # This parameter refers to the used CryIfKey. The underlying CryIfKey refers to a specific CryptoKey in the Crypto Driver.
    container CsmPrimitives [0..*]: multiplicity set at pre-compile  # Container for configuration of CsmPrimitives
      container CsmAEADDecrypt [0..1]: multiplicity set at pre-compile  # Configuration of AEAD decryption primitives
        container CsmAEADDecryptConfig: multiplicity set at pre-compile  # Container for configuration of a CSM decryption interface. The container name serves as a symbolic name for the identifier of an decryption interface.
          enumeration CsmAEADDecryptAlgorithmFamiliy: {CRYPTO_ALGOFAM_3DES, CRYPTO_ALGOFAM_AES, CRYPTO_ALGOFAM_CUSTOM}, multiplicity set at pre-compile, set at pre-compile  # Not used. Determines the algorithm family used for the crypto service. This parameter defines the most significant part of the algorithm.
          enumeration CsmAEADDecryptAlgorithmFamily: {CRYPTO_ALGOFAM_3DES, CRYPTO_ALGOFAM_AES, CRYPTO_ALGOFAM_CUSTOM}, multiplicity set at pre-compile, origin=Vector Informatik, set at pre-compile  # Determines the algorithm family used for the crypto service. This parameter defines the most significant part of the algorithm.
          string CsmAEADDecryptAlgorithmFamilyCustom [0..1]: multiplicity set at pre-compile, set at pre-compile  # This is the name of the custom algorithm family, if CRYPTO_ALGOFAM_CUSTOM is used as CsmAEADDecryptAlgorithmFamily.
          integer CsmAEADDecryptAlgorithmKeyLength: 1..4294967295, multiplicity set at pre-compile, set at pre-compile, default-value=16  # Size of the AEAD decryption key in bytes Not used.
          enumeration CsmAEADDecryptAlgorithmMode: {CRYPTO_ALGOFAM_CUSTOM, CRYPTO_ALGOMODE_GCM}, multiplicity set at pre-compile, set at pre-compile  # Determines the algorithm mode used for the crypto service
          string CsmAEADDecryptAlgorithmModeCustom [0..1]: multiplicity set at pre-compile, set at pre-compile  # Name of the custom algorithm mode used for the crypto service
          integer CsmAEADDecryptAssociatedDataMaxLength [0..1]: 1..4294967295, multiplicity set at pre-compile, set at pre-compile  # Max size of the input associated data length in bytes
          integer CsmAEADDecryptCiphertextMaxLength [0..1]: 1..4294967295, multiplicity set at pre-compile, set at pre-compile  # Max size of the input ciphertext in bytes
          integer CsmAEADDecryptPlaintextMaxLength [0..1]: 1..4294967295, multiplicity set at pre-compile, set at pre-compile  # Size of the output plaintext length in bytes
          enumeration CsmAEADDecryptProcessing: {CSM_ASYNCHRONOUS, CSM_SYNCHRONOUS}, multiplicity set at pre-compile, set at pre-compile  # Determines how the interface shall be used for that primitive. Synchronous processing returns with the result while asynchronous processing returns without processing the job. The caller will be notified by the corresponding callback
          integer CsmAEADDecryptTagLength: 1..4294967295, multiplicity set at pre-compile, set at pre-compile  # Size of the input Tag length in BITS
          reference CsmAEADDecryptKeyRef: multiplicity set at pre-compile, set at pre-compile, destination=CsmKey  # This parameter refers to the key used for that decryption primitive.
          reference CsmAEADDecryptQueueRef [0..1]: multiplicity set at pre-compile, set at pre-compile, destination=CsmQueue  # Not used. Queue is referred in Job. This parameter refers to the queue used for that decryption primitive.
      container CsmAEADEncrypt [0..1]: multiplicity set at pre-compile  # Configuration of AEAD encryption primitives
        container CsmAEADEncryptConfig: multiplicity set at pre-compile  # Container for configuration of a CSM encryption interface. The container name serves as a symbolic name for the identifier of an encryption interface.
          enumeration CsmAEADEncryptAlgorithmFamiliy: {CRYPTO_ALGOFAM_3DES, CRYPTO_ALGOFAM_AES, CRYPTO_ALGOFAM_CUSTOM}, multiplicity set at pre-compile, set at pre-compile  # Not used. Determines the algorithm family used for the crypto service. This parameter defines the most significant part of the algorithm.
          enumeration CsmAEADEncryptAlgorithmFamily: {CRYPTO_ALGOFAM_3DES, CRYPTO_ALGOFAM_AES, CRYPTO_ALGOFAM_CUSTOM}, multiplicity set at pre-compile, origin=Vector Informatik, set at pre-compile  # Determines the algorithm family used for the crypto service. This parameter defines the most significant part of the algorithm.
          string CsmAEADEncryptAlgorithmFamilyCustom [0..1]: multiplicity set at pre-compile, set at pre-compile  # This is the name of the custom algorithm family, if CRYPTO_ALGOFAM_CUSTOM is used as CsmAEADEncryptAlgorithmFamily.
          integer CsmAEADEncryptAlgorithmKeyLength: 1..4294967295, multiplicity set at pre-compile, set at pre-compile, default-value=16  # Size of the AEAD encryption key in bytes. Not used.
          enumeration CsmAEADEncryptAlgorithmMode: {CRYPTO_ALGOFAM_CUSTOM, CRYPTO_ALGOMODE_GCM}, multiplicity set at pre-compile, set at pre-compile  # Determines the algorithm mode used for the crypto service
          string CsmAEADEncryptAlgorithmModeCustom [0..1]: multiplicity set at pre-compile, set at pre-compile  # Name of the custom algorithm mode used for the crypto service
          integer CsmAEADEncryptAssociatedDataMaxLength [0..1]: 1..4294967295, multiplicity set at pre-compile, set at pre-compile  # Max size of the input associated data length in bytes
          integer CsmAEADEncryptCiphertextMaxLength [0..1]: 1..4294967295, multiplicity set at pre-compile, set at pre-compile  # Max size of the output ciphertext length in bytes
          integer CsmAEADEncryptPlaintextMaxLength [0..1]: 1..4294967295, multiplicity set at pre-compile, set at pre-compile  # Max size of the input plaintext length in bytes
          enumeration CsmAEADEncryptProcessing: {CSM_ASYNCHRONOUS, CSM_SYNCHRONOUS}, multiplicity set at pre-compile, set at pre-compile  # Determines how the interface shall be used for that primitive. Synchronous processing returns with the result while asynchronous processing returns without processing the job. The caller will be notified by the corresponding callback
          integer CsmAEADEncryptTagLength: 1..4294967295, multiplicity set at pre-compile, set at pre-compile  # Size of the output Tag length in bytes
          reference CsmAEADEncryptKeyRef: multiplicity set at pre-compile, set at pre-compile, destination=CsmKey  # This parameter refers to the key used for that encryption primitive.
          reference CsmAEADEncryptQueueRef [0..1]: multiplicity set at pre-compile, set at pre-compile, destination=CsmQueue  # Not used. Queue is referred in Job. This parameter refers to the queue used for that encryption primitive.
      container CsmDecrypt [0..1]: multiplicity set at pre-compile  # Configurations of Decryption primitives
        container CsmDecryptConfig: multiplicity set at pre-compile  # Container for configuration of a CSM decryption interface. The container name serves as a symbolic name for the identifier of an decryption interface.
          enumeration CsmDecryptAlgorithmFamiliy: {CRYPTO_ALGOFAM_3DES, CRYPTO_ALGOFAM_AES, CRYPTO_ALGOFAM_CHACHA, CRYPTO_ALGOFAM_CUSTOM, CRYPTO_ALGOFAM_ECIES, CRYPTO_ALGOFAM_RSA}, multiplicity set at pre-compile, set at pre-compile  # Not used. Determines the algorithm family used for the crypto service. This parameter defines the most significant part of the algorithm.
          enumeration CsmDecryptAlgorithmFamily: {CRYPTO_ALGOFAM_3DES, CRYPTO_ALGOFAM_AES, CRYPTO_ALGOFAM_CHACHA, CRYPTO_ALGOFAM_CUSTOM, CRYPTO_ALGOFAM_ECIES, CRYPTO_ALGOFAM_RSA}, multiplicity set at pre-compile, origin=Vector Informatik, set at pre-compile  # Determines the algorithm family used for the crypto service. This parameter defines the most significant part of the algorithm.
          string CsmDecryptAlgorithmFamilyCustom [0..1]: multiplicity set at pre-compile, set at pre-compile  # Name of the custom algorithm family, if CRYPTO_ALGOFAM_CUSTOM is used as CsmDecryptAlgorithmFamily.
          integer CsmDecryptAlgorithmKeyLength: 1..4294967295, multiplicity set at pre-compile, set at pre-compile, default-value=16  # Size of the encryption key in bytes. Not used.
          enumeration CsmDecryptAlgorithmMode: {CRYPTO_ALGOMODE_12ROUNDS, CRYPTO_ALGOMODE_20ROUNDS, CRYPTO_ALGOMODE_8ROUNDS, CRYPTO_ALGOMODE_CBC, CRYPTO_ALGOMODE_CFB, CRYPTO_ALGOMODE_CTR, CRYPTO_ALGOMODE_CUSTOM, CRYPTO_ALGOMODE_ECB, CRYPTO_ALGOMODE_OFB, CRYPTO_ALGOMODE_RSAES_OAEP, CRYPTO_ALGOMODE_RSAES_PKCS1_v1_5, CRYPTO_ALGOMODE_XTS}, multiplicity set at pre-compile, set at pre-compile  # Determines the algorithm mode used for the crypto service
          string CsmDecryptAlgorithmModeCustom [0..1]: multiplicity set at pre-compile, set at pre-compile  # Name of the custom algorithm mode used for the crypto service
          enumeration CsmDecryptAlgorithmSecondaryFamily: {CRYPTO_ALGOFAM_CUSTOM, CRYPTO_ALGOFAM_NOT_SET}, multiplicity set at pre-compile, set at pre-compile, default-value=CRYPTO_ALGOFAM_NOT_SET  # Determines the secondary algorithm family used for the crypto service
          string CsmDecryptAlgorithmSecondaryFamilyCustom [0..1]: multiplicity set at pre-compile, set at pre-compile  # Name of the custom secondary algorithm family used for the crypto service
          integer CsmDecryptDataMaxLength [0..1]: 1..4294967295, multiplicity set at pre-compile, set at pre-compile  # Max size of the input ciphertext length in bytes
          enumeration CsmDecryptProcessing: {CSM_ASYNCHRONOUS, CSM_SYNCHRONOUS}, multiplicity set at pre-compile, set at pre-compile  # Determines how the interface shall be used for that primitive. Synchronous processing returns with the result while asynchronous processing returns without processing the job. The caller will be notified by the corresponding callback
          integer CsmDecryptResultMaxLength [0..1]: 1..4294967295, multiplicity set at pre-compile, set at pre-compile  # Max size of the output plaintext length in bytes
      container CsmEncrypt [0..1]: multiplicity set at pre-compile  # Configurations of Encryption primitives
        container CsmEncryptConfig: multiplicity set at pre-compile  # Container for configuration of a CSM encryption interface. The container name serves as a symbolic name for the identifier of an encryption interface.
          enumeration CsmEncryptAlgorithmFamiliy: {CRYPTO_ALGOFAM_3DES, CRYPTO_ALGOFAM_AES, CRYPTO_ALGOFAM_CHACHA, CRYPTO_ALGOFAM_CUSTOM, CRYPTO_ALGOFAM_ECIES, CRYPTO_ALGOFAM_RSA}, multiplicity set at pre-compile, set at pre-compile  # Not used. Determines the algorithm family used for the crypto service. This parameter defines the most significant part of the algorithm.
          enumeration CsmEncryptAlgorithmFamily: {CRYPTO_ALGOFAM_3DES, CRYPTO_ALGOFAM_AES, CRYPTO_ALGOFAM_CHACHA, CRYPTO_ALGOFAM_CUSTOM, CRYPTO_ALGOFAM_ECIES, CRYPTO_ALGOFAM_RSA}, multiplicity set at pre-compile, origin=Vector Informatik, set at pre-compile  # Determines the algorithm family used for the crypto service. This parameter defines the most significant part of the algorithm.
          string CsmEncryptAlgorithmFamilyCustom [0..1]: multiplicity set at pre-compile, set at pre-compile  # This is the name of the custom algorithm family, if CRYPTO_ALGOFAM_CUSTOM is used as CsmEncryptAlgorithmFamily.
          enumeration CsmEncryptAlgorithmMode: {CRYPTO_ALGOMODE_12ROUNDS, CRYPTO_ALGOMODE_20ROUNDS, CRYPTO_ALGOMODE_8ROUNDS, CRYPTO_ALGOMODE_CBC, CRYPTO_ALGOMODE_CFB, CRYPTO_ALGOMODE_CTR, CRYPTO_ALGOMODE_CUSTOM, CRYPTO_ALGOMODE_ECB, CRYPTO_ALGOMODE_NOT_SET, CRYPTO_ALGOMODE_OFB, CRYPTO_ALGOMODE_RSAES_OAEP, CRYPTO_ALGOMODE_RSAES_PKCS1_v1_5, CRYPTO_ALGOMODE_XTS}, multiplicity set at pre-compile, set at pre-compile  # Determines the algorithm mode used for the crypto service
          string CsmEncryptAlgorithmModeCustom [0..1]: multiplicity set at pre-compile, set at pre-compile  # Name of the custom algorithm mode used for the crypto service
          enumeration CsmEncryptAlgorithmSecondaryFamily: {CRYPTO_ALGOFAM_CUSTOM, CRYPTO_ALGOFAM_NOT_SET}, multiplicity set at pre-compile, set at pre-compile, default-value=CRYPTO_ALGOFAM_NOT_SET  # Determines the algorithm family used for the crypto service
          string CsmEncryptAlgorithmSecondaryFamilyCustom [0..1]: multiplicity set at pre-compile, set at pre-compile  # Name of the custom secondary algorithm family used for the crypto service
          integer CsmEncryptDataMaxLength [0..1]: 1..4294967295, multiplicity set at pre-compile, set at pre-compile  # Max size of the input plaintext length in bytes
          enumeration CsmEncryptProcessing: {CSM_ASYNCHRONOUS, CSM_SYNCHRONOUS}, multiplicity set at pre-compile, set at pre-compile  # Determines how the interface shall be used for that primitive. Synchronous processing returns with the result while asynchronous processing returns without processing the job. The caller will be notified by the corresponding callback
          integer CsmEncryptResultMaxLength [0..1]: 1..4294967295, multiplicity set at pre-compile, set at pre-compile  # Max size of the output cipher length in bytes
      container CsmHash [0..1]: multiplicity set at pre-compile  # Container for Hash Configurations
        container CsmHashConfig: multiplicity set at pre-compile  # Container for configuration of a CSM hash. The container name serves as a symbolic name for the identifier of a key configuration.
          enumeration CsmHashAlgorithmFamiliy: {CRYPTO_ALGOFAM_BLAKE_1_256, CRYPTO_ALGOFAM_BLAKE_1_512, CRYPTO_ALGOFAM_BLAKE_2s_256, CRYPTO_ALGOFAM_BLAKE_2s_512, CRYPTO_ALGOFAM_CUSTOM, CRYPTO_ALGOFAM_RIPEMD160, CRYPTO_ALGOFAM_SHA1, CRYPTO_ALGOFAM_SHA2_224, CRYPTO_ALGOFAM_SHA2_256, CRYPTO_ALGOFAM_SHA2_384, CRYPTO_ALGOFAM_SHA2_512, CRYPTO_ALGOFAM_SHA2_512_224, CRYPTO_ALGOFAM_SHA2_512_256, CRYPTO_ALGOFAM_SHA3_224, CRYPTO_ALGOFAM_SHA3_256, CRYPTO_ALGOFAM_SHA3_384, CRYPTO_ALGOFAM_SHA3_512, CRYPTO_ALGOFAM_SHA3_SHAKE128, CRYPTO_ALGOFAM_SHA3_SHAKE256}, multiplicity set at pre-compile, set at pre-compile  # Not used. Determines the algorithm family used for the crypto service. This parameter defines the most significant part of the algorithm.
          enumeration CsmHashAlgorithmFamily: {CRYPTO_ALGOFAM_BLAKE_1_256, CRYPTO_ALGOFAM_BLAKE_1_512, CRYPTO_ALGOFAM_BLAKE_2s_256, CRYPTO_ALGOFAM_BLAKE_2s_512, CRYPTO_ALGOFAM_CUSTOM, CRYPTO_ALGOFAM_RIPEMD160, CRYPTO_ALGOFAM_SHA1, CRYPTO_ALGOFAM_SHA2_224, CRYPTO_ALGOFAM_SHA2_256, CRYPTO_ALGOFAM_SHA2_384, CRYPTO_ALGOFAM_SHA2_512, CRYPTO_ALGOFAM_SHA2_512_224, CRYPTO_ALGOFAM_SHA2_512_256, CRYPTO_ALGOFAM_SHA3_224, CRYPTO_ALGOFAM_SHA3_256, CRYPTO_ALGOFAM_SHA3_384, CRYPTO_ALGOFAM_SHA3_512, CRYPTO_ALGOFAM_SHA3_SHAKE128, CRYPTO_ALGOFAM_SHA3_SHAKE256}, multiplicity set at pre-compile, origin=Vector Informatik, set at pre-compile  # Determines the algorithm family used for the crypto service. This parameter defines the most significant part of the algorithm.
          string CsmHashAlgorithmFamilyCustom [0..1]: multiplicity set at pre-compile, set at pre-compile  # This is the name of the custom algorithm family, if CRYPTO_ALGOFAM_CUSTOM is used as CsmHashAlgorithmFamily.
          enumeration CsmHashAlgorithmMode: {CRYPTO_ALGOMODE_CUSTOM, CRYPTO_ALGOMODE_NOT_SET}, multiplicity set at pre-compile, set at pre-compile, default-value=CRYPTO_ALGOMODE_NOT_SET  # Determines the algorithm mode used for the crypto service
          string CsmHashAlgorithmModeCustom [0..1]: multiplicity set at pre-compile, set at pre-compile  # Name of the custom primitive mode.
          enumeration CsmHashAlgorithmSecondaryFamily: {CRYPTO_ALGOFAM_CUSTOM, CRYPTO_ALGOFAM_NOT_SET}, multiplicity set at pre-compile, set at pre-compile, default-value=CRYPTO_ALGOFAM_NOT_SET  # Determines the algorithm family used for the crypto service
          string CsmHashAlgorithmSecondaryFamilyCustom [0..1]: multiplicity set at pre-compile, set at pre-compile  # This is the second name of the custom algorithm family, if CRYPTO_ALGOFAM_CUSTOM is set as CsmHashAlgorithmSecondaryFamily.
          integer CsmHashDataMaxLength [0..1]: 1..4294967295, multiplicity set at pre-compile, set at pre-compile  # Max size of the input data length in bytes
          enumeration CsmHashProcessing: {CSM_ASYNCHRONOUS, CSM_SYNCHRONOUS}, multiplicity set at pre-compile, set at pre-compile  # Determines how the interface shall be used for that primitive. Synchronous processing returns with the result while asynchronous processing returns without processing the job. The caller will be notified by the corresponding callback.
          integer CsmHashResultLength: 1..4294967295, multiplicity set at pre-compile, set at pre-compile  # Size of the output hash length in bytes
      container CsmMacGenerate [0..1]: multiplicity set at pre-compile  # Configurations of MacGenerate primitives
        container CsmMacGenerateConfig: multiplicity set at pre-compile  # Container for configuration of a CSM mac generation interface. The container name serves as a symbolic name for the identifier of a MAC generation interface.
          enumeration CsmMacGenerateAlgorithmFamiliy: {CRYPTO_ALGOFAM_3DES, CRYPTO_ALGOFAM_AES, CRYPTO_ALGOFAM_BLAKE_1_256, CRYPTO_ALGOFAM_BLAKE_1_512, CRYPTO_ALGOFAM_BLAKE_2s_256, CRYPTO_ALGOFAM_BLAKE_2s_512, CRYPTO_ALGOFAM_CHACHA, CRYPTO_ALGOFAM_CUSTOM, CRYPTO_ALGOFAM_RIPEMD160, CRYPTO_ALGOFAM_RNG, CRYPTO_ALGOFAM_SHA1, CRYPTO_ALGOFAM_SHA2_224, CRYPTO_ALGOFAM_SHA2_256, CRYPTO_ALGOFAM_SHA2_384, CRYPTO_ALGOFAM_SHA2_512, CRYPTO_ALGOFAM_SHA2_512_224, CRYPTO_ALGOFAM_SHA2_512_256, CRYPTO_ALGOFAM_SHA3_224, CRYPTO_ALGOFAM_SHA3_256, CRYPTO_ALGOFAM_SHA3_384, CRYPTO_ALGOFAM_SHA3_512, CRYPTO_ALGOFAM_SHA3_SHAKE128, CRYPTO_ALGOFAM_SHA3_SHAKE256, CRYPTO_ALGOFAM_SIPHASH}, multiplicity set at pre-compile, set at pre-compile  # Not used. Determines the algorithm family used for the crypto service. This parameter defines the most significant part of the algorithm.
          enumeration CsmMacGenerateAlgorithmFamily: {CRYPTO_ALGOFAM_3DES, CRYPTO_ALGOFAM_AES, CRYPTO_ALGOFAM_BLAKE_1_256, CRYPTO_ALGOFAM_BLAKE_1_512, CRYPTO_ALGOFAM_BLAKE_2s_256, CRYPTO_ALGOFAM_BLAKE_2s_512, CRYPTO_ALGOFAM_CHACHA, CRYPTO_ALGOFAM_CUSTOM, CRYPTO_ALGOFAM_RIPEMD160, CRYPTO_ALGOFAM_RNG, CRYPTO_ALGOFAM_SHA1, CRYPTO_ALGOFAM_SHA2_224, CRYPTO_ALGOFAM_SHA2_256, CRYPTO_ALGOFAM_SHA2_384, CRYPTO_ALGOFAM_SHA2_512, CRYPTO_ALGOFAM_SHA2_512_224, CRYPTO_ALGOFAM_SHA2_512_256, CRYPTO_ALGOFAM_SHA3_224, CRYPTO_ALGOFAM_SHA3_256, CRYPTO_ALGOFAM_SHA3_384, CRYPTO_ALGOFAM_SHA3_512, CRYPTO_ALGOFAM_SHA3_SHAKE128, CRYPTO_ALGOFAM_SHA3_SHAKE256, CRYPTO_ALGOFAM_SIPHASH}, multiplicity set at pre-compile, origin=Vector Informatik, set at pre-compile  # Determines the algorithm family used for the crypto service. This parameter defines the most significant part of the algorithm.
          string CsmMacGenerateAlgorithmFamilyCustom [0..1]: multiplicity set at pre-compile, set at pre-compile  # This is the name of the custom algorithm family, | if CRYPTO_ALGOFAM_CUSTOM is used as CsmMacGenerateAlgorithmFamily
          integer CsmMacGenerateAlgorithmKeyLength: 1..4294967295, multiplicity set at pre-compile, set at pre-compile, default-value=16  # Size of the MAC key in bytes Not used.
          enumeration CsmMacGenerateAlgorithmMode: {CRYPTO_ALGOMODE_CMAC, CRYPTO_ALGOMODE_CTRDRBG, CRYPTO_ALGOMODE_CUSTOM, CRYPTO_ALGOMODE_GMAC, CRYPTO_ALGOMODE_HMAC, CRYPTO_ALGOMODE_NOT_SET, CRYPTO_ALGOMODE_SIPHASH_2_4, CRYPTO_ALGOMODE_SIPHASH_4_8}, multiplicity set at pre-compile, set at pre-compile  # Determines the algorithm mode used for the crypto service
          string CsmMacGenerateAlgorithmModeCustom [0..1]: multiplicity set at pre-compile, set at pre-compile  # Name of the custom algorithm mode used for the crypto service
          enumeration CsmMacGenerateAlgorithmSecondaryFamily: {CRYPTO_ALGOFAM_CUSTOM, CRYPTO_ALGOFAM_NOT_SET}, multiplicity set at pre-compile, set at pre-compile, default-value=CRYPTO_ALGOFAM_NOT_SET  # Determines the secondary algorithm family used for the crypto service
          string CsmMacGenerateAlgorithmSecondaryFamilyCustom [0..1]: multiplicity set at pre-compile, set at pre-compile  # This is the second name of the custom algorithm family, if CRYPTO_ALGOFAM_CUSTOM is set as CsmHashAlgorithmSecondaryFamilyCustom.
          integer CsmMacGenerateDataMaxLength [0..1]: 1..4294967295, multiplicity set at pre-compile, set at pre-compile  # Max size of the input data length in bytes
          enumeration CsmMacGenerateProcessing: {CSM_ASYNCHRONOUS, CSM_SYNCHRONOUS}, multiplicity set at pre-compile, set at pre-compile  # Determines how the interface shall be used for that primitive. Synchronous processing returns with the result while asynchronous processing returns without processing the job. The caller will be notified by the corresponding callback.
          integer CsmMacGenerateResultLength: 1..4294967295, multiplicity set at pre-compile, set at pre-compile  # Size of the output MAC length in bytes
      container CsmMacVerify [0..1]: multiplicity set at pre-compile  # Configurations of MacVerify primitives
        container CsmMacVerifyConfig: multiplicity set at pre-compile  # Container for configuration of a CSM MAC verification interface. The container name serves as a symbolic name for the identifier of a MAC generation interface
          enumeration CsmMacVerifyAlgorithmFamiliy: {CRYPTO_ALGOFAM_AES, CRYPTO_ALGOFAM_BLAKE_1_256, CRYPTO_ALGOFAM_BLAKE_1_512, CRYPTO_ALGOFAM_BLAKE_2s_256, CRYPTO_ALGOFAM_BLAKE_2s_512, CRYPTO_ALGOFAM_CUSTOM, CRYPTO_ALGOFAM_RIPEMD160, CRYPTO_ALGOFAM_SHA1, CRYPTO_ALGOFAM_SHA2_224, CRYPTO_ALGOFAM_SHA2_256, CRYPTO_ALGOFAM_SHA2_384, CRYPTO_ALGOFAM_SHA2_512, CRYPTO_ALGOFAM_SHA2_512_224, CRYPTO_ALGOFAM_SHA2_512_256, CRYPTO_ALGOFAM_SHA3_224, CRYPTO_ALGOFAM_SHA3_256, CRYPTO_ALGOFAM_SHA3_384, CRYPTO_ALGOFAM_SHA3_512, CRYPTO_ALGOFAM_SHA3_SHAKE128, CRYPTO_ALGOFAM_SHA3_SHAKE256, CRYPTO_ALGOFAM_SIPHASH}, multiplicity set at pre-compile, set at pre-compile  # Not used. Determines the algorithm family used for the crypto service. This parameter defines the most significant part of the algorithm.
          enumeration CsmMacVerifyAlgorithmFamily: {CRYPTO_ALGOFAM_AES, CRYPTO_ALGOFAM_BLAKE_1_256, CRYPTO_ALGOFAM_BLAKE_1_512, CRYPTO_ALGOFAM_BLAKE_2s_256, CRYPTO_ALGOFAM_BLAKE_2s_512, CRYPTO_ALGOFAM_CUSTOM, CRYPTO_ALGOFAM_RIPEMD160, CRYPTO_ALGOFAM_SHA1, CRYPTO_ALGOFAM_SHA2_224, CRYPTO_ALGOFAM_SHA2_256, CRYPTO_ALGOFAM_SHA2_384, CRYPTO_ALGOFAM_SHA2_512, CRYPTO_ALGOFAM_SHA2_512_224, CRYPTO_ALGOFAM_SHA2_512_256, CRYPTO_ALGOFAM_SHA3_224, CRYPTO_ALGOFAM_SHA3_256, CRYPTO_ALGOFAM_SHA3_384, CRYPTO_ALGOFAM_SHA3_512, CRYPTO_ALGOFAM_SHA3_SHAKE128, CRYPTO_ALGOFAM_SHA3_SHAKE256, CRYPTO_ALGOFAM_SIPHASH}, multiplicity set at pre-compile, origin=Vector Informatik, set at pre-compile  # Determines the algorithm family used for the crypto service. This parameter defines the most significant part of the algorithm.
          string CsmMacVerifyAlgorithmFamilyCustom [0..1]: multiplicity set at pre-compile, set at pre-compile  # Name of the custom algorithm family used for the crypto service
          enumeration CsmMacVerifyAlgorithmSecondaryFamily: {CRYPTO_ALGOFAM_CUSTOM, CRYPTO_ALGOFAM_NOT_SET}, multiplicity set at pre-compile, set at pre-compile, default-value=CRYPTO_ALGOFAM_NOT_SET  # Determines the secondary algorithm family used for the crypto service
          string CsmMacVerifyAlgorithmSecondaryFamilyCustom [0..1]: multiplicity set at pre-compile, set at pre-compile  # This is the second the name of the custom algorithm, if CRYPTO_ALGOFAM_CUSTOM is set as CsmMacVerifyAlgorithmSecondaryFamily
          integer CsmMacVerifyCompareLength: 1..4294967295, multiplicity set at pre-compile, set at pre-compile  # Size of the input MAC length, that shall be verified, in BITS
          integer CsmMacVerifyDataMaxLength [0..1]: 1..4294967295, multiplicity set at pre-compile, set at pre-compile  # Max size of the input data length, for whichs MAC shall be verified, in bytes
          enumeration CsmMacVerifyProcessing: {CSM_ASYNCHRONOUS, CSM_SYNCHRONOUS}, multiplicity set at pre-compile, set at pre-compile  # Determines how the interface shall be used for that primitive. Synchronous processing returns with the result while asynchronous processing returns without processing the job. The caller will be notified by the corresponding callback.
          enumeration CsmMacVerifyAlgorithmMode: {CRYPTO_ALGOMODE_CMAC, CRYPTO_ALGOMODE_CTRDRBG, CRYPTO_ALGOMODE_CUSTOM, CRYPTO_ALGOMODE_GMAC, CRYPTO_ALGOMODE_HMAC, CRYPTO_ALGOMODE_NOT_SET, CRYPTO_ALGOMODE_SIPHASH_2_4, CRYPTO_ALGOMODE_SIPHASH_4_8}, multiplicity set at pre-compile, origin=Vector Informatik, set at pre-compile  # Determines the algorithm mode used for the crypto service.
          string CsmMacVerifyAlgorithmModeCustom [0..1]: multiplicity set at pre-compile, origin=Vector Informatik, set at pre-compile  # Name of the custom algorithm mode used for the crypto service.
      container CsmRandomGenerate [0..1]: multiplicity set at pre-compile  # Configurations of RandomGenerate primitives
        container CsmRandomGenerateConfig: multiplicity set at pre-compile  # Container for configuration of a CSM random generator. The container name serves as a symbolic name for the identifier of a random generator configuration.
          enumeration CsmRandomGenerateAlgorithmFamiliy: {CRYPTO_ALGOFAM_3DES, CRYPTO_ALGOFAM_AES, CRYPTO_ALGOFAM_BLAKE_1_256, CRYPTO_ALGOFAM_BLAKE_1_512, CRYPTO_ALGOFAM_BLAKE_2s_256, CRYPTO_ALGOFAM_BLAKE_2s_512, CRYPTO_ALGOFAM_CHACHA, CRYPTO_ALGOFAM_CUSTOM, CRYPTO_ALGOFAM_RIPEMD160, CRYPTO_ALGOFAM_RNG, CRYPTO_ALGOFAM_SHA1, CRYPTO_ALGOFAM_SHA2_224, CRYPTO_ALGOFAM_SHA2_256, CRYPTO_ALGOFAM_SHA2_384, CRYPTO_ALGOFAM_SHA2_512, CRYPTO_ALGOFAM_SHA2_512_224, CRYPTO_ALGOFAM_SHA2_512_256, CRYPTO_ALGOFAM_SHA3_224, CRYPTO_ALGOFAM_SHA3_256, CRYPTO_ALGOFAM_SHA3_384, CRYPTO_ALGOFAM_SHA3_512, CRYPTO_ALGOFAM_SHA3_SHAKE128, CRYPTO_ALGOFAM_SHA3_SHAKE256}, multiplicity set at pre-compile, set at pre-compile  # Not used. Determines the algorithm family used for the crypto service. This parameter defines the most significant part of the algorithm.
          enumeration CsmRandomGenerateAlgorithmFamily: {CRYPTO_ALGOFAM_3DES, CRYPTO_ALGOFAM_AES, CRYPTO_ALGOFAM_BLAKE_1_256, CRYPTO_ALGOFAM_BLAKE_1_512, CRYPTO_ALGOFAM_BLAKE_2s_256, CRYPTO_ALGOFAM_BLAKE_2s_512, CRYPTO_ALGOFAM_CHACHA, CRYPTO_ALGOFAM_CUSTOM, CRYPTO_ALGOFAM_RIPEMD160, CRYPTO_ALGOFAM_RNG, CRYPTO_ALGOFAM_SHA1, CRYPTO_ALGOFAM_SHA2_224, CRYPTO_ALGOFAM_SHA2_256, CRYPTO_ALGOFAM_SHA2_384, CRYPTO_ALGOFAM_SHA2_512, CRYPTO_ALGOFAM_SHA2_512_224, CRYPTO_ALGOFAM_SHA2_512_256, CRYPTO_ALGOFAM_SHA3_224, CRYPTO_ALGOFAM_SHA3_256, CRYPTO_ALGOFAM_SHA3_384, CRYPTO_ALGOFAM_SHA3_512, CRYPTO_ALGOFAM_SHA3_SHAKE128, CRYPTO_ALGOFAM_SHA3_SHAKE256}, multiplicity set at pre-compile, origin=Vector Informatik, set at pre-compile  # Determines the algorithm family used for the crypto service. This parameter defines the most significant part of the algorithm.
          string CsmRandomGenerateAlgorithmFamilyCustom [0..1]: multiplicity set at pre-compile, set at pre-compile  # Name of the custom algorithm family used for the crypto service. This is the name of the custom algorithm family, if CRYPTO_ALGOFAM_CUSTOM is used as CsmRandomAlgorithmFamily
          enumeration CsmRandomGenerateAlgorithmMode: {CRYPTO_ALGOMODE_CMAC, CRYPTO_ALGOMODE_CTRDRBG, CRYPTO_ALGOMODE_CUSTOM, CRYPTO_ALGOMODE_GMAC, CRYPTO_ALGOMODE_HMAC, CRYPTO_ALGOMODE_NOT_SET, CRYPTO_ALGOMODE_SIPHASH_2_4, CRYPTO_ALGOMODE_SIPHASH_4_8}, multiplicity set at pre-compile, set at pre-compile  # Determines the algorithm mode used for the crypto service
          string CsmRandomGenerateAlgorithmModeCustom [0..1]: multiplicity set at pre-compile, set at pre-compile  # Name of the custom algorithm mode used for the crypto service. This is the name of the custom algorithm family, if CRYPTO_ALGOFAM_CUSTOM is used as CsmRandomGenerateAlgorithmFamily.
          enumeration CsmRandomGenerateAlgorithmSecondaryFamily: {CRYPTO_ALGOFAM_CUSTOM, CRYPTO_ALGOFAM_NOT_SET}, multiplicity set at pre-compile, set at pre-compile  # Determines the algorithm family used for the crypto service
          string CsmRandomGenerateAlgorithmSecondaryFamilyCustom [0..1]: multiplicity set at pre-compile, set at pre-compile  # Name of the custom secondary algorithm family used for the crypto service. This is the second name of the custom algorithm family, if CRYPTO_ALGOFAM_CUSTOM is set as Csm RandomAlgorithmSecondaryFamily.
          enumeration CsmRandomGenerateProcessing: {CSM_ASYNCHRONOUS, CSM_SYNCHRONOUS}, multiplicity set at pre-compile, set at pre-compile  # Determines how the interface shall be used for that primitive. Synchronous processing returns with the result while asynchronous processing returns without processing the job. The caller will be notified by the corresponding callback
          integer CsmRandomGenerateResultLength: 1..4294967295, multiplicity set at pre-compile, set at pre-compile  # Size of the random generate key in bytes
      container CsmSecureCounter [0..1]: multiplicity set at pre-compile  # Configurations of SecureCounter primitives
        container CsmSecureCounterConfig: multiplicity set at pre-compile  # Container for configuration of a CSM counter. The container name serves as a symbolic name for the identifier of a secure counter configuration.
          enumeration CsmSecureCounterProcessing: {CSM_ASYNCHRONOUS, CSM_SYNCHRONOUS}, multiplicity set at pre-compile, origin=Vector Informatik, set at pre-compile, default-value=CSM_SYNCHRONOUS  # Determines how the interface shall be used for that primitive. Synchronous processing returns with the result while asynchronous processing returns without processing the job. The caller will be notified by the corresponding callback
          reference CsmSecureCounterQueueRef [0..1]: multiplicity set at pre-compile, set at pre-compile, destination=CsmQueue  # Not used. Queue is referred in Job. This parameter refers to the queue used for that secure counter.
      container CsmSignatureGenerate [0..1]: multiplicity set at pre-compile  # Configurations of SignatureGenerate primitives
        container CsmSignatureGenerateConfig: multiplicity set at pre-compile  # Container for configuration of a CSM signature generation interface. The container name serves as a symbolic name for the identifier of signature generation interface.
          enumeration CsmSignatureGenerateAlgorithmFamiliy: {CRYPTO_ALGOFAM_BRAINPOOL, CRYPTO_ALGOFAM_CUSTOM, CRYPTO_ALGOFAM_ECCNIST, CRYPTO_ALGOFAM_ED25519, CRYPTO_ALGOFAM_RSA}, multiplicity set at pre-compile, set at pre-compile  # Not used. Determines the algorithm family used for the crypto service. This parameter defines the most significant part of the algorithm.
          enumeration CsmSignatureGenerateAlgorithmFamily: {CRYPTO_ALGOFAM_BRAINPOOL, CRYPTO_ALGOFAM_CUSTOM, CRYPTO_ALGOFAM_ECCNIST, CRYPTO_ALGOFAM_ED25519, CRYPTO_ALGOFAM_RSA}, multiplicity set at pre-compile, origin=Vector Informatik, set at pre-compile  # Determines the algorithm family used for the crypto service. This parameter defines the most significant part of the algorithm.
          string CsmSignatureGenerateAlgorithmFamilyCustom [0..1]: multiplicity set at pre-compile, set at pre-compile  # Name of the custom algorithm family used for the crypto service. | This is the name of the custom algorithm family, if CRYPTO_ALGOFAM_CUSTOM is used as CsmSignatureGenerateAlgorithmFamily.
          enumeration CsmSignatureGenerateAlgorithmMode: {CRYPTO_ALGOMODE_CUSTOM, CRYPTO_ALGOMODE_NOT_SET, CRYPTO_ALGOMODE_RSASSA_PKCS1_v1_5, CRYPTO_ALGOMODE_RSASSA_PSS}, multiplicity set at pre-compile, set at pre-compile  # Determines the algorithm mode used for the crypto service
          string CsmSignatureGenerateAlgorithmModeCustom [0..1]: multiplicity set at pre-compile, set at pre-compile  # Name of the custom algorithm mode used for the crypto service
          enumeration CsmSignatureGenerateAlgorithmSecondaryFamily: {CRYPTO_ALGOFAM_BLAKE, CRYPTO_ALGOFAM_CUSTOM, CRYPTO_ALGOFAM_NOT_SET, CRYPTO_ALGOFAM_RIPEMD160, CRYPTO_ALGOFAM_SHA1, CRYPTO_ALGOFAM_SHA2_224, CRYPTO_ALGOFAM_SHA2_256, CRYPTO_ALGOFAM_SHA2_384, CRYPTO_ALGOFAM_SHA2_512, CRYPTO_ALGOFAM_SHA2_512_224, CRYPTO_ALGOFAM_SHA2_512_256, CRYPTO_ALGOFAM_SHA3_224, CRYPTO_ALGOFAM_SHA3_256, CRYPTO_ALGOFAM_SHA3_384, CRYPTO_ALGOFAM_SHA3_512, CRYPTO_ALGOFAM_SHA3_SHAKE128, CRYPTO_ALGOFAM_SHA3_SHAKE256}, multiplicity set at pre-compile, set at pre-compile, default-value=CRYPTO_ALGOFAM_NOT_SET  # Determines the algorithm mode used for the crypto service
          string CsmSignatureGenerateAlgorithmSecondaryFamilyCustom [0..1]: multiplicity set at pre-compile, set at pre-compile  # Name of the custom secondary algorithm family used for the crypto service. This is the second name of the custom algorithm family, if CRYPTO_ALGOFAM_CUSTOM is set as CsmSignatureGenerateAlgorithmSecondaryFamily.
          integer CsmSignatureGenerateDataMaxLength [0..1]: 1..4294967295, multiplicity set at pre-compile, set at pre-compile  # Size of the input data length in bytes
          integer CsmSignatureGenerateKeyLength: 1..4294967295, multiplicity set at pre-compile, set at pre-compile, default-value=32  # Size of the signature generate key in bytes. Not used.
          enumeration CsmSignatureGenerateProcessing: {CSM_ASYNCHRONOUS, CSM_SYNCHRONOUS}, multiplicity set at pre-compile, set at pre-compile  # Determines how the interface shall be used for that primitive. Synchronous processing returns with the result while asynchronous processing returns without processing the job. The caller will be notified by the corresponding callback
          integer CsmSignatureGenerateResultLength: 1..4294967295, multiplicity set at pre-compile, set at pre-compile  # Size of the output signature length in bytes
      container CsmSignatureVerify [0..1]: multiplicity set at pre-compile  # Configurations of SignatureVerify primitives
        container CsmSignatureVerifyConfig: multiplicity set at pre-compile  # Container for configuration of a CSM signature verification interface. The container name serves as a symbolic name for the identifier of signature verification interface.
          enumeration CsmSignatureVerifyAlgorithmFamiliy: {CRYPTO_ALGOFAM_BRAINPOOL, CRYPTO_ALGOFAM_CUSTOM, CRYPTO_ALGOFAM_ECCNIST, CRYPTO_ALGOFAM_ED25519, CRYPTO_ALGOFAM_RSA}, multiplicity set at pre-compile, set at pre-compile  # Not used. Determines the algorithm family used for the crypto service. This parameter defines the most significant part of the algorithm.
          enumeration CsmSignatureVerifyAlgorithmFamily: {CRYPTO_ALGOFAM_BRAINPOOL, CRYPTO_ALGOFAM_CUSTOM, CRYPTO_ALGOFAM_ECCNIST, CRYPTO_ALGOFAM_ED25519, CRYPTO_ALGOFAM_RSA}, multiplicity set at pre-compile, origin=Vector Informatik, set at pre-compile  # Determines the algorithm family used for the crypto service. This parameter defines the most significant part of the algorithm.
          string CsmSignatureVerifyAlgorithmFamilyCustom [0..1]: multiplicity set at pre-compile, set at pre-compile  # Name of the custom algorithm family used for the crypto service. This is the name of the custom algorithm family, if CRYPTO_ALGOFAM_CUSTOM is used as CsmSignatureVerifyAlgorithmFamily.
          enumeration CsmSignatureVerifyAlgorithmMode: {CRYPTO_ALGOMODE_CUSTOM, CRYPTO_ALGOMODE_NOT_SET, CRYPTO_ALGOMODE_RSASSA_PKCS1_v1_5, CRYPTO_ALGOMODE_RSASSA_PSS}, multiplicity set at pre-compile, set at pre-compile  # Determines the algorithm mode used for the crypto service
          string CsmSignatureVerifyAlgorithmModeCustom [0..1]: multiplicity set at pre-compile, set at pre-compile  # Name of the custom algorithm mode used for the crypto service
          enumeration CsmSignatureVerifyAlgorithmSecondaryFamily: {CRYPTO_ALGOFAM_BLAKE, CRYPTO_ALGOFAM_CUSTOM, CRYPTO_ALGOFAM_NOT_SET, CRYPTO_ALGOFAM_RIPEMD160, CRYPTO_ALGOFAM_SHA1, CRYPTO_ALGOFAM_SHA2_224, CRYPTO_ALGOFAM_SHA2_256, CRYPTO_ALGOFAM_SHA2_384, CRYPTO_ALGOFAM_SHA2_512, CRYPTO_ALGOFAM_SHA2_512_224, CRYPTO_ALGOFAM_SHA2_512_256, CRYPTO_ALGOFAM_SHA3_224, CRYPTO_ALGOFAM_SHA3_256, CRYPTO_ALGOFAM_SHA3_384, CRYPTO_ALGOFAM_SHA3_512, CRYPTO_ALGOFAM_SHA3_SHAKE128, CRYPTO_ALGOFAM_SHA3_SHAKE256}, multiplicity set at pre-compile, set at pre-compile  # Determines the algorithm family used for the crypto service. This parameter defines the most significant part of the algorithm.
          string CsmSignatureVerifyAlgorithmSecondaryFamilyCustom [0..1]: multiplicity set at pre-compile, set at pre-compile  # Name of the custom secondary algorithm family used for the crypto service. This is the name of the custom algorithm family, if CRYPTO_ALGOFAM_CUSTOM is used as CsmSignatureVerifyAlgorithmFamily.
          integer CsmSignatureVerifyCompareLength: 1..4294967295, multiplicity set at pre-compile, set at pre-compile  # Size of the input data length, for whichs signature shall be verified, in bytes
          integer CsmSignatureVerifyDataMaxLength [0..1]: 1..4294967295, multiplicity set at pre-compile, set at pre-compile  # Size of the input data length, for whichs signature shall be verified, in bytes
          enumeration CsmSignatureVerifyProcessing: {CSM_ASYNCHRONOUS, CSM_SYNCHRONOUS}, multiplicity set at pre-compile, set at pre-compile  # Determines how the interface shall be used for that primitive. Synchronous processing returns with the result while asynchronous processing returns without processing the job. The caller will be notified by the corresponding callback.
    container CsmQueues [0..1]: multiplicity set at pre-compile  # Container for CSM queue configurations
      container CsmQueue [1..*]: multiplicity set at pre-compile  # Container for configuration of a CSM queue. The container name serves as a symbolic name for the identifier of a queue configuration. | A queue has two tasks: 1. queue jobs which cannot be processed since the underlying hardware is busy and 2. refer to channel which shall be used
        integer CsmQueueSize: 1..4294967295, multiplicity set at pre-compile, set at pre-compile  # Size of the CsmQueue. If jobs cannot be processed by the underlying hardware since the hardware is busy, the jobs stay in the prioritized queue. If the queue is full, the next job will be rejected.
        symbolic name reference CsmChannelRef: multiplicity set at pre-compile, set at pre-compile, destination=CryIfChannel  # Refers to the underlying Crypto Interface channel. Violation: Ref Target points currently to CryIf/CryIfKeys/CryIfKey instead of CryIf/CryIfChannel as defined in ASR 4.3
  bsw implementation Csm_Impl: programming-language=C, sw-version=2.03.00, used-code-generator=DaVinci Configurator, vendor-id=30, ar-release-version=4.03.00, behavior=Behavior, preconfigured-configuration=Csm_Pre, recommended-configuration=Csm_Rec, vendor-specific-module-def=Csm
  module config Csm_Pre: definition=Csm
  module config Csm_Rec: definition=Csm
