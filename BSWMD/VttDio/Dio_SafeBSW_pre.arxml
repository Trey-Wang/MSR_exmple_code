AUTOSAR XML (schema 4-0-3)
package /MICROSAR
  module config Dio_Rec: definition=Dio
    DioGeneral: DioSafeBswChecks=1
