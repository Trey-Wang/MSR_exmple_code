AUTOSAR XML (schema 4-0-3)
package /MICROSAR
  module config ComM_Pre: definition=ComM
  module config ComM_Rec: definition=ComM
    ComMGeneral: ComMDevErrorDetect=1, ComMVersionInfoApi=0
