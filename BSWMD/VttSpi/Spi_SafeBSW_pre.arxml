AUTOSAR XML (schema 4-0-3)
package /MICROSAR
  module config Spi_Rec: definition=Spi
    SpiGeneral: SpiSafeBswChecks=1
