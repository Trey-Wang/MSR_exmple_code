AUTOSAR XML (schema 4-0-3)
package /MICROSAR/Fr_CanoeemuEray
  bsw implementation Fr_Impl: programming-language=C, sw-version=5.00.01, used-code-generator=DaVinci Configurator, vendor-id=30, ar-release-version=4.00.03, behavior=Fr_CanoeemuErayBehavior, preconfigured-configuration=Fr_Pre, recommended-configuration=Fr_Rec, vendor-specific-module-def=Fr
  module definition Fr [0..*]: category=VENDOR_SPECIFIC_MODULE_DEFINITION, refined-module-def=Fr, variants pre-compile/link-time/post-build-loadable/post-build-selectable  # Configuration of the Fr (FlexRay driver) module.
    container FrGeneral  # General configuration parameters of the FlexRay Driver module.
      boolean FrAbsoluteTimerDisable: set at pre-compile, origin=Vector Informatik, default-value=false  # This parameter defines if the following absolute timer functions are available: Fr_AckAbsoluteTimerIRQ() Fr_DisableAbsoluteTimerIRQ() Fr_GetAbsoluteTimerIRQStatus() Pre-compile time switch FR_ABSOLUTE_TIMER_DISABLE is derived from this configuration parameter.
      boolean FrRuntimeMeasurementSupport: set at pre-compile, origin=Vector Informatik, default-value=false  # Enables/disables the usage of the Predefined Runtime Measurement Points Feature
      boolean FrBufferReconfig: set at pre-compile, default-value=false  # This parameter defines if the buffer reconfiguration at runtime is enabled.
      integer FrCtrlTestCount: 0..255, set at pre-compile, default-value=1  # This value specifies the maxmimum number of iterations the FlexRay controller hardware test is performed during controller initialization.
      boolean FrCycleStartInterrupt: set at pre-compile, origin=Vector Informatik, default-value=true  # This parameter defines if the callout function ApplFr_ISR_CycleStart() is called. The function is called if a cycle start interrupt occurs.
      boolean FrDevErrorDetect: set at pre-compile, default-value=true  # This parameter switches the Development Error Detection and Notification ON of OFF. Note: In general,the development error detection is recommended during pre-test phase. It is not recommended to enable the development error detection in production code due to increased runtime and ROM needs. true: Development Error Detection and Notification enabled. false: Development Error Detection and Notification disabled.
      boolean FrEnableMsgIdFiltering: set at pre-compile, origin=Vector Informatik, default-value=false  # This parameter defines if the Fr will configure the message ID filters. These filters are used to reduce CPU load by receiving only FrTp-frames in the dynamic segment that are dedicated to the FrTp instance.
      boolean FrFIFOSupport: set at pre-compile, origin=Vector Informatik, default-value=false  # This parameter defines if the support of the FIFO is enabled. It mandates the ability to admit messages into the FIFO based on Message Id filtering criteria.
      boolean FrHardwareCancellationEnable: set at pre-compile, origin=Vector Informatik, default-value=false  # This parameter defines if waiting in loops can be canceled by counter. Under some conditions, the Flexray driver has to wait for hardware dependent events. Waiting is done in a so-called 'Hardware Loop'. To secure that this loop will not called infinite, only a given amount of loops will be performed and then the loop is broken. Activating this feature you have to define the Timeout Duration as the loop count where the loop will be broken and the code continues after a DEM notification.
      integer FrIndex: 0..255, set at pre-compile, default-value=0  # This value specifies the InstanceId of this module instance. If only one instance is present it shall have the Id 0.
      integer FrNumCtrlSupported: 1..2, set at pre-compile, default-value=1  # This value specifies the maximum number of communication controllers that the driver supports.
      boolean FrRxStringentCheck: set at pre-compile, default-value=false  # This parameter defines if stringent check is enabled (true), received frames are only accepted if no slot status error occured.
      boolean FrRxStringentLengthCheck: set at pre-compile, default-value=false  # This parameter defines if stringent check is enabled (true), received frames are only accepted the received payload length matches the configured payload length.
      boolean FrSingleChannelAPI: set at pre-compile, origin=Vector Informatik, default-value=false  # This parameter defines if the single controller API optimization is enabled. Pre-compile time switch FR_CTRL_ENABLE_API_OPTIMIZATION is derived from this configuration parameter.
      integer FrTimeoutDurationFactor: 0..65635, set at pre-compile, origin=Vector Informatik, default-value=0  # This value specifies the number of loops that are executed to wait for an hardware event. This value is used for all hardware loop checks.
      boolean FrTimer0Interrupt: set at pre-compile, origin=Vector Informatik, default-value=true  # Enables/disables the existence of the callout function ApplFr_ISR_Timer0() Pre-compile time switch FR_CFG_APPL_CALLBACK_TIMER0 is derived from this configuration parameter. The function is called if a timer 0 interrupt occurs.
      enumeration FrTypeOfInterruptFunction: set at pre-compile in variant pre-compile+post-build-selectable / link in variant link-time / post-build in variant post-build-loadable, origin=Vector Informatik, default-value=Category2  # This parameter specifies the type of Interrupt Function. Category 2: Interrupt Function is defined with ISR() define. void Func(void): Interrupt Function is defined as void Func(void) function.
        Category2  # Category 2
        voidFuncVoid  # void Func(void)
      boolean FrUseAsmFunctionOptimization: set at pre-compile, origin=Vector Informatik, default-value=false  # This parameter defines if the usage of some optimized assembler functions is enabled. This attribute is only available for some special HW platforms with optimized assembler functions.
      string FrUserConfigFile [0..1]: set at pre-compile, origin=Vector Informatik  # Reference to an external text file that will be included during generation to <module>_Cfg.h. The content of the user configuration file will be added at the end of the generated module configuration file and allows altering or extending the generated code. Caution: User configuration files can cause the software module to malfunction and must only be used with great care!
      boolean FrVersionInfoApi: set at pre-compile, default-value=false  # This parameter enables/disables the function Fr_GetVersionInfo() to get major, minor and patch version information.
      boolean FrSafeBswChecks: set at pre-compile, origin=Vector Informatik, default-value=false  # Selects if safety checks are used. These checks improve robustness as e.g. invalid parameters are checked before function is executed. This attribute has to be enabled for safety projects where this component is mapped to an ASIL partition.
      boolean FrDirectBufferAccessEnable: set at pre-compile, origin=Vector Informatik, default-value=false  # Enables the Direct Buffer Access API. This feature reduce the runtime duration of the JobList excecution because the message buffer data is access directly by FlexRay interface.
    container FrMultipleConfiguration  # The container includes the configuration of the individual controllers.
      container FrController [1..*]: post-build-changeable=true  # This container includes the configuration of the individual controller.
        integer FrCtrlIdx: 0..255, set at pre-compile in variant link-time+post-build-selectable+pre-compile / post-build in variant post-build-loadable, symbolic-name-value=true, default-value=0  # This value specifies the index of Communication Controller (CC) within the FR module.
        boolean FrPAllowHaltDueToClock: set at pre-compile in variant link-time+pre-compile / post-build in variant post-build-loadable+post-build-selectable, default-value=true  # This parameter defines the transition to the POC:halt state due to clock synchronization errors. If set to true, the CC is allowed to transition to POC:halt. If set to false, the CC will not transition to the POC:halt state but will enter or remain in the POC:normal passive state (self healing would still be possible)
        integer FrPAllowPassiveToActive: 0..31, set at pre-compile in variant link-time+pre-compile / post-build in variant post-build-loadable+post-build-selectable, default-value=0  # This value specifies the number of consecutive even/odd cycle pairs that must have valid clock correction terms before the CC will be allowed to transition from the POC:normal passive state to POC:normal active state. If set to zero, the CC is not allowed to transition from POC:normal passive to POC:normal active
        enumeration FrPChannels: {FR_CHANNEL_A, FR_CHANNEL_AB, FR_CHANNEL_B}, set at pre-compile in variant link-time+pre-compile / post-build in variant post-build-loadable+post-build-selectable, default-value=FR_CHANNEL_AB  # This parameter defines the channels to which the node is connected. Implementation Type: Fr_ChannelType
        integer FrPClusterDriftDamping: 0..20, set at pre-compile in variant link-time+pre-compile / post-build in variant post-build-loadable+post-build-selectable, default-value=2  # This value specifies the local cluster drift damping factor used for rate correction. Remark: Upper limit 10 for FlexRay Protocol 3.0 compliance.
        integer FrPDecodingCorrection: 12..143, set at pre-compile in variant link-time+pre-compile / post-build in variant post-build-loadable+post-build-selectable, default-value=72  # This value is used by the receiver to calculate the difference between primary time reference point and secondary time reference point. Remark: Lower limit 14 for FlexRay Protocol 2.1 Rev. A compliance. Upper limit 136 for FlexRay Protocol 3.0 compliance.
        integer FrPDelayCompensationA: 0..211, set at pre-compile in variant link-time+pre-compile / post-build in variant post-build-loadable+post-build-selectable, default-value=1  # This value is used to compensate for reception delays on the indicated channel. This covers assumed propagation delay up to cPropagationDelayMax for microticks in the range of 0.0125us to 0.05us. Remark: Lower limit 4 for FlexRay Protocol 3.0 compliance. Upper limit 200 for FlexRay Protocol 2.1 Rev A compliance.
        integer FrPDelayCompensationB: 0..211, set at pre-compile in variant link-time+pre-compile / post-build in variant post-build-loadable+post-build-selectable, default-value=1  # This value is used to compensate for reception delays on the indicated channel. This covers assumed propagation delay up to cPropagationDelayMax for microticks in the range of 0.0125us to 0.05us. Remark: Lower limit 4 for FlexRay Protocol 3.0 compliance. Upper limit 200 for FlexRay Protocol 2.1 Rev A compliance.
        boolean FrPExternalSync: set at pre-compile in variant link-time+pre-compile / post-build in variant post-build-loadable+post-build-selectable, default-value=false  # This parameter defines whether the node is externally synchronized (operating as time gateway sink in an TT-E cluster) or locally synchronized. If FrPExternalSync is set to 'true' then FrPTwoKeySlotMode must also be set to 'true'. Remarks: Set to 'false' for FlexRay Protocol 2.1 Rev. A compliance.
        boolean FrPFallBackInternal: set at pre-compile in variant link-time+pre-compile / post-build in variant post-build-loadable+post-build-selectable, default-value=false  # This parameter defines whether a time gateway sink node will switch to local clock operation when synchronization with the time gateway source node is lost (FrPFallBackInternal = true) or will instead go to POC:ready (FrPFallBackInternal = false). Remarks: Set to 'false' for FlexRay Protocol 2.1 Rev. A compliance.
        integer FrPKeySlotId: 0..1023, set at pre-compile in variant link-time+pre-compile / post-build in variant post-build-loadable+post-build-selectable, default-value=0  # This value specfies the ID of the key slot, i.e. the slot used to transmit the startup frame, sync frame, or designated key slot frame. If this parameter is set to zero the node does not have a key slot.
        boolean FrPKeySlotOnlyEnabled: set at pre-compile in variant link-time+pre-compile / post-build in variant post-build-loadable+post-build-selectable, default-value=false  # This parameter defines whether or not the node shall enter key slot only mode following startup. Remarks: This parameter maps to FlexRay Protocol 2.1 Rev. A parameter pSingleSlotEnabled.
        boolean FrPKeySlotUsedForStartup: set at pre-compile in variant link-time+pre-compile / post-build in variant post-build-loadable+post-build-selectable, default-value=false  # This parameter defines whether the key slot is used to transmit a startup frame. If FrPKeySlotUsedForStartup is set to true then FrPKeySlotUsedForSync must also be set to true. If FrPTwoKeySlotMode is set to true then both FrPKeySlotUsedForSync and FrPKeySlotUsedForStartup must also be set to true.
        boolean FrPKeySlotUsedForSync: set at pre-compile in variant link-time+pre-compile / post-build in variant post-build-loadable+post-build-selectable, default-value=false  # This parameter defines whether the key slot is used to transmit a sync frame. If FrPKeySlotUsedForStartup is set to true then FrPKeySlotUsedForSync must also be set to true. If FrPTwoKeySlotMode is set to true then both FrPKeySlotUsedForSync and FrPKeySlotUsedForStartup must also be set to true.
        integer FrPLatestTx: 0..7988, set at pre-compile in variant link-time+pre-compile / post-build in variant post-build-loadable+post-build-selectable, default-value=232  # This value defines the last minislot in which a frame transmission can start in the dynamic segment. Remark: Upper limit 7980 for FlexRay Protocol 2.1 Rev A compliance.
        integer FrPMacroInitialOffsetA: 2..68, set at pre-compile in variant link-time+pre-compile / post-build in variant post-build-loadable+post-build-selectable, default-value=5  # This value specifies the number of macroticks between the static slot boundary and the following macrotick boundary of the secondary time reference point based on the nominal macrotick duration.
        integer FrPMacroInitialOffsetB: 2..68, set at pre-compile in variant link-time+pre-compile / post-build in variant post-build-loadable+post-build-selectable, default-value=5  # This value specifies the number of macroticks between the static slot boundary and the following macrotick boundary of the secondary time reference point based on the nominal macrotick duration.
        integer FrPMicroInitialOffsetA: 0..239, set at pre-compile in variant link-time+pre-compile / post-build in variant post-build-loadable+post-build-selectable, default-value=7  # This value specifies the number of microticks between the secondary time reference point and the macrotick boundary immediately following the secondary time reference point. The parameter depends on FrPDelayCompensationA and therefore it has to be set independently for each channel [Microticks].
        integer FrPMicroInitialOffsetB: 0..239, set at pre-compile in variant link-time+pre-compile / post-build in variant post-build-loadable+post-build-selectable, default-value=7  # This value specifies the number of microticks between the secondary time reference point and the macrotick boundary immediately following the secondary time reference point. The parameter depends on FrPDelayCompensationB and therefore it has to be set independently for each channel [Microticks].
        integer FrPMicroPerCycle: 640..1280000, set at pre-compile in variant link-time+pre-compile / post-build in variant post-build-loadable+post-build-selectable, default-value=200000  # This value specifies the nominal number of microticks in the communication cycle of the local node. If nodes have different microtick durations this number will differ from node to node. Remark: Lower limit 960 for FlexRay Protocol 3.0 compliance. Upper limit 640000 for FlexRay Protocol 2.1 Rev A compliance.
        boolean FrPNmVectorEarlyUpdate: set at pre-compile in variant link-time+pre-compile / post-build in variant post-build-loadable+post-build-selectable, default-value=false  # This parameter defines when the update of the Network Management Vector in the CHI shall take place. If FrPNmVectorEarlyUpdate is set to false, the update shall take place after the NIT. If FrPNmVectorEarlyUpdate is set to true, the update shall take place after the end of the static segment. Remarks: Set to 'false' for FlexRay Protocol 2.1 Rev. A compliance.
        integer FrPOffsetCorrectionOut: 13..16082, set at pre-compile in variant link-time+pre-compile / post-build in variant post-build-loadable+post-build-selectable, default-value=150  # This value specifies the magnitude of the maximum permissible offset correction value. Remark: Upper limit 15567 for FlexRay Protocol 2.1 Rev A compliance. Remark: Lower limit 15 for FlexRay Protocol 3.0 compliance.
        integer FrPOffsetCorrectionStart: 7..15999, set at pre-compile in variant link-time+pre-compile / post-build in variant post-build-loadable+post-build-selectable, default-value=4956  # This value specifies the start of the offset correction phase within the NIT, expressed as the number of macroticks from the start of cycle. Remark: This parameter maps to FlexRay Protocol 2.1 Rev. A parameter gOffsetCorrectionStart. Lower limit 9 for FlexRay Protocol 2.1 Rev A compliance.
        integer FrPPayloadLengthDynMax: 0..127, set at pre-compile in variant link-time+pre-compile / post-build in variant post-build-loadable+post-build-selectable, default-value=127  # This value specifies the maximum payload length for dynamic frames.
        integer FrPRateCorrectionOut: 2..3846, set at pre-compile in variant link-time+pre-compile / post-build in variant post-build-loadable+post-build-selectable, default-value=601  # This value specifies the magnitude of the maximum permissible rate correction value and the maximum drift offset between two nodes operating with unsynchronized clocks for one communication cycle. Remarks: This parameter maps to FlexRay Protocol 2.1 Rev. A parameter pdMaxDrift. Lower limit 3 for FlexRay Protocol 3.0 compliance. Upper limit 1923 for FlexRay Protocol 2.1 Rev A compliance.
        enumeration FrPSamplesPerMicrotick: {N1SAMPLES, N2SAMPLES, N4SAMPLES}, set at pre-compile in variant link-time+pre-compile / post-build in variant post-build-loadable+post-build-selectable, default-value=N2SAMPLES  # This value specifies the number of samples per microtick. Remark: Allowed range N1SAMPLES, N2SAMPLES for FlexRay Protocol 3.0 compliance.
        integer FrPSecondKeySlotId: 0..1023, set at pre-compile in variant link-time+pre-compile / post-build in variant post-build-loadable+post-build-selectable, default-value=0  # This value specifies the ID of the second key slot, in which a second startup frame shall be sent when operating as a coldstart node in a TT-L or TT-D cluster. If this parameter is set to zero the node does not have a second key slot. Remark: Set to 0 for FlexRay Protocol 2.1 Rev A compliance.
        boolean FrPTwoKeySlotMode: set at pre-compile in variant link-time+pre-compile / post-build in variant post-build-loadable+post-build-selectable, default-value=false  # This parameter defines whether node operates as a coldstart node in a TT-E or TT-L cluster. If pTwoKeySlotMode is set to true then both pKeySlotUsedForSync and pKeySlotUsedForStartup must also be set to true. If pExternalSync is set to true then pTwoKeySlotMode must also be set to true. Remark: Set to false for FlexRay Protocol 2.1 Rev A compliance.
        enumeration FrPWakeupChannel: {FR_CHANNEL_A, FR_CHANNEL_B}, set at pre-compile in variant link-time+pre-compile / post-build in variant post-build-loadable+post-build-selectable, default-value=FR_CHANNEL_A  # This parameter defines which channel used by the node to send a wakeup pattern. FrPWakeupChannel must be selected from among the channels configured by FrPChannels.
        integer FrPWakeupPattern: 0..63, set at pre-compile in variant link-time+pre-compile / post-build in variant post-build-loadable+post-build-selectable, default-value=63  # This value specifies the number of repetitions of the wakeup symbol that are combined to form a wakeup pattern when the node enters the POC:wakeup send state. Remark: Lower limit 2 for FlexRay Protocol 2.1 Rev A compliance.
        integer FrPdAcceptedStartupRange: 0..2743, set at pre-compile in variant link-time+pre-compile / post-build in variant post-build-loadable+post-build-selectable, default-value=242  # This value specifies the expanded range of measured clock deviation allowed for startup frames during integration. Remark: Upper limit 1875 for FlexRay Protocol 2.1 Rev A compliance. Lower limit 29 for FlexRay Protocol 3.0 compliance.
        integer FrPdListenTimeout: 1284..2567692, set at pre-compile in variant link-time+pre-compile / post-build in variant post-build-loadable+post-build-selectable, default-value=401202  # This value specifies the timeout for the startup listen and wakeup listen. Although this is a node local parameter, the real time equivalent of this value should be the same for all nodes in the cluster. Remark: Lower limit 1926 for FlexRay Protocol 3.0 compliance. Upper limit 1283846 for FlexRay Protocol 2.1 Rev. A compliance.
        enumeration FrPdMicrotick: {T100NS, T12_5NS, T25NS, T50NS}, set at pre-compile in variant link-time+pre-compile / post-build in variant post-build-loadable+post-build-selectable, default-value=T25NS  # This parameter defines the duration of a microtick. Remark: Allowed range T12_5NS, T25NS, T50NS for FlexRay Protocol 3.0 compliance.
        enumeration FrStrobePointPosition: {SAMPLE_4, SAMPLE_5, SAMPLE_6}, set at link in variant link-time / post-build in variant post-build-loadable+post-build-selectable / pre-compile in variant pre-compile, origin=Vector Informatik, default-value=SAMPLE_5  # Not used. Defines the sample count value for strobing. The strobed bit value is set to the voted value when the sample count is incremented to the value configured by Strobe Point Position.
        enumeration FrStatusIRQLine: {LINE_0, LINE_1}, set at link in variant link-time+post-build-loadable+post-build-selectable / pre-compile in variant pre-compile, origin=Vector Informatik, default-value=LINE_0  # This parameter defines the interrupt line all status interrupts provided by the register SIR (e.g. Cyclestart-Interrupt, Tx-Interrupt, ...) are assigned to.
        enumeration FrErrorIRQLine: {LINE_0, LINE_1}, set at link in variant link-time+post-build-loadable+post-build-selectable / pre-compile in variant pre-compile, origin=Vector Informatik, default-value=LINE_1  # This parameter defines the interrupt line all error interrupts provided by the register EIR are assigned to.
        string FrCANoeClusterName: set at pre-compile, origin=Vector Informatik, default-value=FlexRay  # This parameter define the name of the network cluster within CANoe simulation of the FR bus. Adapt the value to the configured name within a CANoe FlexRay simulation. The maximum character count is 128.
        container FrAbsoluteTimer [1..*]  # This container includes the absolute timer configuration parameters of the Fr.
          integer FrAbsTimerIdx: 0..254, set at pre-compile, symbolic-name-value=true, default-value=0  # This value specifies the index of an absolute timer contained in Fr on a certain FlexRay CC.
        container FrControllerDemEventParameterRefs [0..1]  # This container includes the references to DemEventParameter elements which shall be invoked using the API Dem_ReportErrorStatus API in case the corresponding error occurs. The EventId is taken from the referenced DemEventParameter's DemEventId value.
          symbolic name reference FrDemCtrlTestResultRef [0..1]: set at post-build in variant post-build-loadable / pre-compile in variant pre-compile+link-time+post-build-selectable, destination=DemEventParameter  # Reference to DEM event Id that is reported for FlexRay | controller hardware test failure. If this parameter is not configured, no event reporting happens.
        container FrFifo [0..*]: post-build-changeable=true  # This container includes one First In First Out (FIFO) queued receive structure, defining the admittance criteria to the FIFO, and mandating the ability to admit messages into the FIFO based on Message Id filtering criteria.
          boolean FrAdmitWithoutMessageId [0..1]: set at post-build in variant post-build-loadable / pre-compile in variant pre-compile+link-time+post-build-selectable  # This parameter defines whether or not frames received in the dynamic segment that don't contain a message ID will be admitted into the FIFO.
          integer FrBaseCycle [0..1]: 0..63, set at post-build in variant post-build-loadable / pre-compile in variant pre-compile+link-time+post-build-selectable  # This value specifies the FIFO cycle counter acceptance criteria.
          enumeration FrChannels: {FR_CHANNEL_A, FR_CHANNEL_AB, FR_CHANNEL_B}, set at pre-compile in variant link-time+pre-compile / post-build in variant post-build-loadable+post-build-selectable, default-value=FR_CHANNEL_A  # This parameter defines the FIFO channel admittance criteria.
          integer FrCycleRepetition [0..1]: 1..64, set at post-build in variant post-build-loadable / pre-compile in variant pre-compile+link-time+post-build-selectable  # This value specfies the FIFO counter acceptance criteria. Valid values are 1,2,4,5,8,10,16,20,32,40,50,64. Remark: Values 1,2,4,8,16,32,64 are valid only for FlexRay Protocol 2.1 Rev A compliance.
          integer FrFifoDepth [0..1]: 1..2048, set at post-build in variant post-build-loadable / pre-compile in variant pre-compile+link-time+post-build-selectable  # This value specifies FIFO depth.
          integer FrMsgIdMask [0..1]: 0..65535, set at post-build in variant post-build-loadable / pre-compile in variant pre-compile+link-time+post-build-selectable  # This value specifies the FIFO message identifier acceptance criteria (Mask filter).
          integer FrMsgIdMatch [0..1]: 0..65535, set at post-build in variant post-build-loadable / pre-compile in variant pre-compile+link-time+post-build-selectable  # This value specifies the FIFO message identifier acceptance criteria (Match filter).
          container FrRange [1..*]: post-build-changeable=true  # This container includes the FIFO Frame Id range acceptance criteria.
            integer FrRangeMax: 0..2047, set at pre-compile in variant link-time+pre-compile / post-build in variant post-build-loadable+post-build-selectable, default-value=0  # This value specifies the last FrameId of this range that will be accepted by the FIFO.
            integer FrRangeMin: 0..2047, set at pre-compile in variant link-time+pre-compile / post-build in variant post-build-loadable+post-build-selectable, default-value=0  # This value specifies the first FrameId of this range that will be accepted by the FIFO.
  module config Fr_Pre: definition=Fr
  module config Fr_Rec: definition=Fr
