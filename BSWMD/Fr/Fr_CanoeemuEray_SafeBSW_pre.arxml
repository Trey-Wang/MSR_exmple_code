AUTOSAR XML (schema 4-0-3)
package /MICROSAR/Fr_CanoeemuEray
  module config Fr_Rec: definition=Fr
    FrGeneral: FrSafeBswChecks=1
