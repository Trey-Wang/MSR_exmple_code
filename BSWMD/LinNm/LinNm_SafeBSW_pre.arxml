AUTOSAR XML (schema 4-0-3)
package /MICROSAR
  module config LinNm_Rec: definition=LinNm
    LinNmGlobalConfig: LinNmSafeBswChecks=1
