AUTOSAR XML (schema 4-0-3)
package /MICROSAR
  module config LinNm_Pre: definition=LinNm
