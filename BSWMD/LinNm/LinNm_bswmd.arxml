AUTOSAR XML (schema 4-0-3)
package /MICROSAR
  module definition LinNm [0..1]: category=VENDOR_SPECIFIC_MODULE_DEFINITION, refined-module-def=LinNm, variants link-time/pre-compile/post-build-loadable  # Configuration of the LIN Network Management (LinNm) module.
    container LinNmGlobalConfig  # Global configuration parameters of the LINNM.
      boolean LinNmBusSynchronizationEnabled: set at pre-compile, default-value=false  # This parameter defines whether the bus synchronization support of the LinNm is enabled or disabled. This feature is required for NM Coordinator nodes only.
      boolean LinNmComControlEnabled: set at pre-compile, default-value=false  # This parameter defines whether the Communication Control support is enabled or disabled.
      boolean LinNmComUserDataSupport: set at pre-compile, default-value=false  # This parameter defines whether the NM COM user data support is enabled or disabled.
      boolean LinNmCoordinatorSyncSupport: set at pre-compile, default-value=false  # This parameter defines whether the coordinator synchronization support is enabled or disabled.
      boolean LinNmDevErrorDetect: set at pre-compile, default-value=true  # This parameter switches the Development Error Detection and Notification ON or OFF. true: Development error detection is enabled. false: Development error detection is disabled. Note: In general, the development error detection is recommended during pre-test phase. It is not recommended to enable the development error detection in production code due to increased runtime and ROM needs.
      boolean LinNmNodeDetectionEnabled: set at pre-compile, default-value=false  # This parameter defines whether the Node Detection feature is enabled or disabled.
      boolean LinNmNodeIdEnabled: set at pre-compile, default-value=false  # This parameter defines whether the source node identifier in NM messages is transmitted or not.
      boolean LinNmPassiveModeEnabled: set at pre-compile, default-value=false  # This parameter defines whether the Passive Mode of the LinNm is supported or not.
      boolean LinNmRemoteSleepIndicationEnabled: set at pre-compile, default-value=false  # This parameter defines whether Remote Sleep Indication support is enabled or disabled. This feature is required for NM Coordinator nodes only.
      boolean LinNmStateChangeIndEnabled: set at pre-compile, default-value=false  # This parameter defines whether the Network Management state change notification functions are called or not.
      boolean LinNmSynchronizationPointEnabled: set at pre-compile, default-value=false  # This parameter defines whether the Synchronize NM feature is enabled or disabled.
      boolean LinNmUserDataEnabled: set at pre-compile, default-value=false  # This parameter defines whether User Data support is enabled or disabled.
      boolean LinNmVersionInfoApi: set at pre-compile, default-value=false  # This parameter enables/disables the function LinNm_GetVersionInfo() to get major, minor and patch version information.
      string LinNmUserConfigFile [0..1]: set at pre-compile, origin=Vector Informatik  # Reference to an external text file that will be included during generation to <Module>_Cfg.h. The content of the user configuration file will be added at the end of the generated module configuration file and allows altering or extending the generated code. Caution: User configuration files can cause the software module to malfunction and must only be used with great care!
      boolean LinNmSafeBswChecks: set at pre-compile, origin=Vector Informatik, default-value=false  # Selects if safety checks are used. These checks improve robustness as e.g. invalid parameters are checked before function is executed. This attribute has to be enabled for safety projects where this component is mapped to an ASIL partition.
      container LinNmChannelConfig [1..*]  # Channel specific configuration parameters of the LINNM.
        symbolic name reference LinNmComMNetworkHandleRef: set at link in variant link-time / pre-compile in variant pre-compile+post-build-loadable, destination=ComMChannel  # ComM Network Handle Ref | Reference to a ComMChannel to provide access to the unique channel index value in ComMChannelId.
  bsw implementation LinNm_Impl: programming-language=C, sw-version=2.03.00, used-code-generator=DaVinci Configurator, vendor-id=30, ar-release-version=4.00.03, behavior=LinNmBehavior, preconfigured-configuration=LinNm_Pre, recommended-configuration=LinNm_Rec, vendor-specific-module-def=LinNm
  module config LinNm_Pre: definition=LinNm
  module config LinNm_Rec: definition=LinNm
