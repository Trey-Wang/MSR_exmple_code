AUTOSAR XML (schema 4-0-3)
package /MICROSAR
  module config CanNm_Pre: definition=CanNm
