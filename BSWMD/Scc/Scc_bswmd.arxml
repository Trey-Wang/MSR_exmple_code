AUTOSAR XML (schema 4-0-3)
package /MICROSAR
  module definition Scc [0..1]: category=VENDOR_SPECIFIC_MODULE_DEFINITION, variants pre-compile  # OEM Vector
    container SccGeneral
      boolean SccDevErrorDetect: set at pre-compile, origin=Vector Informatik, default-value=true  # Enable Development Error Detection | If 'Development Error Detection' is enabled, all development errors are reported to the Development Error Tracer (DET). The errors are described in the [TechnicalReference_Scc.pdf]. Note: In general, the development error detection is recommended during pre-test phase. It is not recommended to enable the development error detection in production code due to increased runtime and ROM needs.
      boolean SccVersionInfoApi: set at pre-compile, origin=Vector Informatik, default-value=false  # Enable Version Info API | If 'SccVersionInfoApi' is enabled, the function Scc_GetVersionInfo() is available to get major, minor and patch version information.
      string SccUserConfigFile: set at pre-compile, origin=Vector Informatik  # If a file path will be specified, the file is read and its contents are put at the end of the Scc config file.
      boolean SccProdErrorDetect: set at pre-compile, origin=Vector Informatik, default-value=true  # Enable Production Error Detection | If 'Production Error Detection' is enabled, production relevant errors are reported to the Diagnostics Event Manager (DEM). Disable this option, if no DEM is present in your system.
      float SccMainFunctionPeriod: 0.001..65.535, set at pre-compile, origin=Vector Informatik, default-value=0.005  # Main Function Period | The MainFunction period of the component.
      container SccConnectionConfig
        boolean SccEnableTls: set at pre-compile, origin=Vector Informatik, default-value=true  # Enable TLS | Enables the use of TLS for the V2G communication. If disabled, TCP is used directly. Please keep in mind that without TLS neither PnC nor VAS is available (according to the ISO/IEC 15118 specification).
        integer SccV2GSocketTxBufLen: 1..65535, set at pre-compile, origin=Vector Informatik, default-value=500  # V2G Socket Tx Buffer Length | Length of the TCP/TLS Tx buffer that shall be used. Note: This parameter will not generate a RAM buffer, it is used to configure the TLS connection or the TCP socket. Note: The default value is recommended for ISO 15118 PnC charging, it may be optimized for specific use cases and for EIM or DIN 70121 charging.
        integer SccV2GSocketRxBufLen: 1..65535, set at pre-compile, origin=Vector Informatik, default-value=4000  # V2G Socket Rx Buffer Length | Length of the TCP/TLS Rx buffer that shall be used. Note: This parameter will not generate a RAM buffer, it is used to configure the TLS connection or the TCP socket. Note: The default value is recommended for ISO 15118 PnC charging, it may be optimized for specific use cases and for EIM or DIN 70121 charging.
        integer SccV2GTPMaxTcpRxSegments: 1..65535, set at pre-compile, origin=Vector Informatik, default-value=2  # Maximum TL Rx Segments | The maximum number of TL memory segments that can be stored. Note: Using the Vector TCP IP implementation 2 segments are enough. All other segments will be appended to the existing segment.
        integer SccTcpSocketTxBufLen [0..1]: 1..65535, set at pre-compile, origin=Vector Informatik, default-value=300  # Tcp Socket Tx Buffer Length | Length of the TCP Tx buffer that shall be used. Note: This parameter will not generate a RAM buffer, it is used to configure the TLS connection or the TCP socket. Note: The default value is recommended for ISO 15118 PnC charging, it may be optimized for specific use cases and for EIM or DIN 70121 charging.
        integer SccTcpSocketRxBufLen [0..1]: 1..65535, set at pre-compile, origin=Vector Informatik, default-value=1440  # Tcp Socket Rx Buffer Length | Length of the TCP Rx buffer that shall be used. Note: This parameter will not generate a RAM buffer, it is used to configure the TLS connection or the TCP socket. Note: The default value is recommended for ISO 15118 PnC charging, it may be optimized for specific use cases and for EIM or DIN 70121 charging.
        reference SccEthIfCtrlRef: set at pre-compile, origin=Vector Informatik, destination=EthIfController  # Ethernet Interface Controller | The ethernet interface controller which is used for the V2G communication. The reference is necessary since the component reads the MAC address and uses it as the EVCCID.
        reference SccIPv6AddressRef: set at pre-compile, origin=Vector Informatik, destination=TcpIpLocalAddr  # The IPv6 address that shall be used by the SCC module to communicate with the EVSE. If unsure, chose the ...AsAn address. IPv6 will then automatically chose the correct IPv6 address. Just make sure to select the IPv6 address of the correct Eth controller.
      container SccV2GConfig
        integer SccV2GTpHdrPayloadTypeSdpReq: 0..65535, set at pre-compile, origin=Vector Informatik, default-value=36864  # V2G Transport Protocol Header Payload Type for SDPReq | V2GTP Payload Type for SECCDiscoveryProtocol request messages.
        integer SccV2GTpHdrPayloadTypeSdpRes: 0..65535, set at pre-compile, origin=Vector Informatik, default-value=36865  # V2G Transport Protocol Header Payload Type for SDPRes | V2GTP Payload Type for SECCDiscoveryProtocol response messages.
        integer SccV2GTpHdrPayloadTypeSap: 0..65535, set at pre-compile, origin=Vector Informatik, default-value=32769  # V2G Transport Protocol Header Payload Type for SAP messages | V2GTP Payload Type for SupportedAppProtocol messages.
        integer SccV2GTpHdrPayloadTypeExi: 0..65535, set at pre-compile, origin=Vector Informatik, default-value=32769  # V2G Transport Protocol Header Payload Type for EXI encoded messages | V2GTP Payload Type for EXI encoded messages.
        integer SccSchemaPriorityIsoFdis: 0..20, set at pre-compile, origin=Vector Informatik, default-value=1  # Schema Priority for ISO15118 v2 | Priority of the named schema. This priority will be send to the EVSE in the supportedAppProtocolReq.Priority. Values: 0: Schema disabled 1-20: Schema enabled, lowest value has highest priority
        integer SccSchemaPriorityDin: 0..20, set at pre-compile, origin=Vector Informatik, default-value=0  # Schema Priority for DIN70121 v2 | Priority of the named schema. This priority will be send to the EVSE in the supportedAppProtocolReq.Priority. Values: 0: Schema disabled 1-20: Schema enabled, lowest value has highest priority
        boolean SccEnableAcCharging: set at pre-compile, origin=Vector Informatik, default-value=true  # Enable AC Charging | If 'SccEnableAcCharging' is enabled, AC charging messages are supported by SCC.
        boolean SccEnableDcCharging: set at pre-compile, origin=Vector Informatik, default-value=false  # Enable DC Charging | If 'SccEnableDcCharging' is enabled, DC charging messages are supported by SCC.
        boolean SccEnablePncCharging: set at pre-compile, origin=Vector Informatik, default-value=false  # Enable PnC Profile | If 'SccEnablePncCharging' is set to true, the PnC charging profile will be supported for AC and DC charging according to ISO 15118. RESTRICTIONS: can only be enabled if 'SccEnableACCharging' are enabled
        boolean SccEnableStateMachine: set at pre-compile, origin=Vector Informatik, default-value=true  # Enable Internal State Machine | If enabled the internal state machine of the component is activated.
        integer SccV2GProtocolVersion: 1..1, set at pre-compile, origin=Vector Informatik, default-value=1  # V2G Protocol Version | The V2G protocol version which is used in the V2G header.
        boolean SccEnableSlacHandling: set at pre-compile, origin=Vector Informatik, default-value=false  # Enable SLAC Handling | Enable if this module shall handle the SLAC protocol. If disabled, the application has to start SLAC and handle all of the callbacks.
        boolean SccApplicationControlledFlow: set at pre-compile, origin=Vector Informatik, default-value=false  # Enable Internal State Machine Application Controlled Flow | If enabled the application is able to control the flow of the complete message sequence. Only if the value is set to TRUE, the internal State Machine will continue with the next message.
        boolean SccEnableOngoingCallbacks: set at pre-compile, origin=Vector Informatik, default-value=false  # If enabled, the parameters of response messages that contain the EVSEProcessing parameter will always be reported, not only when EVSEProcessing is equal to Finished. Except for SAScheduleList, which is never being reported when EVSEProcessing is equal to Ongoing.
        boolean SccEnableEvseCompatibility: set at pre-compile, origin=Vector Informatik, default-value=false  # Enable EVSE Compatibility | If the paramter is enabled, the following checks are disabled in the Scc to allow compatibility with some EVSE - EVSEMaximumPowerLimit DISABLE THIS PARAMTER IN SERIAL PRODUCTION
        container SccPncConfig
          boolean SccEnableCertificateUpdate: set at pre-compile, origin=Vector Informatik, default-value=true  # If 'SccUseCertificateUpdate' is set to true, the SCC will support the CertificateUpdate message set.
          boolean SccEnableCertificateInstallation: set at pre-compile, origin=Vector Informatik, default-value=true  # If 'SccUseCertificateInstallation' is set to true, the SCC will support the CertificateInstallation message set.
          boolean SccCertCpsCheckEnabled: set at pre-compile, origin=Vector Informatik, default-value=false  # Enable CPS Check for SAProvisioningCertChain | Enable the CPS Check for the SAProvisioningCertChain as required in V2G2-891 and V2G2-896.
          boolean SccCertPivateKeyValidationEnable: set at pre-compile, origin=Vector Informatik, default-value=true  # Enable Private Key Validation | Enables the private key validation during certificate installation and update.
          boolean SccDisableXmlSecTx: set at pre-compile, origin=Vector Informatik, default-value=false  # Disable XmlSignature Generation | If enabled the component will not create XmlSecurity signatures for outgoing V2G messages.
          boolean SccDisableXmlSecRx: set at pre-compile, origin=Vector Informatik, default-value=false  # Disable XmlSignature Validation | If enabled the component will not validate incoming XmlSecurity signatures.
          integer SccCertLen: 800..800, set at pre-compile, origin=Vector Informatik, default-value=800  # Certificate Length | The expected length for all certificates. Note: The maximum length that can be transmitted is limited by the ISO15118 EXI schema.
          integer SccCertPrivKeyLen: 32..32, set at pre-compile, origin=Vector Informatik, default-value=32  # Certificate Private Key Length | The expected length for all certificate private keys. Note: ECDSA private key length is specified with 32 byte.
          integer SccCertPubKeyLen: 65..65, set at pre-compile, origin=Vector Informatik, default-value=65  # Certificate Public Key Length | The expected length for received certificate public keys. Note: ECDSA public key length is specified with 64 byte.
          integer SccCertIvLen: 16..16, set at pre-compile, origin=Vector Informatik, default-value=16  # Initial Vector Length | The expected length for received initialization vectors. Note: AES128 initialization vector length is specified with 16 byte.
          integer SccCertChainSizeSize: 1..1, set at pre-compile, origin=Vector Informatik, default-value=1  # Certificate Chain Size NvM Block Size | The expected contract certificate chain size NvM block length.
          integer SccProvCertIdMaxLen: 1..18, set at pre-compile, origin=Vector Informatik, default-value=18  # Maximum Provisioning Certificate ID Length | The maximum length of a Provisioning Certificate ID.
          boolean SccEnablePrivateKeyEncryption: set at pre-compile, origin=Vector Informatik, default-value=false  # Activates the encryption of the Private Key. This requires a password and an optional salt which have to be provided by the application via a callback. To generate the secret PBKDF2 is used, to encrypt and decrypt the Private Key AES128 is used.
          boolean SccEnableEMAIDValidation: set at pre-compile, origin=Vector Informatik, default-value=true  # If enabled, the EMAID that is being received as a parameter in the Certificate Installation or Certificate Update message will be validated against the actual EMAID that is contained in the Contract Certificate.
          string SccDomainComponentTlsLeafCert: set at pre-compile, origin=Vector Informatik  # Domain Component TLS Leaf Certificate | Name of the Domain Component in the TLS Leaf Certificate which will be validated with the function 'Scc_Cbk_TLS_CertChain' in /MICROSAR/TcpIp/TcpIpConfig/TcpIpSocketOwnerConfig/TcpIpSocketOwner/TcpIpSocketOwnerTlsValidationResultName
          boolean SccEnableCsmSupport: set at pre-compile, origin=Vector Informatik, default-value=false  # Enables the support for Crypto Service Manager (CSM) defined in AUTOSAR4.3.
          container SccPrivKeyEncConfig [0..1]
            integer SccPBKDF2Iterations: 2..2147483647, set at pre-compile, origin=Vector Informatik, default-value=4096  # The number of iterations that are used in the PBKDF2. The higher the number, the more secure the encryption of the Private Key will be. 4096 is used as default, since this amount of iterations is used for WPA2.
            string SccContrCertPrivKeyPwdPtr: set at pre-compile, origin=Vector Informatik, default-value=Appl_SccCbk_Get_Core_ContrCertPrivKeyPasswordPtr, min-length=1  # Contract Certificate Private Key Password Callback | Function name for the callback which provides a pointer to the Password that will be used for encrypting the Private Key of the Contract Certificate.
            string SccContrCertPrivKeySaltPtr: set at pre-compile, origin=Vector Informatik, default-value=Appl_SccCbk_Get_Core_ContrCertPrivKeySaltPtr  # Contract Certificate Private Key Salt Callback | Function name for the callback which provides a pointer to the Salt that will be used for encrypting the Private Key of the Contract Certificate. If left empty, no Salt will be used.
            string SccProvCertPrivKeyPwdPtr: set at pre-compile, origin=Vector Informatik, default-value=Appl_SccCbk_Get_Core_ProvCertPrivKeyPasswordPtr, min-length=1  # Provisioning Certificate Private Key Password Callback | Function name for the callback which provides a pointer to the Password that will be used for encrypting the Private Key of the Provisioning Certificate.
            string SccProvCertPrivKeySaltPtr: set at pre-compile, origin=Vector Informatik, default-value=Appl_SccCbk_Get_Core_ProvCertPrivKeySaltPtr  # Provisioning Certificate Private Key Salt Callback | Function name for the callback which provides a pointer to the Salt that will be used for encrypting the Private Key of the Provisioning Certificate. If left empty, no Salt will be used.
        container SccSlacConfig
          string SccRandomDataFct: set at pre-compile, origin=Vector Informatik, default-value=ApplRand_GetRandArray, min-length=1  # Random Data Function | The function that is specified here needs to provide random data. The randomization does not need to meet cryptographic standards. The signature should look like this: FunctionName(uint8* PointerToBuffer, uint16 LengthOfBuffer)
          string SccIncludeHeader [0..*]: set at pre-compile, origin=Vector Informatik  # Header File | Header file that contains the random data function.
          symbolic name reference SccTrcvRef [0..1]: set at pre-compile, origin=Vector Informatik, destination=EthTrcvConfig  # Ethernet Transceiver | The ethernet transceiver which is used for the PLC communication. The reference is necessary since the component will start SLAC on this transceiver.
      container SccBufferConfig
        integer SccExiStructBufLen: 1..65535, set at pre-compile, origin=Vector Informatik, default-value=10000  # EXI Struct Buffer Length | The length of the EXI Struct Buffer. It is used for received messages and for messages that shall be sent.
        integer SccExiTempBufLen: 1..65535, set at pre-compile, origin=Vector Informatik, default-value=500  # EXI Temporary Buffer Length | This buffer is required to store temporary data. This includes EXI streams which are necessary to create and validate XmlSignatures and elements that are received in a response and have to be transmitted back in the next request. This buffer is only required if the PnC profile is active.
        boolean SccEnableInternalChargingProfileBuffer: set at pre-compile, origin=Vector Informatik, default-value=false  # If enabled, the callback that requests the ChargingProfile will provide a pointer to the Exi Struct buffer, to where the application may copy the ChargingProfile. If disabled (old behavior), the callback will request a pointer to the buffer where the application has stored the ChargingProfile.
      container SccNvmConfig
        integer SccSessionIdNvmBlockLen [0..1]: 1..255, set at pre-compile, origin=Vector Informatik, default-value=9  # SessionID NvM Block Length | The length of the currently configured NvM block.
        integer SccSessionIdNvmBlockExpLen: 1..255, set at pre-compile, origin=Vector Informatik, default-value=9  # SessionID Expected NvM Block Length | The expected NvM block length.
        integer SccDiagParametersNvmBlockLen: 0..255, set at pre-compile, origin=Vector Informatik, default-value=0  # 'Dynamic Config Parameters' NvM Block Length | The length of the currently configured NvM block.
        string SccSessionIdNvmRomDefault: set at pre-compile, origin=Vector Informatik, default-value=Scc_SessionIDNvmRomDefault, min-length=1  # SessionID NvM ROM Default | The ROM default block that will be used as initial value for this NvM block.
        string SccDiagParametersNvmRomDefault: set at pre-compile, origin=Vector Informatik, default-value=Scc_DynConfigParamsNvmRomDefault, min-length=1  # 'Dynamic Config Parameters' NvM ROM Default | The ROM default block that will be used as initial value for this NvM block.
        reference SccSessionIdNvmBlock [0..1]: set at pre-compile, origin=Vector Informatik, destination=NvMBlockDescriptor  # SessionID NvM Block | The NvM block which stores the SessionID.
        reference SccDiagParametersNvmBlock [0..1]: set at pre-compile, origin=Vector Informatik, destination=NvMBlockDescriptor  # 'Dynamic Config Parameters' NvM Block | The NvM block which stores the parameters that are configurable via diagnostic measures.
    container SccCertConfig [0..1]
      container SccRootCertConfig [1..*]
        integer SccRootCertNvmBlockLen: 0..1024, set at pre-compile, origin=Vector Informatik, default-value=0  # 'Root Certificate' NvM Block Length | The length of the currently configured NvM block.
        integer SccRootCertNvmBlockExpLen: 1..1024, set at pre-compile, origin=Vector Informatik, default-value=800  # 'Root Certificate' Expected NvM Block Length | The expected NvM block length.
        integer SccRootCertIdx: set at pre-compile, origin=Vector Informatik, symbolic-name-value=true, default-value=0  # Root Certificate Index | Automatic calculated index value.
        reference SccRootCertNvmBlock: set at pre-compile, origin=Vector Informatik, destination=NvMBlockDescriptor  # 'Root Certificate' NvM Block | The NvM block of the root certificate that is used for the component to validate signatures which are received with the responses of the EVSE.
      container SccContrCertChainConfig [1..*]
        integer SccContractCertChainSizeNvmBlockLen: 1..2, set at pre-compile, origin=Vector Informatik, default-value=0  # 'Contract Certificate Chain Size' NvM Block Length | The length of the currently configured NvM block.
        integer SccContractCertChainSizeNvmBlockExpLen: 1..2, set at pre-compile, origin=Vector Informatik, default-value=1  # 'Contract Certificate Chain Size' Expected NvM Block Length | The expected NvM block length.
        integer SccContractCertNvmBlockLen: 0..1024, set at pre-compile, origin=Vector Informatik, default-value=0  # 'Contract Certificate' NvM Block Length | The length of the currently configured NvM block.
        integer SccContractCertNvmBlockExpLen: 1..1024, set at pre-compile, origin=Vector Informatik, default-value=800  # 'Contract Certificate' Expected NvM Block Length | The expected NvM block length.
        integer SccContractCertPrivKeyNvmBlockLen: 0..1024, set at pre-compile, origin=Vector Informatik, default-value=0  # 'Contract Certificate Private Key' NvM Block Length | The length of the currently configured NvM block.
        integer SccContractCertPrivKeyNvmBlockExpLen: 1..1024, set at pre-compile, origin=Vector Informatik, default-value=32  # 'Contract Certificate Private Key' Expected NvM Block Length | The expected NvM block length.
        integer SccProvCertNvmBlockLen: 0..1024, set at pre-compile, origin=Vector Informatik, default-value=0  # 'Provisioning Certificate' NvM Block Length | The length of the currently configured NvM block.
        integer SccProvCertNvmBlockExpLen: 1..1024, set at pre-compile, origin=Vector Informatik, default-value=800  # 'Provisioning Certificate' Expected NvM Block Length | The expected NvM block length.
        integer SccProvCertPrivKeyNvmBlockLen: 0..1024, set at pre-compile, origin=Vector Informatik, default-value=0  # 'Provisioning Certificate Private Key' NvM Block Length | The length of the currently configured NvM block.
        integer SccProvCertPrivKeyNvmBlockExpLen: 1..1024, set at pre-compile, origin=Vector Informatik, default-value=32  # 'Provisioning Certificate Private Key' Expected NvM Block Length | The expected NvM block length.
        integer SccContrCertChainIdx: set at pre-compile, origin=Vector Informatik, symbolic-name-value=true, default-value=0  # Contract Certificate Chain Index | Automatic calculated index value.
        reference SccContractCertChainSizeNvmBlock [0..1]: set at pre-compile, origin=Vector Informatik, destination=NvMBlockDescriptor  # 'Contract Certificate Chain Size' NvM Block | The current size of the ContractCertificateChain. If the value is equal to '0' it means that only the ContractCertificate belongs to the ContractCertificateChain. All values greater than '0' define how man Contract Sub Certificates are used. RESTRICTIONS: 'SccEnablePncCharging' has to be enabled to be able to configure this parameter
        reference SccContractCertNvmBlock: set at pre-compile, origin=Vector Informatik, destination=NvMBlockDescriptor  # 'Contract Certificate' NvM Block | The ContractCertificate of this ContractCertificateChain.
        reference SccContractCertPrivKeyNvmBlock [0..1]: set at pre-compile, origin=Vector Informatik, destination=NvMBlockDescriptor  # 'Contract Certificate Private Key' NvM Block | The PrivateKey of the ContractCertificate of this ContractCertificateChain.
        reference SccProvCertNvmBlock: set at pre-compile, origin=Vector Informatik, destination=NvMBlockDescriptor  # 'Provisioning Certificate' NvM Block | The ProvisioningCertificate of this ContractCertificateChain. RESTRICTIONS: 'SccUseCertificateInstallation' has to be enabled to be able to configure this parameter
        reference SccProvCertPrivKeyNvmBlock [0..1]: set at pre-compile, origin=Vector Informatik, destination=NvMBlockDescriptor  # 'Provisioning Certificate Private Key' NvM Block | The PrivateKey of the ProvisioningCertificate of this ContractCertificateChain.
        container SccContrSubCertConfig [0..2]
          integer SccContrSubCertNvmBlockLen: 0..1024, set at pre-compile, origin=Vector Informatik, default-value=0  # 'Contract Sub Certificate' NvM Block Length | The length of the currently configured NvM block.
          integer SccContrSubCertNvmBlockExpLen: 1..1024, set at pre-compile, origin=Vector Informatik, default-value=800  # 'Contract Sub Certificate' Expected NvM Block Length | The expected NvM block length.
          integer SccContrSubCertIdx: set at pre-compile, origin=Vector Informatik, symbolic-name-value=true, default-value=0  # Contract Sub Certificate Index | Automatic calculated index value.
          reference SccContrSubCertNvmBlock: set at pre-compile, origin=Vector Informatik, destination=NvMBlockDescriptor  # 'Contract Sub Certificate' NvM Block | The ContractSubCertificates of this ContractCertificateChain.
        container SccCsmContrConfig [0..1]  # Configuration of all CSM parameters needed for a Contract Certificate
          reference SccECDSASignContrCertKeyId: set at pre-compile, origin=Vector Informatik, destination=CsmKey  # ECDSA Sign Contract Certificate KeyId | CSM Private ECC Key to sign the messages AuthorizationReq, CertificateUpdateReq and MeteringReceiptReq.
          reference SccECDSASignContrCertJobId: set at pre-compile, origin=Vector Informatik, destination=CsmJob  # ECDSA Sign Contract Certificate JobId | CSM job to sign the messages AuthorizationReq, CertificateUpdateReq and MeteringReceiptReq.
      container SccCsmConfig [0..1]
        reference SccECDSASignProvCertJobId: set at pre-compile, origin=Vector Informatik, destination=CsmJob  # ECDSA Sign Provisioning Certificate JobId | CSM job to sign the messages CertificateInstallationReq.
        reference SccECDSASignProvCertKeyId: set at pre-compile, origin=Vector Informatik, destination=CsmKey  # ECDSA Sign Provisioning Certificate KeyId | CSM key to sign the messages CertificateInstallationReq.
        reference SccECDSAVerifyJobId: set at pre-compile, origin=Vector Informatik, destination=CsmJob  # CSM job to verify the messages ChargeParameterDiscoveryRes (MoSub2Cert), CertificateInstallationRes (SAProvCert), CertificateUpdateRes (SAProvCert) and the certificate chains.
        reference SccECDSAVerifyKeyId: set at pre-compile, origin=Vector Informatik, destination=CsmKey  # CSM Public Key to verify the messages ChargeParameterDiscoveryRes (MoSub2Cert), CertificateInstallationRes (SAProvCert), CertificateUpdateRes (SAProvCert) and the certificate chains.
        reference SccSHA256JobId: set at pre-compile, origin=Vector Informatik, destination=CsmJob  # CSM job to calculate Hash (SHA256) for signature reference.
    container SccDemEventParameterRefs [0..1]
      symbolic name reference SCC_E_EXI [0..1]: set at pre-compile, origin=Vector Informatik, destination=DemEventParameter
      symbolic name reference SCC_E_UNEXPECTED_MSG [0..1]: set at pre-compile, origin=Vector Informatik, destination=DemEventParameter
      symbolic name reference SCC_E_NVM_READ_CONTR_CERT_CHAIN_SIZE_FAIL [0..1]: set at pre-compile, origin=Vector Informatik, destination=DemEventParameter
      symbolic name reference SCC_E_NVM_READ_CONTR_CERT_FAIL [0..1]: set at pre-compile, origin=Vector Informatik, destination=DemEventParameter
      symbolic name reference SCC_E_NVM_READ_CONTR_CERT_PRIV_KEY_FAIL [0..1]: set at pre-compile, origin=Vector Informatik, destination=DemEventParameter
      symbolic name reference SCC_E_NVM_READ_ROOT_CERT_FAIL [0..1]: set at pre-compile, origin=Vector Informatik, destination=DemEventParameter
      symbolic name reference SCC_E_NVM_READ_PROV_CERT_FAIL [0..1]: set at pre-compile, origin=Vector Informatik, destination=DemEventParameter
      symbolic name reference SCC_E_XML_SEC [0..1]: set at pre-compile, origin=Vector Informatik, destination=DemEventParameter
      symbolic name reference SCC_E_CRYPTO [0..1]: set at pre-compile, origin=Vector Informatik, destination=DemEventParameter
      symbolic name reference SCC_E_NVM_READ_PROV_CERT_PRIV_KEY_FAIL [0..1]: set at pre-compile, origin=Vector Informatik, destination=DemEventParameter
      symbolic name reference SCC_E_NVM_READ_CONTR_SUB_CERT_FAIL [0..1]: set at pre-compile, origin=Vector Informatik, destination=DemEventParameter
      symbolic name reference SCC_E_IP_BASE [0..1]: set at pre-compile, origin=Vector Informatik, destination=DemEventParameter
      symbolic name reference SCC_E_SAP_NO_NEGOTIATION [0..1]: set at pre-compile, origin=Vector Informatik, destination=DemEventParameter
    container SccParameterMapping
      string SccCbkIncludeHeader [0..*]: set at pre-compile, origin=Vector Informatik  # Header File | Header file that contains the callback functions.
      container SccCore
        container SccCoreRxParam [1..*]
          enumeration SccInterfaceType: set at pre-compile, origin=Vector Informatik, default-value=CBK  # Interface Type
            CBK  # Callback
            SM  # State Machine
          string SccCallback: set at pre-compile, origin=Vector Informatik  # Callback
          boolean SccUseDefaultValue: set at pre-compile, origin=Vector Informatik, default-value=false  # Use Default Value
          integer SccDefaultValue: set at pre-compile, origin=Vector Informatik, default-value=0  # Default Value
        container SccCoreTxParam [1..*]
          enumeration SccInterfaceType: set at pre-compile, origin=Vector Informatik, default-value=CBK  # Interface Type
            CBK  # Callback
          string SccCallback: set at pre-compile, origin=Vector Informatik  # Callback
          boolean SccDisableCallback: set at pre-compile, origin=Vector Informatik, default-value=false  # Disable Callback
      container SccStateM [0..1]
        container SccStateMRxParam [1..*]
          enumeration SccInterfaceType: set at pre-compile, origin=Vector Informatik, default-value=CBK  # Interface Type
            CBK  # Callback
            SM  # State Machine
          string SccCallback: set at pre-compile, origin=Vector Informatik  # Callback
          boolean SccUseDefaultValue: set at pre-compile, origin=Vector Informatik, default-value=false  # Use Default Value
          integer SccDefaultValue: set at pre-compile, origin=Vector Informatik, default-value=0  # Default Value
        container SccStateMTxParam [1..*]
          enumeration SccInterfaceType: set at pre-compile, origin=Vector Informatik, default-value=CBK  # Interface Type
            CBK  # Callback
          string SccCallback: set at pre-compile, origin=Vector Informatik  # Callback
          boolean SccDisableCallback: set at pre-compile, origin=Vector Informatik, default-value=false  # Disable Callback
      container SccIso [0..1]
        container SccIsoCommon
          container SccIsoCommonRxParam [1..*]
            enumeration SccInterfaceType: set at pre-compile, origin=Vector Informatik, default-value=CBK  # Interface Type
              CBK  # Callback
              SM  # State Machine
            string SccCallback: set at pre-compile, origin=Vector Informatik  # Callback
            boolean SccUseDefaultValue: set at pre-compile, origin=Vector Informatik, default-value=false  # Use Default Value
            integer SccDefaultValue: set at pre-compile, origin=Vector Informatik, default-value=0  # Default Value
          container SccIsoCommonTxParam [1..*]
            enumeration SccInterfaceType: set at pre-compile, origin=Vector Informatik, default-value=CBK  # Interface Type
              CBK  # Callback
            string SccCallback: set at pre-compile, origin=Vector Informatik  # Callback
            boolean SccDisableCallback: set at pre-compile, origin=Vector Informatik, default-value=false  # Disable Callback
        container SccIsoAc [0..1]
          container SccIsoAcRxParam [1..*]
            enumeration SccInterfaceType: set at pre-compile, origin=Vector Informatik, default-value=CBK  # Interface Type
              CBK  # Callback
              SM  # State Machine
            string SccCallback: set at pre-compile, origin=Vector Informatik  # Callback
            boolean SccUseDefaultValue: set at pre-compile, origin=Vector Informatik, default-value=false  # Use Default Value
            integer SccDefaultValue: set at pre-compile, origin=Vector Informatik, default-value=0  # Default Value
          container SccIsoAcTxParam [1..*]
            enumeration SccInterfaceType: set at pre-compile, origin=Vector Informatik, default-value=CBK  # Interface Type
              CBK  # Callback
            string SccCallback: set at pre-compile, origin=Vector Informatik  # Callback
            boolean SccDisableCallback: set at pre-compile, origin=Vector Informatik, default-value=false  # Disable Callback
        container SccIsoDc [0..1]
          container SccIsoDcRxParam [1..*]
            enumeration SccInterfaceType: set at pre-compile, origin=Vector Informatik, default-value=CBK  # Interface Type
              CBK  # Callback
              SM  # State Machine
            string SccCallback: set at pre-compile, origin=Vector Informatik  # Callback
            boolean SccUseDefaultValue: set at pre-compile, origin=Vector Informatik, default-value=false  # Use Default Value
            integer SccDefaultValue: set at pre-compile, origin=Vector Informatik, default-value=0  # Default Value
          container SccIsoDcTxParam [1..*]
            enumeration SccInterfaceType: set at pre-compile, origin=Vector Informatik, default-value=CBK  # Interface Type
              CBK  # Callback
            string SccCallback: set at pre-compile, origin=Vector Informatik  # Callback
            boolean SccDisableCallback: set at pre-compile, origin=Vector Informatik, default-value=false  # Disable Callback
      container SccDin [0..1]
        container SccDinRxParam [1..*]
          enumeration SccInterfaceType: set at pre-compile, origin=Vector Informatik, default-value=CBK  # Interface Type
            CBK  # Callback
            SM  # State Machine
          string SccCallback: set at pre-compile, origin=Vector Informatik  # Callback
          boolean SccUseDefaultValue: set at pre-compile, origin=Vector Informatik, default-value=false  # Use Default Value
          integer SccDefaultValue: set at pre-compile, origin=Vector Informatik, default-value=0  # Default Value
        container SccDinTxParam [1..*]
          enumeration SccInterfaceType: set at pre-compile, origin=Vector Informatik, default-value=CBK  # Interface Type
            CBK  # Callback
          string SccCallback: set at pre-compile, origin=Vector Informatik  # Callback
          boolean SccDisableCallback: set at pre-compile, origin=Vector Informatik, default-value=false  # Disable Callback
      container SccSlac [0..1]
        container SccSlacRxParam [1..*]
          enumeration SccInterfaceType: set at pre-compile, origin=Vector Informatik, default-value=CBK  # Interface Type
            CBK  # Callback
            SM  # State Machine
          string SccCallback: set at pre-compile, origin=Vector Informatik  # Callback
          boolean SccUseDefaultValue: set at pre-compile, origin=Vector Informatik, default-value=false  # Use Default Value
          integer SccDefaultValue: set at pre-compile, origin=Vector Informatik, default-value=0  # Default Value
        container SccSlacTxParam [1..*]
          enumeration SccInterfaceType: set at pre-compile, origin=Vector Informatik, default-value=CBK  # Interface Type
            CBK  # Callback
          string SccCallback: set at pre-compile, origin=Vector Informatik  # Callback
          boolean SccDisableCallback: set at pre-compile, origin=Vector Informatik, default-value=false  # Disable Callback
    container SccConfigMapping
      string SccCbkIncludeHeader [0..*]: set at pre-compile, origin=Vector Informatik  # Header File | Header file that contains the callback functions.
      container SccTimerConfig
        container SccTimerConfigISO [0..1]
          container SccTimerConfigISOParam [1..*]
            enumeration SccConfigType: set at pre-compile, origin=Vector Informatik, default-value=Static  # Config Type
              Static  # Static Value
              Dynamic  # Dynamic NVRAM
              Extern  # External Callback
            string SccCallback [0..1]: set at pre-compile, origin=Vector Informatik  # Callback
            integer SccDefaultValue: set at pre-compile, origin=Vector Informatik, default-value=0  # Default Value
        container SccTimerConfigDIN [0..1]
          container SccTimerConfigDINParam [1..*]
            enumeration SccConfigType: set at pre-compile, origin=Vector Informatik, default-value=Static  # Config Type
              Static  # Static Value
              Dynamic  # Dynamic NVRAM
              Extern  # External Callback
            string SccCallback [0..1]: set at pre-compile, origin=Vector Informatik  # Callback
            integer SccDefaultValue: set at pre-compile, origin=Vector Informatik, default-value=0  # Default Value
        container SccTimerConfigGeneral
          container SccTimerConfigGeneralParam [1..*]
            enumeration SccConfigType: set at pre-compile, origin=Vector Informatik, default-value=Static  # Config Type
              Static  # Static Value
              Dynamic  # Dynamic NVRAM
              Extern  # External Callback
            string SccCallback [0..1]: set at pre-compile, origin=Vector Informatik  # Callback
            integer SccDefaultValue: set at pre-compile, origin=Vector Informatik, default-value=0  # Default Value
      container SccStateMConfig [0..1]
        container SccStateMConfigParam [1..*]
          enumeration SccConfigType: set at pre-compile, origin=Vector Informatik, default-value=Static  # ConfigType
            Static  # Static Value
            Dynamic  # Dynamic NVRAM
            Extern  # External Callback
          string SccCallback [0..1]: set at pre-compile, origin=Vector Informatik  # Callback
          integer SccDefaultValue: set at pre-compile, origin=Vector Informatik, default-value=0  # Default Value
  bsw implementation Scc_Impl: programming-language=C, sw-version=09.05.00, used-code-generator=DaVinci Configurator, vendor-id=30, ar-release-version=4.00.03, behavior=SccBehavior, preconfigured-configuration=Scc_Pre, recommended-configuration=Scc_Rec, vendor-specific-module-def=Scc
  module config Scc_Pre: definition=Scc
    SccGeneral
      SccV2GConfig: SccV2GProtocolVersion=1
        SccPncConfig: SccCertChainSizeSize=1, SccCertIvLen=16, SccCertLen=800, SccCertPrivKeyLen=32, SccCertPubKeyLen=65
      SccNvmConfig: SccSessionIdNvmBlockExpLen=9
  module config Scc_Rec: definition=Scc
