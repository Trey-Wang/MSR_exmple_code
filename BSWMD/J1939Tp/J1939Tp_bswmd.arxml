AUTOSAR XML (schema 4-1-3)
package /MICROSAR
  module definition J1939Tp [0..1]: category=VENDOR_SPECIFIC_MODULE_DEFINITION, refined-module-def=J1939Tp, variants post-build-loadable/pre-compile/post-build-selectable  # Configuration of the J1939Tp (SAE J1939 Transport Layer) module.
    container J1939TpConfiguration  # Configuration parameters and sub containers of the J1939Tp module that define the communication paths.
      container J1939TpRxChannel [0..*]: post-build-changeable=true  # This container describes a reception channel of the J1939Tp module. A channel referencing N-PDUs without MetaData is used for all N-SDUs that share the same source address (SA) and the same destination address (BAM: DA = 0xFF, CMDT: DA != 0xFF). A channel with N-PDUs with MetaData is used for all possible source and destination addresses.
        boolean J1939TpRxCancellationSupport [0..1]: set at post-build in variant post-build-loadable+post-build-selectable / pre-compile in variant pre-compile, default-value=false  # Enable receive cancellation using the API J1939Tp_CancelReceive() for this channel. Please note: This feature is not yet supported.
        integer J1939TpRxDa [0..1]: 0..253, set at post-build in variant post-build-loadable+post-build-selectable / pre-compile in variant pre-compile, default-value=0  # Rx DA | Destination address (DA) of this channel. This parameter is only required for channels with fixed DA which use N-PDUs with MetaData containing the DA.
        boolean J1939TpRxDynamicBlockCalculation [0..1]: set at post-build in variant post-build-loadable+post-build-selectable / pre-compile in variant pre-compile, default-value=false  # Dynamic Block Calculation | Enable dynamic calculation of "number of packets that can be sent" value in TP.CM_CTS, based on the size of buffers in upper layers reported via StartOfReception and PduR_J1939TpCopyRxData. Please note: This feature is not yet supported.
        integer J1939TpRxDynamicBufferRatio [0..1]: 0..100, set at post-build in variant post-build-loadable+post-build-selectable / pre-compile in variant pre-compile, default-value=80  # Dynamic Buffer Ratio | Percentage of available buffer that shall be used for retry. Please note: This feature is not yet supported. | This parameter is only applicable when "J1939TpRxRetrySupport" and "J1939TpRxDynamicBlockCalculation" are enabled.
        integer J1939TpRxPacketsPerBlock [0..1]: 1..255, set at post-build in variant post-build-loadable+post-build-selectable / pre-compile in variant pre-compile, default-value=16  # Packets Per Block | Number of TP.DT frames the receiving J1939Tp module allows the sender to send before waiting for another TP.CM_CTS. This parameter is transmitted in the TP.CM_CTS frame, and is thus only relevant for reception of messages via CMDT. When J1939TpRxDynamicBlockCalculation is enabled, this parameter specifies a maximum for the calculated value. For further details on this parameter value see SAE J1939/21.
        enumeration J1939TpRxProtocolType [0..1]: set at post-build in variant post-build-loadable+post-build-selectable / pre-compile in variant pre-compile, default-value=J1939TP_PROTOCOL_BAM  # Protocol Type | Protocol type used by this channel. This parameter is only required for channels with fixed destination address.
          J1939TP_PROTOCOL_BAM  # J1939 Broadcast TP (BAM = Broadcast Announce Message)
          J1939TP_PROTOCOL_CMDT  # J1939 Directed TP (aka RTS/CTS, CMDT = Connection Mode Data Transfer)
          J1939TP_PROTOCOL_ETP  # ISO 11783 Extended TP
          J1939TP_PROTOCOL_FPTP  # NMEA2000 FastPacket Protocol
        boolean J1939TpRxRetrySupport [0..1]: set at post-build in variant post-build-loadable+post-build-selectable / pre-compile in variant pre-compile, default-value=false  # Retry Support | Enable support for triggering repetition of failed transmission using TP.CM_CTS with a packet number that has already been sent. Retransmission is triggered when a sequence number is missing or a timeout occurs during reception. Please note: This feature is not yet supported.
        integer J1939TpRxSa [0..1]: 0..253, set at post-build in variant post-build-loadable+post-build-selectable / pre-compile in variant pre-compile, default-value=0  # Rx SA | Source address (SA) of this channel. This parameter is only required for channels with fixed SA which use N-PDUs with MetaData.
        boolean J1939TpRxIsobusChannel [0..1]: set at pre-compile, origin=Vector Informatik, default-value=false  # ISOBUS Channel | Identifies this channel as an ISOBUS (ISO 11873) channel. If enabled, the abort reasons conform with ISO 11783, otherwise with SAE J1939.
        symbolic name reference J1939TpRxChannelComMNetworkHandleRef: set at post-build in variant post-build-loadable+post-build-selectable / pre-compile in variant pre-compile, origin=Vector Informatik, destination=ComMChannel  # ComM Network Handle Ref | Reference to the channel defined by the ComMChannel providing access to the unique channel index ComMChannelId.
        container J1939TpRxCmNPdu [0..1]  # TP.CM Rx N-Pdu | This N-PDU represents the TP.CM frame of a J1939 transport protocol session. TP.CM is used both by BAM and CMDT to initialize the connection. For CMDT, it is also used to abort the connection.
          integer J1939TpRxCmNPduId: 0..65535, scope=ECU, set at pre-compile, symbolic-name-value=true, default-value=0  # TP.CM Rx N-Pdu ID | The N-PDU identifier used for communication with CanIf.
          reference J1939TpRxCmNPduRef: set at post-build in variant post-build-loadable+post-build-selectable / pre-compile in variant pre-compile, destination=Pdu  # TP.CM Rx N-Pdu Ref | Reference to the Pdu object representing the N-PDU.
        container J1939TpRxDtNPdu [0..1]  # TP.DT Rx N-Pdu | This N-PDU represents the TP.DT frame of a J1939 transport protocol session. TP.DT is used both by BAM and CMDT to transfer the contents of an N-SDU.
          integer J1939TpRxDtNPduId: 0..65535, scope=ECU, set at pre-compile, symbolic-name-value=true, default-value=0  # TP.DT Rx N-Pdu ID | The N-PDU identifier used for communication with CanIf.
          reference J1939TpRxDtNPduRef: set at post-build in variant post-build-loadable+post-build-selectable / pre-compile in variant pre-compile, destination=Pdu  # TP.DT Rx N-Pdu Ref | Reference to the Pdu object representing the N-PDU.
        container J1939TpRxPg [1..*]: post-build-changeable=true  # PG | Parameter group received by the J1939 transport layer.
          boolean J1939TpRxPgDynLength: set at post-build in variant post-build-loadable+post-build-selectable / pre-compile in variant pre-compile, default-value=false  # Dyn Length | This flag is set to TRUE when the N-SDU refers to a PG with variable length. | Please note: When this attribute is TRUE, the sub container J1939TpRxDirectNPdu is required.
          integer J1939TpRxPgPGN: 0..262143, set at post-build in variant post-build-loadable+post-build-selectable / pre-compile in variant pre-compile, default-value=0  # PGN | PGN of the referenced N-SDUs.
          container J1939TpRxDirectNPdu [0..1]  # Direct and FastPacket Rx N-Pdu | This N-PDU represents the short frame that is used for a FastPacket message or a dynamic length PG when it has a length of less that 8 bytes. | Please note: This sub container is only necessary when J1939TpRxPgDynLength is TRUE.
            integer J1939TpRxDirectNPduId: 0..65535, scope=ECU, set at pre-compile, symbolic-name-value=true, default-value=0  # Direct Rx N-Pdu ID | The N-PDU identifier used for communication with CanIf.
            reference J1939TpRxDirectNPduRef: set at post-build in variant post-build-loadable+post-build-selectable / pre-compile in variant pre-compile, destination=Pdu  # Direct Rx N-Pdu Ref | Reference to the Pdu object representing the N-PDU.
          container J1939TpRxNSdu [1..*]: post-build-changeable=true  # Rx N-Sdu | This container describes the parameters that are relevant for the reception of a specific N-SDU.
            integer J1939TpRxNSduId: 0..65535, scope=ECU, set at pre-compile, symbolic-name-value=true, default-value=0  # Rx N-Sdu ID | This is a unique identifier for a received N-SDU. This Id is used in the CancelReceive and ChangeParameter API call.
            reference J1939TpRxNSduRef: set at post-build in variant post-build-loadable+post-build-selectable / pre-compile in variant pre-compile, destination=Pdu  # Rx N-Sdu Ref | Reference to the Pdu object representing the N-SDU.
        container J1939TpTxFcNPdu [0..1]  # TP.CM FC Tx N-Pdu | This N-PDU represents the TP.CM frame that is used in reverse direction for a J1939 transport protocol session using the CMDT protocol type. TP.CM in reverse direction is used for intermediate and final acknowledgement of received data and to abort the connection. | Please note: This sub container is only required when J1939TpRxProtocolType is J1939TP_PROTOCOL_CMDT or when it is not configured at all.
          integer J1939TpTxFcNPduTxConfId: 0..65535, scope=ECU, set at pre-compile, symbolic-name-value=true, default-value=0  # TP.CM FC Tx N-Pdu ID | The N-PDU identifier used for Tx confirmation from CanIf.
          reference J1939TpTxFcNPduRef: set at post-build in variant post-build-loadable+post-build-selectable / pre-compile in variant pre-compile, destination=Pdu  # TP.CM FC Tx N-Pdu Ref | Reference to the Pdu object representing the N-PDU. | Please note: When two channels have identical but exchanged source and destination addresses, the Pdu referenced by this parameter is shared with J1939TpTxCmNPduRef of the corresponding J1939TpTxChannel.
        container J1939TpEtpRxCmNPdu [0..1]  # ETP.CM Rx N-Pdu | This N-PDU represents the ETP.CM frame of an ISO 11783 extended transport protocol session. ETP.CM is used to initialize and to abort the connection.
          integer J1939TpEtpRxCmNPduId: 0..65535, scope=ECU, set at pre-compile, origin=Vector Informatik, symbolic-name-value=true, default-value=0  # ETP.CM Rx N-Pdu ID | The N-PDU identifier used for communication with CanIf.
          reference J1939TpEtpRxCmNPduRef: set at post-build in variant post-build-loadable+post-build-selectable / pre-compile in variant pre-compile, origin=Vector Informatik, destination=Pdu  # ETP.CM Rx N-Pdu Ref | Reference to the Pdu object representing the N-PDU.
        container J1939TpEtpRxDtNPdu [0..1]  # ETP.DT Rx N-Pdu | This N-PDU represents the ETP.DT frame of an ISO 11783 extended transport protocol session. ETP.DT is used to transfer the contents of an N-SDU.
          integer J1939TpEtpRxDtNPduId: 0..65535, scope=ECU, set at pre-compile, origin=Vector Informatik, symbolic-name-value=true, default-value=0  # ETP.DT Rx N-Pdu ID | The N-PDU identifier used for communication with CanIf.
          reference J1939TpEtpRxDtNPduRef: set at post-build in variant post-build-loadable+post-build-selectable / pre-compile in variant pre-compile, origin=Vector Informatik, destination=Pdu  # ETP.DT Rx N-Pdu Ref | Reference to the Pdu object representing the N-PDU.
        container J1939TpEtpTxFcNPdu [0..1]  # ETP.CM FC Tx N-Pdu | This N-PDU represents the ETP.CM frame that is used in reverse direction for an ISO 11783 extended transport protocol session. ETP.CM in reverse direction is used for intermediate and final acknowledgement of received data and to abort the connection. | Please note: This sub container is only required when J1939TpRxProtocolType is J1939TP_PROTOCOL_CMDT or when it is not configured at all.
          integer J1939TpEtpTxFcNPduTxConfId: 0..65535, scope=ECU, set at pre-compile, origin=Vector Informatik, symbolic-name-value=true, default-value=0  # ETP.CM FC Tx N-Pdu ID | The N-PDU identifier used for Tx confirmation from CanIf.
          reference J1939TpEtpTxFcNPduRef: set at post-build in variant post-build-loadable+post-build-selectable / pre-compile in variant pre-compile, origin=Vector Informatik, destination=Pdu  # ETP.CM FC Tx N-Pdu Ref | Reference to the Pdu object representing the N-PDU. | Please note: When two channels have identical but exchanged source and destination addresses, the Pdu referenced by this parameter is shared with J1939TpTxCmNPduRef of the corresponding J1939TpTxChannel.
      container J1939TpTxChannel [0..*]: post-build-changeable=true  # This container describes a transmission channel of the J1939Tp module. A channel referencing N-PDUs without MetaData is used for all N-SDUs that share the same source address (SA) and the same destination address (BAM: DA = 0xFF, CMDT: DA != 0xFF). A channel with N-PDUs with MetaData is used for all possible source and destination addresses.
        boolean J1939TpTxCancellationSupport [0..1]: set at post-build in variant post-build-loadable+post-build-selectable / pre-compile in variant pre-compile, default-value=false  # Enable transmit cancellation using the API J1939Tp_CancelTransmit() for this channel. Please note: This feature is not yet supported.
        integer J1939TpTxDa [0..1]: 0..253, set at post-build in variant post-build-loadable+post-build-selectable / pre-compile in variant pre-compile, default-value=0  # Tx DA | Destination address (DA) of this channel. This parameter is only required for channels with fixed DA which use N-PDUs with MetaData containing the DA.
        boolean J1939TpTxDynamicBlockCalculation [0..1]: set at post-build in variant post-build-loadable+post-build-selectable / pre-compile in variant pre-compile, default-value=false  # Dynamic Block Calculation | Enable dynamic calculation of "maximum number of packets that can be sent" value in TP.CM_RTS, based on the available amount of data in upper layers reported via PduR_J1939TpCopyTxData. Please note: This feature is not yet supported.
        integer J1939TpTxMaxPacketsPerBlock [0..1]: 1..255, set at post-build in variant post-build-loadable+post-build-selectable / pre-compile in variant pre-compile, default-value=255  # Max Packets Per Block | Maximum number of TP.DT frames the transmitting J1939Tp module is ready to send before waiting for another TP.CM_CTS. This parameter is transmitted in the TP.CM_RTS frame, and is thus only relevant for transmission of messages via CMDT. When J1939TpTxDynamicBlockCalculation is enabled, this parameter specifies a maximum for the calculated value. For further details on this parameter value see SAE J1939/21.
        enumeration J1939TpTxProtocolType [0..1]: set at post-build in variant post-build-loadable+post-build-selectable / pre-compile in variant pre-compile, default-value=J1939TP_PROTOCOL_BAM  # Protocol Type | Protocol type used by this channel. This parameter is only required for channels with fixed destination address.
          J1939TP_PROTOCOL_BAM  # J1939 Broadcast TP (BAM = Broadcast Announce Message)
          J1939TP_PROTOCOL_CMDT  # J1939 Directed TP (aka RTS/CTS, CMDT = Connection Mode Data Transfer)
          J1939TP_PROTOCOL_ETP  # ISO 11783 Extended TP
          J1939TP_PROTOCOL_FPTP  # NMEA2000 FastPacket Protocol
        boolean J1939TpTxRetrySupport [0..1]: set at post-build in variant post-build-loadable+post-build-selectable / pre-compile in variant pre-compile, default-value=false  # Retry Support | Enable support for repetition of failed transmission using TP.CM_CTS with a packet number that has already been sent. Retransmission is handled via the retry feature of PduR_J1939TpCopyTxData. Please note: This feature is not yet supported.
        integer J1939TpTxSa [0..1]: 0..253, set at post-build in variant post-build-loadable+post-build-selectable / pre-compile in variant pre-compile, default-value=0  # Tx SA | Source address (SA) of this channel. This parameter is only required for channels with fixed SA which use N-PDUs with MetaData.
        boolean J1939TpTxIsobusChannel [0..1]: set at pre-compile, origin=Vector Informatik, default-value=false  # ISOBUS Channel | Identifies this channel as an ISOBUS (ISO 11873) channel. If enabled, the abort reasons conform with ISO 11783, otherwise with SAE J1939.
        symbolic name reference J1939TpTxChannelComMNetworkHandleRef: set at post-build in variant post-build-loadable+post-build-selectable / pre-compile in variant pre-compile, origin=Vector Informatik, destination=ComMChannel  # ComM Network Handle Ref | Reference to the channel defined by the ComMChannel providing access to the unique channel index ComMChannelId.
        container J1939TpRxFcNPdu [0..1]  # TP.CM FC Rx N-Pdu | This N-PDU represents the TP.CM frame that is used in reverse direction for a J1939 transport protocol session using the CMDT protocol type. TP.CM in reverse direction is used for intermediate and final acknowledgement of received data and to abort the connection. | Please note: This sub container is only required when J1939TpRxProtocolType is J1939TP_PROTOCOL_CMDT or when it is not configured at all.
          integer J1939TpRxFcNPduId: 0..65535, scope=ECU, set at pre-compile, symbolic-name-value=true, default-value=0  # TP.CM FC Rx N-Pdu ID | The N-PDU identifier used for communication with CanIf.
          reference J1939TpRxFcNPduRef: set at post-build in variant post-build-loadable+post-build-selectable / pre-compile in variant pre-compile, destination=Pdu  # TP.CM FC Rx N-Pdu Ref | Reference to the Pdu object representing the N-PDU. | Please note: When two channels have identical but exchanged source and destination addresses, the Pdu referenced by this parameter is shared with J1939TpRxCmNPduRef of the corresponding J1939TpRxChannel.
        container J1939TpTxCmNPdu [0..1]  # TP.CM Tx N-Pdu | This N-PDU represents the TP.CM frame of a J1939 transport protocol session. TP.CM is used both by BAM and CMDT to initialize the connection. For CMDT, it is also used to abort the connection.
          integer J1939TpTxCmNPduTxConfId: 0..65535, scope=ECU, set at pre-compile, symbolic-name-value=true, default-value=0  # TP.CM Tx N-Pdu ID | The N-PDU identifier used for Tx confirmation from CanIf.
          reference J1939TpTxCmNPduRef: set at post-build in variant post-build-loadable+post-build-selectable / pre-compile in variant pre-compile, destination=Pdu  # TP.CM Tx N-Pdu Ref | Reference to the Pdu object representing the N-PDU.
        container J1939TpTxDtNPdu [0..1]  # TP.DT Tx N-Pdu | This N-PDU represents the TP.DT frame of a J1939 transport protocol session. TP.DT is used both by BAM and CMDT to transfer the contents of an N-SDU.
          integer J1939TpTxDtNPduTxConfId: 0..65535, scope=ECU, set at pre-compile, symbolic-name-value=true, default-value=0  # TP.DT Tx N-Pdu ID | The N-PDU identifier used for Tx confirmation from CanIf.
          reference J1939TpTxDtNPduRef: set at post-build in variant post-build-loadable+post-build-selectable / pre-compile in variant pre-compile, destination=Pdu  # TP.DT Tx N-Pdu Ref | Reference to the Pdu object representing the N-PDU.
        container J1939TpTxPg [1..*]: post-build-changeable=true  # PG | Parameter group transmitted by the J1939 transport layer.
          boolean J1939TpTxPgDynLength: set at post-build in variant post-build-loadable+post-build-selectable / pre-compile in variant pre-compile, default-value=false  # Dyn Length | This flag is set to TRUE when the N-SDU refers to a PG with variable length. | Please note: When this attribute is TRUE, the sub container J1939TpTxDirectNPdu is required.
          integer J1939TpTxPgPGN: 0..262143, set at post-build in variant post-build-loadable+post-build-selectable / pre-compile in variant pre-compile, default-value=0  # PGN | PGN of the referenced N-SDUs.
          container J1939TpTxDirectNPdu [0..1]  # Direct and FastPacket Tx N-Pdu | This N-PDU represents the short frame that is used for a FastPacket message or a dynamic length PG when it has a length of less that 8 bytes. | Please note: This sub container is only necessary when J1939TpTxPgDynLength is TRUE.
            integer J1939TpTxDirectNPduTxConfId: 0..65535, scope=ECU, set at pre-compile, symbolic-name-value=true, default-value=0  # Direct Tx N-Pdu ID | The N-PDU identifier used for Tx confirmation from CanIf.
            reference J1939TpTxDirectNPduRef: set at post-build in variant post-build-loadable+post-build-selectable / pre-compile in variant pre-compile, destination=Pdu  # Direct Tx N-Pdu Ref | Reference to the Pdu object representing the N-PDU.
          container J1939TpTxNSdu [1..*]: post-build-changeable=true  # Tx N-Sdu | This container describes the parameters that are relevant for the transmission of a specific N-SDU.
            integer J1939TpTxNSduId: 0..65535, scope=ECU, set at pre-compile, symbolic-name-value=true, default-value=0  # Tx N-Sdu ID | The N-SDU identifier used for communication with PduR.
            reference J1939TpTxNSduRef: set at post-build in variant post-build-loadable+post-build-selectable / pre-compile in variant pre-compile, destination=Pdu  # Tx N-Sdu Ref | Reference to the Pdu object representing the N-SDU.
        container J1939TpEtpRxFcNPdu [0..1]  # ETP.CM FC Rx N-Pdu | This N-PDU represents the TP.CM frame that is used in reverse direction for a J1939 transport protocol session using the CMDT protocol type. TP.CM in reverse direction is used for intermediate and final acknowledgement of received data and to abort the connection. | Please note: This sub container is only required when J1939TpRxProtocolType is J1939TP_PROTOCOL_CMDT or when it is not configured at all.
          integer J1939TpEtpRxFcNPduId: 0..65535, scope=ECU, set at pre-compile, origin=Vector Informatik, symbolic-name-value=true, default-value=0  # ETP.CM FC Rx N-Pdu ID | The N-PDU identifier used for communication with CanIf.
          reference J1939TpEtpRxFcNPduRef: set at post-build in variant post-build-loadable+post-build-selectable / pre-compile in variant pre-compile, origin=Vector Informatik, destination=Pdu  # ETP.CM FC Rx N-Pdu Ref | Reference to the Pdu object representing the N-PDU. | Please note: When two channels have identical but exchanged source and destination addresses, the Pdu referenced by this parameter is shared with J1939TpRxCmNPduRef of the corresponding J1939TpRxChannel.
        container J1939TpEtpTxCmNPdu [0..1]  # ETP.CM Tx N-Pdu | This N-PDU represents the TP.CM frame of a J1939 transport protocol session. TP.CM is used both by BAM and CMDT to initialize the connection. For CMDT, it is also used to abort the connection.
          integer J1939TpEtpTxCmNPduTxConfId: 0..65535, scope=ECU, set at pre-compile, origin=Vector Informatik, symbolic-name-value=true, default-value=0  # ETP.CM Tx N-Pdu ID | The N-PDU identifier used for Tx confirmation from CanIf.
          reference J1939TpEtpTxCmNPduRef: set at post-build in variant post-build-loadable+post-build-selectable / pre-compile in variant pre-compile, origin=Vector Informatik, destination=Pdu  # ETP.CM Tx N-Pdu Ref | Reference to the Pdu object representing the N-PDU.
        container J1939TpEtpTxDtNPdu [0..1]  # ETP.DT Tx N-Pdu | This N-PDU represents the TP.DT frame of a J1939 transport protocol session. TP.DT is used both by BAM and CMDT to transfer the contents of an N-SDU.
          integer J1939TpEtpTxDtNPduTxConfId: 0..65535, scope=ECU, set at pre-compile, origin=Vector Informatik, symbolic-name-value=true, default-value=0  # ETP.DT Tx N-Pdu ID | The N-PDU identifier used for Tx confirmation from CanIf.
          reference J1939TpEtpTxDtNPduRef: set at post-build in variant post-build-loadable+post-build-selectable / pre-compile in variant pre-compile, origin=Vector Informatik, destination=Pdu  # ETP.DT Tx N-Pdu Ref | Reference to the Pdu object representing the N-PDU.
    container J1939TpGeneral  # General configuration parameters of the J1939Tp module.
      boolean J1939TpCancellationSupport [0..1]: set at pre-compile, default-value=false  # Enables/disables transmit and receive cancellation. Please note: This feature is not yet supported. | The APIs J1939Tp_CancelTransmit() and J1939Tp_CancelReceive() will only be available when this parameter is enabled.
      boolean J1939TpDevErrorDetect: set at pre-compile, default-value=true  # Enables/disables the development error detection. Note: In general, the development error detection is recommended during pre-test phase. It is not recommended to enable the development error detection in production code due to increased runtime and ROM needs.
      boolean J1939TpDynamicBlockCalculation [0..0]: set at pre-compile, default-value=false  # This parameter is deprecated and will be removed in future. | Old description: Enable dynamic calculation of packets per block values in TP.CM_RTS and TP.CM_CTS, based on the size of buffers in upper layers reported via StartOfReception, CopyRxData, and CopyTxData.
      float J1939TpMainFunctionPeriod: 0..0.255, scope=ECU, set at pre-compile, default-value=0.01  # Execution cycle of J1939Tp_MainFunction. | Please note: This configuration value shall be equal to the value in the ScheduleManager module.
      boolean J1939TpRetrySupport [0..0]: set at pre-compile, default-value=false  # This parameter is deprecated and will be removed in future. | Old description: Enable support for repetition of failed transmission via TP.CM_CTS with a packet number that has already been sent. Retransmission is triggered when a sequence number is missing or a timeout occurs during reception. On sender side, retransmission is handled via the retry feature of PduR_J1939TpCopyTxData.
      float J1939TpTxConfTimeout: 0..65.535, set at pre-compile, default-value=1.5  # Time to wait for a confirmation after transmission of a message. After this time, TxConfirmation is not expected to be called for the last transmission, and the message is assumed to have been lost. | Please note: The Tx confirmation timeout should be set to a value that enabled detection of a lost Tx confirmation in time, and that ensures that normal transmission delay caused by lower message priority does not lead to an error.
      boolean J1939TpVersionInfoApi: set at pre-compile, default-value=false  # Version Info API | Enables/disables the function J1939Tp_GetVersionInfo() to get major, minor and patch version information.
      boolean J1939TpSupportBam: set at pre-compile, origin=Vector Informatik, default-value=true  # Support BAM | Enables/disables transmission/reception via SAE J1939 transport protocol broadcast variant (BAM). This setting is only relevant for link-time or post build configurations.
      boolean J1939TpSupportCmdt: set at pre-compile, origin=Vector Informatik, default-value=true  # Support CMDT | Enables/disables transmission/reception via SAE J1939 transport protocol point-to-point variant (CMDT). This setting is only relevant for link-time or post build configurations.
      boolean J1939TpSupportEtp: set at pre-compile, origin=Vector Informatik, default-value=true  # Support ETP | Enables/disables transmission/reception via ISO 11783 extended transport protocol (ETP). This setting is only relevant for link-time or post build configurations.
      boolean J1939TpSupportFptp: set at pre-compile, origin=Vector Informatik, default-value=true  # Support FPTP | Enables/disables transmission/reception via NMEA 2000 fast packet protocol (FPTP). This setting is only relevant for link-time or post build configurations.
      string J1939TpUserConfigurationFile [0..1]: set at pre-compile, origin=Vector Informatik  # Reference to an external user configuration file that will be included during generation. The content of the user configuration file will be added at the end of the generated module configuration file and allows altering or extending the generated code. Caution: User configuration files can cause the software module to malfunction and must only be used with great care!
      boolean J1939TpRuntimeErrorReport: set at pre-compile, origin=Vector Informatik, default-value=true  # Enables/disables the reporting of runtime errors.
  bsw implementation J1939Tp_Impl: programming-language=C, sw-version=1.03.02, used-code-generator=DaVinci Configurator, vendor-id=30, ar-release-version=4.02.02, behavior=J1939TpBehavior, preconfigured-configuration=J1939Tp_Pre, recommended-configuration=J1939Tp_Rec, vendor-specific-module-def=J1939Tp
  module config J1939Tp_Pre: definition=J1939Tp
  module config J1939Tp_Rec: definition=J1939Tp
