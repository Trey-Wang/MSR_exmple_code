AUTOSAR XML (schema 4-0-3)
package /MICROSAR
  module config EcuC_Pre: definition=EcuC
    EcucGeneral
      PostbuildLoadable
