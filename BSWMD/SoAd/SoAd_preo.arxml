AUTOSAR XML (schema 4-0-3)
package /MICROSAR
  module config SoAd_Pre: definition=SoAd
  module config SoAd_Rec: definition=SoAd
