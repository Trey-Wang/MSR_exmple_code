AUTOSAR XML (schema 4-0-3)
package /MICROSAR/Lin_Canoeemu
  module config Lin_Pre: definition=Lin
