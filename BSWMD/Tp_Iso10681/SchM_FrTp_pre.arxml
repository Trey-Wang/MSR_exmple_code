AUTOSAR XML (schema 3.0.1)
package /MICROSAR
  module config SchM_Rec: definition=SchM, implementation-config-variant=VARIANT-PRE-COMPILE  # Configuration of the SchM (BSW Scheduler) module.
    FrTp (SchMModuleConfiguration): SchMModuleLiteral=FrTp, SchMModuleInclude=FrTp.h, SchMModuleConfigVersion=1.1.0, SchMModuleImplementationRef=FrTp_Impl
      SCHM_FRTP_INSTANCE_0 (InstanceConfiguration): SchMInstanceLiteral=SCHM_FRTP_INSTANCE_0
        FRTP_EXCLUSIVE_AREA_0 (ExclusiveAreaConf):
          SchMExclusiveAreaLiteral = FRTP_EXCLUSIVE_AREA_0
          SchMExclusiveAreaDescription = This exclusive should be mapped to a resource that is capable of decoupling the FrTp from FlexRay communication events such as FrTp_RxIndication and FrTp_TxConfirmation, issued by the FrIf. One possibility to do this would be to lock FlexRay communication interrupts.
        FRTP_EXCLUSIVE_AREA_1 (ExclusiveAreaConf):
          SchMExclusiveAreaLiteral = FRTP_EXCLUSIVE_AREA_1
          SchMExclusiveAreaDescription = This exclusive are should be mapped to an OS-Resource. It is used to decouple calls to FrTp_Transmit, FrTp_ChangeParameterRequest and FrTp_ReadParameterRequest.
    FrTp_MainFunction (SchMMainFunctionMapping): SchMMainFunctionSymbol=FrTp_MainFunction, SchMModuleRef=FrTp
      SchMBswEvent
        SchMBswDerivedTimingEvent: SchMMainFunctionPeriodParamScale=1.0, SchMMainFunctionPeriodParamRef=/MICROSAR/FrTp/FrTpGeneral/FrTpMainFuncCycle
