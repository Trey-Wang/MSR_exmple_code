AUTOSAR XML (schema 4-0-3)
package /MICROSAR
  module config IpV4_Pre: definition=IpV4, implementation-config-variant=VARIANT-PRE-COMPILE
  module config IpV4_Rec: definition=IpV4
