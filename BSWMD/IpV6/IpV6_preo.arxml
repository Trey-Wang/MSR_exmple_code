AUTOSAR XML (schema 4-0-3)
package /MICROSAR
  module config IpV6_Pre: definition=IpV6, implementation-config-variant=VARIANT-PRE-COMPILE
  module config IpV6_Rec: definition=IpV6
