AUTOSAR XML (schema 4-0-3)
package /MICROSAR
  module config EthSm_Pre: definition=EthSm, implementation-config-variant=VARIANT-PRE-COMPILE
  module config EthSm_Rec: definition=EthSm
