AUTOSAR XML (schema 4-0-3)
package /MICROSAR
  module definition EthSM [0..1]: category=VENDOR_SPECIFIC_MODULE_DEFINITION, refined-module-def=EthSM, variants pre-compile  # Configuration of the Ethernet State Manager
    container EthSMGeneral  # General configuration parameters of the EthSM.
      boolean EthSMDevErrorDetect: set at pre-compile, default-value=false  # Enable Development Error Detection | This parameter switches the Development Error Detection and Notification ON or OFF. true: Development error detection is enabled. false: Development error detection is disabled.
      boolean EthSMDummyMode: set at pre-compile, default-value=false  # Enable Dummy Mode | This parameter defines the handling of the underlying modules. If the parameter is enabled EthSM will not call the APIs of EthIf to control the Ethernet controller and Ethernet Transceiver neither the API of TcpIp to request a TcpIp mode. The APIs to be used by the ComM are avaible but state changes of the underlying modules are not possible.
      float EthSMMainFunctionPeriod: 0.005..1, set at pre-compile, default-value=0.02  # Main Function Period | This value specifies the period that the Main Function of the EthSM has to be triggered with.
      boolean EthSMVersionInfoApi: set at pre-compile, default-value=false  # Enable Version Info API | This parameter enables/disables the function EthSM_GetVersionInfo() to get major, minor and patch version information.
      string EthSMUserConfigFile [0..1]: set at pre-compile, origin=Vector Informatik  # User Config File | Reference to an external file that will be included during generation to EthSM_Cfg.h. The content of the user configuration file will be added at the end of the generated module configuration file and allows altering or extending the generated code. Caution: User configuration files can cause the software module to malfunction and must only be used with greate care!
      boolean EthSMEnableEthIfApiTimeout: set at pre-compile, origin=Vector Informatik, default-value=false  # Enable EthIf API Timeout | This parameter defines if a error handling for possibly unsuccessful calls to the EthIf APIs is actived. false: The error handling is disabled and the EthSM will call EthIf APIs endlessly every main function cycle until they return successfully. true: The error handling is enabled and the EthSM will call the EthIf APIs with a time gap specified by 'EthSMConfirmationTimeout' and as often as specified by 'EthSMMaxNumRetry'. (Both configurable Ethernet network-specific) Error handling of unsuccessful calls will be as followed: DET: (only enabled if 'EthSMDevErrorDetect' is enabled) EthSM will report the error ETHSM_E_ETHIF_TIMEOUT to DET by calling Det_ReportError. DEM: (only enabled if Ethernet network-specific DEM event 'ETHSM_E_TIMEOUT' is configured) EthSM will report the error with the specific DEM event ID by calling Dem_ReportErrorStatus.
      boolean EthSMEnableOooIndications: set at pre-compile, origin=Vector Informatik, default-value=false  # Enable Out Of Order Indications | This parameter defines if indications from EthIf and TcpIp can be handled out of order. false: The indications of EthIf and TcpIp must occur in the order they are specified in the state machine of the AUTOSAR 4.1.1 SWS (Figure 7-1) (dead locks of state machine possible if e.g. EthSM_TcpModeIndication is called before EthSM_TrcvLinkStateChange in a FULL_COM request scenario) true: The indications of EthIf and TcpIp can be handled if they occur out of order. The EthSM will recall the inidcated state of the out of order indication and procced with the sequence for the mode request as if the indications occured in order.
    container EthSMNetwork [1..*]  # This container contains the Ethernet network-specific parameters of each Ethernet network.
      float EthSMConfirmationTimeout: 0.001..10, set at pre-compile, default-value=0.1  # EthIf API Confirmation Timeout | This value specifes the time gap between the retries of the calls to EthIf: -EthIf_ControllerInit -EthIf_TransceiverInit -EthIf_SetControllerMode -EthIf_SetTransceiverMode For further information of EthIf API timeout handling please refere to the description of 'EthSMEnableEthIfApiTimeout'. | EthIf_ControllerInit EthIf_TransceiverInit EthIf_SetControllerMode EthIf_SetTransceiverMode
      integer EthSMMaxNumRetry: 0..10, set at pre-compile, origin=Vector Informatik, default-value=0  # Max Number of EthIf API Retries | This value specifies the maximum number of retries for EthIf API calls. One try to call the EthIf API successfully is done without taking the specified value into account. For further information of EthIf API timeout handling please refere to the description of 'EthSMEnableEthIfApiTimeout'.
      enumeration EthSMStackType: {TcpIp, Avb}, set at pre-compile, origin=Vector Informatik, default-value=TcpIp  # Stack Type | Parameter defines the communication stack using this Ethernet network. TcpIp: The Ethernet network is used by a TcpIp communication stack. The two-stage communication request for this network specified by AUTOSAR will be used. The EthIf APIs are used to change activate/deactivate the Ethernet controller and transceiver and the TcpIp API is used to change the TcpIp mode. Also the EthSM relies on the indications of the transceiver link and the TcpIp mode for state handling. Avb: The Ethernet network is used by a Avb communication stack. The two-stage communication request for this network specified by AUTOSAR will be tailored into a one-stage request. The EthIf APIs are used to change activate/deactivate the Ethernet controller and transceiver. The TcpIp APIs aren't used anymore. Also the EthSM only relies on the indications of the transceiver link for state handling.
      symbolic name reference EthSMComMNetworkHandleRef: set at pre-compile, destination=ComMChannel  # ComM Network | Reference to a ComM channel representing this Ethernet network in ComM configuration.
      symbolic name reference EthSMEthIfControllerRef: set at pre-compile, destination=EthIfController  # EthIf Controller | Reference to a EthIfController which abstracts the underlying Ethernet controller and transceiver to be controlled. | transceiver (optional) combination is configured.
      container EthSMDemEventParameterRefs [0..1]  # This container includes the references to DemEventParameter elements which shall be invoked using the API Dem_ReportErrorStatus API in case the corresponding error occurs. The EventId is taken from the referenced DemEventParameter's DemEventId value.
        symbolic name reference ETHSM_E_LINK_DOWN [0..1]: set at pre-compile, destination=DemEventParameter  # Reference to configured DEM event to report bus off errors for this Ethernet network. The event will be reported in two situations: 1) Ethernet network is in STATE_ONLINE and loses transceiver link The event will be reported to the DEM by calling Dem_ReportErrorStatus with the status DEM_EVENT_STATUS_FAILED. 2) Ethernet network is in STATE_ONHOLD and gains transceiver link The event will be reported to the DEM by calling Dem_ReportErrorStatus with the status DEM_EVENT_STATUS_PASSED.
        symbolic name reference ETHSM_E_TIMEOUT [0..1]: set at pre-compile, origin=Vector Informatik, destination=DemEventParameter  # Reference to configured DEM event to report a timeout of EthIf API calls. The event will be reported to the DEM if the EthIf API error handling is processed by calling Dem_ReportErrorStatus with the status DEM_EVENT_STATUS_FAILED.
  bsw implementation EthSM_Impl: programming-language=C, sw-version=3.01.03, used-code-generator=DaVinci Configurator, vendor-id=30, ar-release-version=4.01.01, behavior=EthSMBehavior, preconfigured-configuration=EthSM_Pre, recommended-configuration=EthSM_Rec, vendor-specific-module-def=EthSM
  module config EthSM_Pre: definition=EthSM
  module config EthSM_Rec: definition=EthSM
