AUTOSAR XML (schema 4-2-1)
package /MICROSAR
  bsw implementation Rtp_Impl: programming-language=C, sw-version=1.01.00, used-code-generator=DaVinci Configurator, vendor-id=30, ar-release-version=4.02.01, behavior=RtpBehavior, recommended-configuration=Rtp_Rec, vendor-specific-module-def=Rtp
  module definition Rtp [0..1]: category=VENDOR_SPECIFIC_MODULE_DEFINITION, variants pre-compile  # Realtime Transport Protocol | Configuration of the Realtime Transport Protocol module.
    container RtpConfig  # This container contains the configuration parameters and sub containers of the Realtime Transport Protocol (Rtp) module.
      container RtpStream [1..*]  # This container specifies all stream-dependent parameters.
        enumeration RtpStreamType: origin=Vector Informatik  # Payload type of the configured stream.
          Ch{1..6}_16  # {1..6} Channel, 16 Bit
          Ch6_24  # 6 Channel, 24 Bit
          Ch8_24  # 8 Channel, 24 Bit
          MPEG_TS  # MPEG Transport Stream
        integer RtpStreamId: 0..18446744073709551615, origin=Vector Informatik, default-value=0  # IEEE 802.1Q stream identifier.
        integer RtpFramePriority: 0..7, origin=Vector Informatik, default-value=0  # Specifies the priority of the Ethernet frame.
        integer RtpStreamHandleId: 0..65535, origin=Vector Informatik, symbolic-name-value=true, default-value=0  # HandleId which has to be used by the upper layer in order to identify a stream.
        reference RtpUpperLayerRef [0..1]: origin=Vector Informatik, destination=RtpUpperLayer  # Reference to the upper layer configuration.
        reference RtpTimeDomainRef: origin=Vector Informatik, destination=RtpTimeDomain  # Reference to the time domain configuration.
        choice container RtpTransmissionType  # Specifies the transmission type of the stream.
          container RtpTxStream [0..1]  # Configuration of transmitted stream.
            float RtpRtcpCycleTime: 0.0001..1, origin=Vector Informatik, default-value=0.125  # Transmission cycle of RTCP messages.
            string RtpStreamName: origin=Vector Informatik, max-length=4, min-length=4  # Name to identify set of RTCP packets.
            string RtpCName: origin=Vector Informatik, max-length=255, min-length=1  # CNAME of the stream which is transmitted in RTCP SDES packets.
            boolean RtpCopyTxDataCalloutEnabled: origin=Vector Informatik, default-value=true  # If enabled, the upper layer will receive a callback in order to copy its payload to the Ethernet buffer.
            container RtpTxPdu  # PDU used for transmission of RTP messages.
              integer RtpTxPduId: 0..65535, origin=Vector Informatik, symbolic-name-value=true, default-value=0  # ID of the PDU that will be transmitted via the API Rtp_SoAdTriggerTransmit().
              reference RtpTxPduRef: origin=Vector Informatik, destination=Pdu  # Reference to the "global" Pdu structure to allow harmonization of handle IDs in the COM-Stack.
            container RtpRtcpTxPdu  # PDU used for transmission of RTCP messages.
              integer RtpRtcpTxPduId: 0..65535, origin=Vector Informatik, symbolic-name-value=true, default-value=0  # ID of the PDU that will be transmitted via the API Rtp_SoAdTriggerTransmit().
              reference RtpRtcpTxPduRef: origin=Vector Informatik, destination=Pdu  # Reference to the "global" Pdu structure to allow harmonization of handle IDs in the COM-Stack.
          container RtpRxStream [0..1]  # Configuration of received stream.
            boolean RtpSdesInformationCalloutEnabled: origin=Vector Informatik, default-value=true  # If enabled, the upper layer will receive callbacks if SDES packets are received.
            container RtpRxPdu  # PDU used for reception of RTP messages.
              integer RtpRxPduId: 0..65535, origin=Vector Informatik, symbolic-name-value=true, default-value=1  # ID of the PDU that will be received via the API Rtp_SoAdRxIndication().
              reference RtpRxPduRef: origin=Vector Informatik, destination=Pdu  # Reference to the "global" Pdu structure to allow harmonization of handle IDs in the COM-Stack.
            container RtpRtcpRxPdu  # PDU used for reception of RTCP messages.
              integer RtpRtcpRxPduId: 0..65535, origin=Vector Informatik, symbolic-name-value=true, default-value=1  # ID of the PDU that will be received via the API Rtp_SoAdRxIndication().
              reference RtpRtcpRxPduRef: origin=Vector Informatik, destination=Pdu  # Reference to the "global" Pdu structure to allow harmonization of handle IDs in the COM-Stack.
      container RtpUpperLayer [0..*]  # Configuration of UpperLayer parameters.
        linker symbol RtpUpperLayerName: origin=Vector Informatik, default-value=RtpUpperLayer, min-length=1  # UpperLayer Name which will be used to prefix callouts.
      container RtpTimeDomain [1..*]  # Configuration of time domain parameters.
        string RtpGmPhysAddr: origin=Vector Informatik  # Physical address of the time domain.
        integer RtpGmPortNumber: 0..65535, origin=Vector Informatik  # Port of the time domain.
        reference RtpGlobalTimeDomainRef [0..1]: origin=Vector Informatik, destination=EthTSynGlobalTimeDomain  # Reference to the configured EthTSyn global time domain.
    container RtpGeneral  # This container lists the general configuration parameters for the RTP module.
      string RtpRandomNumberFunctionIncludeFile [0..1]: origin=Vector Informatik, default-value=Appl_Rand.h  # This parameter defines the header file holding the declaration of the random number generation function defined in 'RtpRandomNumberFunction'.
      string RtpRandomNumberFunction [0..1]: origin=Vector Informatik, default-value=Appl_Crypto_GetRandNo  # This parameter defines the function called for the random number generation. API description: void <FunctionName>(uint8* DataPtr, uint16 Length)
      string RtpUserConfigFile [0..1]: origin=Vector Informatik, default-value=X:\xyz\Rtp_UserConfig.txt  # Reference to an external user configuration file that will be included during generation. The content of the user configuration file will be added at the end of the generated module configuration file and allows altering or extending the generated code. Caution: User configuration files can cause the software module to malfunction and must only be used with great care!
      float RtpMainFunctionCycleTime: 0.0001..1, origin=Vector Informatik, default-value=0.005  # Determines the frequency at which the Rtp_MainFunction() is called.
      boolean RtpDevErrorDetect: origin=Vector Informatik, default-value=true  # Enables and disables the development error detection and notification mechanism.
      boolean RtpVersionInfoApi: origin=Vector Informatik, default-value=false  # Enables and disables the version info API.
      boolean RtpSafeBswChecks: origin=Vector Informatik, set at pre-compile, default-value=false  # Selects if safety checks are used. These checks improve robustness as e.g. invalid parameters are checked before function is executed. This attribute has to be enabled for safety projects where this component is mapped to an ASIL partition.
      container RtpGeneration  # Contains the generation configuration parameters of the module Rtp.
        enumeration RtpOutOfBoundsWriteProtectionStrategy: origin=Vector Informatik, set at pre-compile, default-value=NONE  # This parameter is used to configure a strategy to protect the code to write out of bounds. NONE: no protection strategy is generated in the data access. INDEX_SATURATION: arrays are blown up and the data access index is saturated by an appropriate mask. The advantage is the speed of the data access, but own data elements at other indexes of the same variable can be overridden. INDEX_CHECKING: the data access index is validated by a runtime check. The advantage is that values are never written to incorrect indexes of the data access.
          NONE  # none
          INDEX_SATURATION  # index saturation
          INDEX_CHECKING  # index checking
        boolean RtpOutOfBoundsWriteSanitizer: origin=Vector Informatik, set at pre-compile, default-value=false  # This parameter activates/deactivates the generation of runtime checks which call a DET error notification function to find easily out of bounds write problems. FALSE: no checks are generated in the data access. TRUE: the data access is enriched with DET checks to validate indexes.
        boolean RtpOutOfBoundsReadSanitizer: origin=Vector Informatik, set at pre-compile, default-value=false  # This parameter activates/deactivates the generation of runtime checks which call a DET error notification function to find easily out of bounds read problems. FALSE: no checks are generated in the data access. TRUE: the data access is enriched with DET checks to validate indexes.
        enumeration RtpNumericalDataTypeMinimizationStrategy: origin=Vector Informatik, set at pre-compile, default-value=MINIMIZE_NUMERICAL_DATA_TYPES_WITH_CAST  # This parameter is used to minimize the datatypes of CONFIG-CLASS PRE-COMPILE numerical data based on the used values. NONE: the datatype is not minimized. MINIMIZE_NUMERICAL_DATA_TYPES_WITHOUT_CAST: the datatype of numerical data is minimized. Unsigned data types are not changed to signed datatypes. MINIMIZE_NUMERICAL_DATA_TYPES_WITH_CAST: the datatype of numerical data is minimized. Unsigned data types can be optimized to signed datatypes.
          NONE  # none
          MINIMIZE_NUMERICAL_DATA_TYPES_WITHOUT_CAST  # minimize numerical data types without cast
          MINIMIZE_NUMERICAL_DATA_TYPES_WITH_CAST  # minimize numerical data types with cast
        boolean RtpReduceConstantData2Define: origin=Vector Informatik, set at pre-compile, default-value=false  # Reduce Constant Data To a Define | This parameter activates/deactivates the capability to generate CONFIG-CLASS PRE-COMPILE ROM arrays as constant define. FALSE: ROM arrays are generated as data even if all values are identical. TRUE: ROM arrays are generated as constant define if all values are identical.
        enumeration RtpBoolDataInArrayOfStructStrategy: origin=Vector Informatik, set at pre-compile, default-value=BITMASKING  # This parameter is used to tailor the usage of boolean data in structures in all CONFIG-CLASSES ROM data. The difference between BITFIELD and BITMASKING depends on your compiler options and memory mapping. BOOLEAN: the datatype of boolean data is native boolean. BITFIELD: the bitfield type is used and the compiler extracts the boolean data from structures. BITMASKING: generated masks are used to extract the boolean data from structures.
          BOOLEAN  # boolean
          BITFIELD  # bitfield
          BITMASKING  # bitmasking
        boolean RtpDeduplicateIndirectedData: origin=Vector Informatik, set at pre-compile, default-value=true  # This parameter activates/deactivates the capability to compress 0:N relational ROM data in all CONFIG-CLASSES without increasing the runtime. FALSE: 0:N relational ROM data is not compressed. TRUE: 0:N relational ROM data is compressed without increasing the runtime.
        enumeration RtpDataDeduplicationStrategy: origin=Vector Informatik, set at pre-compile, default-value=DEDUPLICATE_CONST_DATA_WITH_CAST  # This parameter is used to taylor the the deduplication of CONFIG-CLASS PRE-COMPILE ROM data. NONE: The generated data is not deduplicated. DEDUPLICATE_CONST_DATA_WITHOUT_CAST: The data is deduplicated without using casts. DEDUPLICATE_CONST_DATA_WITH_CAST: The data is deduplicated using casts.
          NONE  # none
          DEDUPLICATE_CONST_DATA_WITHOUT_CAST  # deduplicate const data without cast
          DEDUPLICATE_CONST_DATA_WITH_CAST  # deduplicate const data with cast
        integer RtpReduceBoolDataByNegationThreshold: 0..9223372036854775807, origin=Vector Informatik, set at pre-compile, default-value=2  # This parameter activates/deactivates the capability to compress boolean CONFIG-CLASS PRE-COMPILE ROM data by using the negation operator. 0: The optimization is deactivated. >0: If the number of deduplicateable elements is greater than this threshold the data optimization can be performed.
        integer RtpReduceBoolDataByNumericalComparisonThreshold: 0..9223372036854775807, origin=Vector Informatik, set at pre-compile, default-value=2  # This parameter activates/deactivates the capability to compress boolean CONFIG-CLASS PRE-COMPILE ROM data by using numerical comparison with other ROM data. 0: The optimization is deactivated. >0: If the number of deduplicateable elements is greater than this threshold the data optimization can be performed.
        integer RtpReduceBoolDataByNumericalRelationThreshold: 0..9223372036854775807, origin=Vector Informatik, set at pre-compile, default-value=2  # This parameter activates/deactivates the capability to compress boolean CONFIG-CLASS PRE-COMPILE ROM data by using relational comparison with other ROM data. 0: The optimization is deactivated. >0: If the number of deduplicateable elements is greater than this threshold the data optimization can be performed.
        enumeration RtpReduceBoolDataByNumericalOperandStrategy: origin=Vector Informatik, set at pre-compile, default-value=DEDUPLICATE_DATA_WITH_ANY_VALUE  # This parameter is used to taylor the CONFIG-CLASS PRE-COMPILE ROM bool data with number deduplication mechanisms. A comparison with 0 is very efficient, but a numerical comparison with a value not 0 can be used to increase the ROM data compression rate. NONE: ROM data deduplications are switched off. DEDUPLICATE_DATA_WITH_ZERO: ROM data deduplications can be applied with the value 0. DEDUPLICATE_DATA_WITH_ANY_VALUE: ROM data deduplications can be applied with any numerical value.
          NONE  # none
          DEDUPLICATE_DATA_WITH_ZERO  # deduplicate data with zero
          DEDUPLICATE_DATA_WITH_ANY_VALUE  # deduplicate data with any value
        integer RtpReduceNumericalDataByOffsetThreshold: 0..9223372036854775807, origin=Vector Informatik, set at pre-compile, default-value=2  # This parameter activates/deactivates the capability to compress numerical CONFIG-CLASS PRE-COMPILE ROM data by using a constant offset. 0: The optimization is deactivated. >0: If the number of deduplicateable elements is greater than this threshold the data optimization can be performed.
        integer RtpReduceNumericalDataByArraySubtractionThreshold: 0..9223372036854775807, origin=Vector Informatik, set at pre-compile, default-value=2  # This parameter activates/deactivates the capability to compress numerical CONFIG-CLASS PRE-COMPILE ROM data by using a subtraction with other ROM data. 0: The optimization is deactivated. >0: If the number of deduplicateable elements is greater than this threshold the data optimization can be performed.
        boolean RtpReduceDataByStreaming: origin=Vector Informatik, set at pre-compile, default-value=false  # This parameter activates/deactivates the capability to pack generated CONFIG-CLASS PRE-COMPILE ROM data into a data type dependent stream. FALSE: generated const data is not packed into a data type dependent stream. TRUE: generated const data is packed into a data type dependent stream.
        boolean RtpShortSymbols: origin=Vector Informatik, set at pre-compile, default-value=false  # This parameter activates/deactivates the capability to generate shortened symbol names. FALSE: symbol names are generated in a human readable style based on the MIP, tags and variant names. TRUE: symbol names are generated based on the MIP and a CRC32.
        boolean RtpInterfacesForDeactivatedData: origin=Vector Informatik, set at pre-compile, default-value=false  # This parameter activates/deactivates the capability to generate bsw data interfaces for deactivated data elements. This is an advantage for the BSW developer to reduce the time to market with a development environment using auto completition and to investigate potential interfaces. FALSE: data interfaces are not generated if the data elementis deactivated. TRUE: data interfaces are generated as e.g. emty macros.
        boolean RtpReferringKeysInComments: origin=Vector Informatik, set at pre-compile, default-value=false  # This parameter activates/deactivates the capability to generate referring keys in comments. This is an advantage for the developer to investigate indirections, but this feature reduces the overall readability of the generated data. FALSE: referring keys are not generated in comments. TRUE: referring keys are generated in comments.
