AUTOSAR XML (schema 4-2-1)
package /MICROSAR
  module config Rtp_Rec: definition=Rtp
    RtpGeneral: RtpSafeBswChecks=1
