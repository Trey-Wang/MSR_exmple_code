AUTOSAR XML (schema 4-2-1)
package /COM/VECTOR/CFG/WORKFLOW/SYSDESC/SYNC
  flat map FLATMAP
    17 x flat instance descriptor:
      CpSaDoorFrontLeft: upstream-reference=EcuSwComposition.CpCoApplication.CpSaDoorFrontLeft, ecu-extract-reference=COMPOSITIONTYPE.CpSaDoorFrontLeft
      CpSaInteriorLightFront: upstream-reference=EcuSwComposition.CpCoApplication.CpSaInteriorLightFront, ecu-extract-reference=COMPOSITIONTYPE.CpSaInteriorLightFront
      CpApMySwc: upstream-reference=EcuSwComposition.CpCoApplication.CpApMySwc, ecu-extract-reference=COMPOSITIONTYPE.CpApMySwc
      CpSaDoorFrontRight: upstream-reference=EcuSwComposition.CpCoApplication.CpSaDoorFrontRight, ecu-extract-reference=COMPOSITIONTYPE.CpSaDoorFrontRight
      CpCddIoHwAb: upstream-reference=EcuSwComposition.CpCoApplication.CpCddIoHwAb, ecu-extract-reference=COMPOSITIONTYPE.CpCddIoHwAb
      sig_State_RearLeftDoor: upstream-reference=EcuSwComposition.PpDoorStateRearLeft.DeDoorState, ecu-extract-reference=COMPOSITIONTYPE.PpDoorStateRearLeft.DeDoorState
      PpDoorStateRearLeft: upstream-reference=EcuSwComposition.PpDoorStateRearLeft, ecu-extract-reference=COMPOSITIONTYPE.PpDoorStateRearLeft
      sig_State_RearRightDoor: upstream-reference=EcuSwComposition.PpDoorStateRearRight.DeDoorState, ecu-extract-reference=COMPOSITIONTYPE.PpDoorStateRearRight.DeDoorState
      PpDoorStateRearRight: upstream-reference=EcuSwComposition.PpDoorStateRearRight, ecu-extract-reference=COMPOSITIONTYPE.PpDoorStateRearRight
      sig_RearInteriorLight: upstream-reference=EcuSwComposition.PpLightStateRear.DeLightState, ecu-extract-reference=COMPOSITIONTYPE.PpLightStateRear.DeLightState
      PpLightStateRear: upstream-reference=EcuSwComposition.PpLightStateRear, ecu-extract-reference=COMPOSITIONTYPE.PpLightStateRear
      CpSaDisplay: upstream-reference=EcuSwComposition.CpCoApplication.CpSaDisplay, ecu-extract-reference=COMPOSITIONTYPE.CpSaDisplay
      CpApMySwcSnNvMPimLightOnOffCounter: upstream-reference=COMPOSITIONTYPE.CpApMySwc.SnNvMPimLightOnOffCounter
      CpApMySwcPpNvMNotifyJobFinishedOdometerCtApMySwcNvM_NvM_RpNotifyJobEnd_CpApMySwcSnNvMPimOdometer: upstream-reference=COMPOSITIONTYPE.CpApMySwc.SnNvMPimOdometer, ecu-extract-reference=CpApMySwcPpNvMNotifyJobFinishedOdometerCtApMySwcNvM_NvM_RpNotifyJobEnd_CpApMySwcSnNvMPimOdometer
      CpApMySwcSnNvMPimOdometer: upstream-reference=COMPOSITIONTYPE.CpApMySwc.SnNvMPimOdometer
      CpApMySwcPpNvMLightOnOffCtApMySwcNvM_PS_CpApMySwcSnNvMPimLightOnOffCounter: upstream-reference=COMPOSITIONTYPE.CpApMySwc.SnNvMPimLightOnOffCounter, ecu-extract-reference=CpApMySwcPpNvMLightOnOffCtApMySwcNvM_PS_CpApMySwcSnNvMPimLightOnOffCounter
      CpApMySwcPpNvMOdometerCtApMySwcNvM_PS_CpApMySwcSnNvMPimOdometer: upstream-reference=COMPOSITIONTYPE.CpApMySwc.SnNvMPimOdometer, ecu-extract-reference=CpApMySwcPpNvMOdometerCtApMySwcNvM_PS_CpApMySwcSnNvMPimOdometer
