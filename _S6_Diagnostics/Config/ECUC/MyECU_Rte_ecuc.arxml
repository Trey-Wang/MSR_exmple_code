AUTOSAR XML (schema 4-2-1)
package /ActiveEcuC
  module config Rte: implementation-config-variant=VARIANT-PRE-COMPILE, module-description=Rte_Impl
    RteInitializationBehavior: RteInitializationStrategy=RTE_INITIALIZATION_STRATEGY_AT_DATA_DECLARATION, RteSectionInitializationPolicy=INIT
    RteGeneration:
      RteGenerationMode = COMPATIBILITY_MODE
      RteIocInteractionReturnValue = RTE_IOC
      RteValueRangeCheckEnabled = false
      RteCalibrationSupport = NONE
      RteCodeVendorId = 30
      RteDevErrorDetect = true
      RteDevErrorDetectUninit = false
      RteMeasurementSupport = false
      RteOptimizationMode = MEMORY
      RteVfbTraceEnabled = false
      RteVttVfbTraceFunction = Rte_Vtt_Task_WaitEventRet
    RteBswGeneral: RteSchMVersionInfoApi=false, RteUseComShadowSignalApi=false
    RteOsInteraction
      5 x RteUsedOsActivation, all with RteExpectedActivationOffset=0, RteExpectedTickDuration=0:
        Rte_Al_TE2_SchM_Task_0_10ms: RteActivationOsAlarmRef=Rte_Al_TE2_SchM_Task_0_10ms, RteActivationOsTaskRef=SchM_Task
        Rte_Al_TE2_SchM_Task_0_20ms: RteActivationOsAlarmRef=Rte_Al_TE2_SchM_Task_0_20ms, RteActivationOsTaskRef=SchM_Task
        Rte_Al_TE_IO_Task_0_200ms: RteActivationOsAlarmRef=Rte_Al_TE_IO_Task_0_200ms, RteActivationOsTaskRef=IO_Task
        Rte_Al_TE_CpApMySwc_RCtApMySwcCode: RteActivationOsAlarmRef=Rte_Al_TE_CpApMySwc_RCtApMySwcCode, RteActivationOsTaskRef=My_Task
        Rte_Al_TE2_SchM_Task_0_5ms: RteActivationOsAlarmRef=Rte_Al_TE2_SchM_Task_0_5ms, RteActivationOsTaskRef=SchM_Task
    12 x RteBswModuleInstance:
      BswM: RteBswImplementationRef=BswM_Impl, RteBswModuleConfigurationRef=BswM
        BswM_MainFunctionTimingEvent0 (RteBswEventToTaskMapping):
          RteBswImmediateRestart = false
          RteBswPositionInTask = 9
          RteBswEventRef = BswM_MainFunctionTimingEvent0
          RteBswMappedToTaskRef = SchM_Task
          RteBswUsedOsEventRef = Rte_Ev_Cyclic2_SchM_Task_0_10ms
          RteBswUsedOsAlarmRef = Rte_Al_TE2_SchM_Task_0_10ms
        BSWM_EXCLUSIVE_AREA_0 (RteBswExclusiveAreaImpl): RteExclusiveAreaImplMechanism=ALL_INTERRUPT_BLOCKING, RteBswExclusiveAreaRef=BSWM_EXCLUSIVE_AREA_0
      Can: RteBswImplementationRef=Can_Impl, RteBswModuleConfigurationRef=Can
        3 x RteBswEventToTaskMapping, all with RteBswImmediateRestart=false, RteBswMappedToTaskRef=SchM_Task, RteBswUsedOsEventRef=Rte_Ev_Cyclic2_SchM_Task_0_10ms, RteBswUsedOsAlarmRef=Rte_Al_TE2_SchM_Task_0_10ms:
          Can_MainFunction_BusOffTimingEvent0: RteBswPositionInTask=3, RteBswEventRef=Can_MainFunction_BusOffTimingEvent0
          Can_MainFunction_WakeupTimingEvent0: RteBswPositionInTask=5, RteBswEventRef=Can_MainFunction_WakeupTimingEvent0
          Can_MainFunction_ModeTimingEvent0: RteBswPositionInTask=4, RteBswEventRef=Can_MainFunction_ModeTimingEvent0
        7 x RteBswExclusiveAreaImpl, all with RteExclusiveAreaImplMechanism=ALL_INTERRUPT_BLOCKING:
          CAN_EXCLUSIVE_AREA_{0..6}: RteBswExclusiveAreaRef=CAN_EXCLUSIVE_AREA_{0..6}
      CanIf: RteBswImplementationRef=CanIf_Impl, RteBswModuleConfigurationRef=CanIf
        8 x RteBswExclusiveAreaImpl, all with RteExclusiveAreaImplMechanism=ALL_INTERRUPT_BLOCKING:
          CANIF_EXCLUSIVE_AREA_{0..7}: RteBswExclusiveAreaRef=CANIF_EXCLUSIVE_AREA_{0..7}
      CanNm: RteBswImplementationRef=CanNm_Impl, RteBswModuleConfigurationRef=CanNm
        CanNm_MainFunctionTimingEvent0 (RteBswEventToTaskMapping):
          RteBswImmediateRestart = false
          RteBswPositionInTask = 6
          RteBswEventRef = CanNm_MainFunctionTimingEvent0
          RteBswMappedToTaskRef = SchM_Task
          RteBswUsedOsEventRef = Rte_Ev_Cyclic2_SchM_Task_0_10ms
          RteBswUsedOsAlarmRef = Rte_Al_TE2_SchM_Task_0_10ms
        6 x RteBswExclusiveAreaImpl, all with RteExclusiveAreaImplMechanism=ALL_INTERRUPT_BLOCKING:
          CANNM_EXCLUSIVE_AREA_{0..5}: RteBswExclusiveAreaRef=CANNM_EXCLUSIVE_AREA_{0..5}
      CanSM: RteBswImplementationRef=CanSM_Impl, RteBswModuleConfigurationRef=CanSM
        CanSM_MainFunctionTimingEvent0 (RteBswEventToTaskMapping):
          RteBswImmediateRestart = false
          RteBswPositionInTask = 7
          RteBswEventRef = CanSM_MainFunctionTimingEvent0
          RteBswMappedToTaskRef = SchM_Task
          RteBswUsedOsEventRef = Rte_Ev_Cyclic2_SchM_Task_0_10ms
          RteBswUsedOsAlarmRef = Rte_Al_TE2_SchM_Task_0_10ms
        5 x RteBswExclusiveAreaImpl, all with RteExclusiveAreaImplMechanism=ALL_INTERRUPT_BLOCKING:
          CANSM_EXCLUSIVE_AREA_{1..5}: RteBswExclusiveAreaRef=CANSM_EXCLUSIVE_AREA_{1..5}
      Com: RteBswImplementationRef=Com_Impl, RteBswModuleConfigurationRef=Com
        Com_MainFunctionTxTimingEvent0 (RteBswEventToTaskMapping):
          RteBswImmediateRestart = false
          RteBswPositionInTask = 10
          RteBswEventRef = Com_MainFunctionTxTimingEvent0
          RteBswMappedToTaskRef = SchM_Task
          RteBswUsedOsEventRef = Rte_Ev_Cyclic2_SchM_Task_0_10ms
          RteBswUsedOsAlarmRef = Rte_Al_TE2_SchM_Task_0_10ms
        Com_MainFunctionRxTimingEvent0 (RteBswEventToTaskMapping):
          RteBswImmediateRestart = false
          RteBswPositionInTask = 8
          RteBswEventRef = Com_MainFunctionRxTimingEvent0
          RteBswMappedToTaskRef = SchM_Task
          RteBswUsedOsEventRef = Rte_Ev_Cyclic2_SchM_Task_0_10ms
          RteBswUsedOsAlarmRef = Rte_Al_TE2_SchM_Task_0_10ms
        3 x RteBswExclusiveAreaImpl, all with RteExclusiveAreaImplMechanism=ALL_INTERRUPT_BLOCKING:
          COM_EXCLUSIVE_AREA_TX: RteBswExclusiveAreaRef=COM_EXCLUSIVE_AREA_TX
          COM_EXCLUSIVE_AREA_RX: RteBswExclusiveAreaRef=COM_EXCLUSIVE_AREA_RX
          COM_EXCLUSIVE_AREA_BOTH: RteBswExclusiveAreaRef=COM_EXCLUSIVE_AREA_BOTH
      ComM: RteBswImplementationRef=ComM_Impl, RteBswModuleConfigurationRef=ComM
        ComM_MainFunction_0TimingEvent0 (RteBswEventToTaskMapping):
          RteBswImmediateRestart = false
          RteBswPositionInTask = 11
          RteBswEventRef = ComM_MainFunction_0TimingEvent0
          RteBswMappedToTaskRef = SchM_Task
          RteBswUsedOsEventRef = Rte_Ev_Cyclic2_SchM_Task_0_20ms
          RteBswUsedOsAlarmRef = Rte_Al_TE2_SchM_Task_0_20ms
        COMM_EXCLUSIVE_AREA_0 (RteBswExclusiveAreaImpl): RteExclusiveAreaImplMechanism=ALL_INTERRUPT_BLOCKING, RteBswExclusiveAreaRef=COMM_EXCLUSIVE_AREA_0
        COMM_EXCLUSIVE_AREA_1 (RteBswExclusiveAreaImpl): RteExclusiveAreaImplMechanism=ALL_INTERRUPT_BLOCKING, RteBswExclusiveAreaRef=COMM_EXCLUSIVE_AREA_1
      Det: RteBswImplementationRef=Det_Impl, RteBswModuleConfigurationRef=Det
        DET_EXCLUSIVE_AREA_0 (RteBswExclusiveAreaImpl): RteExclusiveAreaImplMechanism=ALL_INTERRUPT_BLOCKING, RteBswExclusiveAreaRef=DET_EXCLUSIVE_AREA_0
      EcuM: RteBswImplementationRef=EcuM_Impl, RteBswModuleConfigurationRef=EcuM
        EcuM_MainFunctionTimingEvent0 (RteBswEventToTaskMapping):
          RteBswImmediateRestart = false
          RteBswPositionInTask = 14
          RteBswEventRef = EcuM_MainFunctionTimingEvent0
          RteBswMappedToTaskRef = SchM_Task
          RteBswUsedOsEventRef = Rte_Ev_Cyclic2_SchM_Task_0_10ms
          RteBswUsedOsAlarmRef = Rte_Al_TE2_SchM_Task_0_10ms
        3 x RteBswExclusiveAreaImpl, all with RteExclusiveAreaImplMechanism=ALL_INTERRUPT_BLOCKING:
          ECUM_EXCLUSIVE_AREA_{0..2}: RteBswExclusiveAreaRef=ECUM_EXCLUSIVE_AREA_{0..2}
      Nm: RteBswImplementationRef=Nm_Impl, RteBswModuleConfigurationRef=Nm
        NM_EXCLUSIVE_AREA_0 (RteBswExclusiveAreaImpl): RteExclusiveAreaImplMechanism=ALL_INTERRUPT_BLOCKING, RteBswExclusiveAreaRef=NM_EXCLUSIVE_AREA_0
        NM_EXCLUSIVE_AREA_1 (RteBswExclusiveAreaImpl): RteExclusiveAreaImplMechanism=ALL_INTERRUPT_BLOCKING, RteBswExclusiveAreaRef=NM_EXCLUSIVE_AREA_1
      PduR: RteBswImplementationRef=PduR_Impl, RteBswModuleConfigurationRef=PduR
        PDUR_EXCLUSIVE_AREA_0 (RteBswExclusiveAreaImpl): RteExclusiveAreaImplMechanism=ALL_INTERRUPT_BLOCKING, RteBswExclusiveAreaRef=PDUR_EXCLUSIVE_AREA_0
      Rte: RteBswImplementationRef=Rte_Impl, RteBswModuleConfigurationRef=Rte
    10 x RteSwComponentInstance:
      Det_EcuSwComposition: RteSoftwareComponentInstanceRef=Det
      ComM_EcuSwComposition: RteSoftwareComponentInstanceRef=ComM
        16 x RteEventToTaskMapping, all with RteImmediateRestart=false:
          Timer_ComM_MainFunction_0: RtePositionInTask=11, RteEventRef=Timer_ComM_MainFunction_0, RteMappedToTaskRef=SchM_Task, RteUsedOsEventRef=Rte_Ev_Cyclic2_SchM_Task_0_20ms, RteUsedOsAlarmRef=Rte_Al_TE2_SchM_Task_0_20ms
          OpEventGetInhibitionStatus_GetInhibitionStatus_CL_CAN00_f26020e5: RteEventRef=OpEventGetInhibitionStatus_GetInhibitionStatus_CL_CAN00_f26020e5
          OpEventLimitECUToNoComMode_LimitECUToNoComMode_modeLimitation: RteEventRef=OpEventLimitECUToNoComMode_LimitECUToNoComMode_modeLimitation
          OpEventReadInhibitCounter_ReadInhibitCounter_modeLimitation: RteEventRef=OpEventReadInhibitCounter_ReadInhibitCounter_modeLimitation
          OpEventResetInhibitCounter_ResetInhibitCounter_modeLimitation: RteEventRef=OpEventResetInhibitCounter_ResetInhibitCounter_modeLimitation
          OpEventSetECUGroupClassification_SetECUGroupClassification_modeLimitation: RteEventRef=OpEventSetECUGroupClassification_SetECUGroupClassification_modeLimitation
          OpEventLimitChannelToNoComMode_LimitChannelToNoComMode_CL_CAN00_f26020e5: RteEventRef=OpEventLimitChannelToNoComMode_LimitChannelToNoComMode_CL_CAN00_f26020e5
          OpEventPreventWakeUp_PreventWakeUp_CW_CAN00_f26020e5: RteEventRef=OpEventPreventWakeUp_PreventWakeUp_CW_CAN00_f26020e5
          OpEventGetRequestedComMode_GetRequestedComMode_UR_USR_INTERIOR_LIGHT: RteEventRef=OpEventGetRequestedComMode_GetRequestedComMode_UR_USR_INTERIOR_LIGHT
          OpEventGetMaxComMode_GetMaxComMode_UR_USR_INTERIOR_LIGHT: RteEventRef=OpEventGetMaxComMode_GetMaxComMode_UR_USR_INTERIOR_LIGHT
          OpEventRequestComMode_RequestComMode_UR_USR_INTERIOR_LIGHT: RteEventRef=OpEventRequestComMode_RequestComMode_UR_USR_INTERIOR_LIGHT
          OpEventGetCurrentComMode_GetCurrentComMode_UR_USR_INTERIOR_LIGHT: RteEventRef=OpEventGetCurrentComMode_GetCurrentComMode_UR_USR_INTERIOR_LIGHT
          OpEventGetRequestedComMode_GetRequestedComMode_UR_USR_CHNL_f276589c: RteEventRef=OpEventGetRequestedComMode_GetRequestedComMode_UR_USR_CHNL_f276589c
          OpEventGetMaxComMode_GetMaxComMode_UR_USR_CHNL_f276589c: RteEventRef=OpEventGetMaxComMode_GetMaxComMode_UR_USR_CHNL_f276589c
          OpEventGetCurrentComMode_GetCurrentComMode_UR_USR_CHNL_f276589c: RteEventRef=OpEventGetCurrentComMode_GetCurrentComMode_UR_USR_CHNL_f276589c
          OpEventRequestComMode_RequestComMode_UR_USR_CHNL_f276589c: RteEventRef=OpEventRequestComMode_RequestComMode_UR_USR_CHNL_f276589c
      BswM_EcuSwComposition: RteSoftwareComponentInstanceRef=BswM
        Timer_BswM_MainFunction (RteEventToTaskMapping):
          RteImmediateRestart = false
          RtePositionInTask = 9
          RteEventRef = Timer_BswM_MainFunction
          RteMappedToTaskRef = SchM_Task
          RteUsedOsEventRef = Rte_Ev_Cyclic2_SchM_Task_0_10ms
          RteUsedOsAlarmRef = Rte_Al_TE2_SchM_Task_0_10ms
      EcuM_EcuSwComposition: RteSoftwareComponentInstanceRef=EcuM
        8 x RteEventToTaskMapping, all with RteImmediateRestart=false:
          Timer_EcuM_MainFunction: RtePositionInTask=14, RteEventRef=Timer_EcuM_MainFunction, RteMappedToTaskRef=SchM_Task, RteUsedOsEventRef=Rte_Ev_Cyclic2_SchM_Task_0_10ms, RteUsedOsAlarmRef=Rte_Al_TE2_SchM_Task_0_10ms
          OpEventSelectShutdownTarget_SelectShutdownTarget_EcuM_ShutdownTarget: RteEventRef=OpEventSelectShutdownTarget_SelectShutdownTarget_EcuM_ShutdownTarget
          OpEventGetShutdownTarget_GetShutdownTarget_EcuM_ShutdownTarget: RteEventRef=OpEventGetShutdownTarget_GetShutdownTarget_EcuM_ShutdownTarget
          OpEventGetLastShutdownTarget_GetLastShutdownTarget_EcuM_ShutdownTarget: RteEventRef=OpEventGetLastShutdownTarget_GetLastShutdownTarget_EcuM_ShutdownTarget
          OpEventSelectShutdownCause_SelectShutdownCause_EcuM_ShutdownTarget: RteEventRef=OpEventSelectShutdownCause_SelectShutdownCause_EcuM_ShutdownTarget
          OpEventGetShutdownCause_GetShutdownCause_EcuM_ShutdownTarget: RteEventRef=OpEventGetShutdownCause_GetShutdownCause_EcuM_ShutdownTarget
          OpEventSelectBootTarget_SelectBootTarget_EcuM_BootTarget: RteEventRef=OpEventSelectBootTarget_SelectBootTarget_EcuM_BootTarget
          OpEventGetBootTarget_GetBootTarget_EcuM_BootTarget: RteEventRef=OpEventGetBootTarget_GetBootTarget_EcuM_BootTarget
      DemMaster_0_EcuSwComposition: RteSoftwareComponentInstanceRef=DemMaster_0
        24 x RteEventToTaskMapping, all with RteImmediateRestart=false:
          Timer_Dem_MasterMainFunction: RtePositionInTask=12, RteEventRef=Timer_Dem_MasterMainFunction, RteUsedOsEventRef=Rte_Ev_Cyclic2_SchM_Task_0_10ms, RteUsedOsAlarmRef=Rte_Al_TE2_SchM_Task_0_10ms, RteMappedToTaskRef=SchM_Task
          OpEventPostRunRequested_GetPostRunRequested_DemServices: RteEventRef=OpEventPostRunRequested_GetPostRunRequested_DemServices
          OpEventGetDTCStatusAvailabilityMask_GetDTCStatusAvailabilityMask_DemServices: RteEventRef=OpEventGetDTCStatusAvailabilityMask_GetDTCStatusAvailabilityMask_DemServices
          OpEventGetOperationCycleState_GetOperationCycleState_OpCycle_DemOperationCycle: RteEventRef=OpEventGetOperationCycleState_GetOperationCycleState_OpCycle_DemOperationCycle
          OpEventSetOperationCycleState_SetOperationCycleState_OpCycle_DemOperationCycle: RteEventRef=OpEventSetOperationCycleState_SetOperationCycleState_OpCycle_DemOperationCycle
          OpEventGetEventStatus_GetEventStatus_GeneralEventInfo: RteEventRef=OpEventGetEventStatus_GetEventStatus_GeneralEventInfo
          OpEventGetMonitorStatus_GetMonitorStatus_GeneralEventInfo: RteEventRef=OpEventGetMonitorStatus_GetMonitorStatus_GeneralEventInfo
          OpEventGetEventFailed_GetEventFailed_GeneralEventInfo: RteEventRef=OpEventGetEventFailed_GetEventFailed_GeneralEventInfo
          OpEventGetEventUdsStatus_GetEventUdsStatus_GeneralEventInfo: RteEventRef=OpEventGetEventUdsStatus_GetEventUdsStatus_GeneralEventInfo
          OpEventGetDebouncingOfEvent_GetDebouncingOfEvent_GeneralEventInfo: RteEventRef=OpEventGetDebouncingOfEvent_GetDebouncingOfEvent_GeneralEventInfo
          OpEventGetEventExtendedDataRecordEx_GetEventExtendedDataRecordEx_GeneralEventInfo: RteEventRef=OpEventGetEventExtendedDataRecordEx_GetEventExtendedDataRecordEx_GeneralEventInfo
          OpEventGetEventFreezeFrameDataEx_GetEventFreezeFrameDataEx_GeneralEventInfo: RteEventRef=OpEventGetEventFreezeFrameDataEx_GetEventFreezeFrameDataEx_GeneralEventInfo
          OpEventGetFaultDetectionCounter_GetFaultDetectionCounter_GeneralEventInfo: RteEventRef=OpEventGetFaultDetectionCounter_GetFaultDetectionCounter_GeneralEventInfo
          OpEventGetEventTested_GetEventTested_GeneralEventInfo: RteEventRef=OpEventGetEventTested_GetEventTested_GeneralEventInfo
          OpEventGetDTCOfEvent_GetDTCOfEvent_GeneralEventInfo: RteEventRef=OpEventGetDTCOfEvent_GetDTCOfEvent_GeneralEventInfo
          OpEventGetEventEnableCondition_GetEventEnableCondition_GeneralEventInfo: RteEventRef=OpEventGetEventEnableCondition_GetEventEnableCondition_GeneralEventInfo
          OpEventGetOperationCycleState_GetOperationCycleState_OpCycle_IgnitionCycle: RteEventRef=OpEventGetOperationCycleState_GetOperationCycleState_OpCycle_IgnitionCycle
          OpEventSetOperationCycleState_SetOperationCycleState_OpCycle_IgnitionCycle: RteEventRef=OpEventSetOperationCycleState_SetOperationCycleState_OpCycle_IgnitionCycle
          OpEventGetOperationCycleState_GetOperationCycleState_OpCycle_PowerCycle: RteEventRef=OpEventGetOperationCycleState_GetOperationCycleState_OpCycle_PowerCycle
          OpEventSetOperationCycleState_SetOperationCycleState_OpCycle_PowerCycle: RteEventRef=OpEventSetOperationCycleState_SetOperationCycleState_OpCycle_PowerCycle
          OpEventGetEventMemoryOverflow_GetEventMemoryOverflow_OverflowIndPrimaryMemory_DemClient: RteEventRef=OpEventGetEventMemoryOverflow_GetEventMemoryOverflow_OverflowIndPrimaryMemory_DemClient
          OpEventSelectDTC_SelectDTC_ClearDTC_DemClient: RteEventRef=OpEventSelectDTC_SelectDTC_ClearDTC_DemClient
          OpEventClearDTC_ClearDTC_ClearDTC_DemClient: RteEventRef=OpEventClearDTC_ClearDTC_ClearDTC_DemClient
          OpEventGetNumberOfEventMemoryEntries_GetNumberOfEventMemoryEntries_OverflowIndPrimaryMemory_DemClient: RteEventRef=OpEventGetNumberOfEventMemoryEntries_GetNumberOfEventMemoryEntries_OverflowIndPrimaryMemory_DemClient
      DemSatellite_0_EcuSwComposition: RteSoftwareComponentInstanceRef=DemSatellite_0
        155 x RteEventToTaskMapping, all with RteImmediateRestart=false:
          Timer_Dem_SatelliteMainFunction: RtePositionInTask=13, RteEventRef=Timer_Dem_SatelliteMainFunction, RteUsedOsEventRef=Rte_Ev_Cyclic2_SchM_Task_0_10ms, RteUsedOsAlarmRef=Rte_Al_TE2_SchM_Task_0_10ms, RteMappedToTaskRef=SchM_Task
          OpEventGetEventUdsStatus_GetEventUdsStatus_EvtInfo_AutoCreatedDemEvent_NVM_E_INTEGRITY_FAILED: RteEventRef=OpEventGetEventUdsStatus_GetEventUdsStatus_EvtInfo_AutoCreatedDemEvent_NVM_E_INTEGRITY_FAILED
          OpEventGetEventStatus_GetEventStatus_EvtInfo_AutoCreatedDemEvent_NVM_E_LOSS_OF_REDUNDANCY: RteEventRef=OpEventGetEventStatus_GetEventStatus_EvtInfo_AutoCreatedDemEvent_NVM_E_LOSS_OF_REDUNDANCY
          OpEventGetEventExtendedDataRecordEx_GetEventExtendedDataRecordEx_EvtInfo_AutoCreatedDemEvent_NVM_E_LOSS_OF_REDUNDANCY: RteEventRef=OpEventGetEventExtendedDataRecordEx_GetEventExtendedDataRecordEx_EvtInfo_AutoCreatedDemEvent_NVM_E_LOSS_OF_REDUNDANCY
          OpEventGetEventTested_GetEventTested_EvtInfo_AutoCreatedDemEvent_NVM_E_LOSS_OF_REDUNDANCY: RteEventRef=OpEventGetEventTested_GetEventTested_EvtInfo_AutoCreatedDemEvent_NVM_E_LOSS_OF_REDUNDANCY
          OpEventGetDTCOfEvent_GetDTCOfEvent_EvtInfo_AutoCreatedDemEvent_NVM_E_QUEUE_OVERFLOW: RteEventRef=OpEventGetDTCOfEvent_GetDTCOfEvent_EvtInfo_AutoCreatedDemEvent_NVM_E_QUEUE_OVERFLOW
          OpEventGetEventEnableCondition_GetEventEnableCondition_EvtInfo_AutoCreatedDemEvent_NVM_E_LOSS_OF_REDUNDANCY: RteEventRef=OpEventGetEventEnableCondition_GetEventEnableCondition_EvtInfo_AutoCreatedDemEvent_NVM_E_LOSS_OF_REDUNDANCY
          OpEventGetDebouncingOfEvent_GetDebouncingOfEvent_EvtInfo_AutoCreatedDemEvent_NVM_E_WRITE_PROTECTED: RteEventRef=OpEventGetDebouncingOfEvent_GetDebouncingOfEvent_EvtInfo_AutoCreatedDemEvent_NVM_E_WRITE_PROTECTED
          OpEventGetEventEnableCondition_GetEventEnableCondition_EvtInfo_AutoCreatedDemEvent_NVM_E_QUEUE_OVERFLOW: RteEventRef=OpEventGetEventEnableCondition_GetEventEnableCondition_EvtInfo_AutoCreatedDemEvent_NVM_E_QUEUE_OVERFLOW
          OpEventGetEventStatus_GetEventStatus_EvtInfo_AutoCreatedDemEvent_NVM_E_WRONG_BLOCK_ID: RteEventRef=OpEventGetEventStatus_GetEventStatus_EvtInfo_AutoCreatedDemEvent_NVM_E_WRONG_BLOCK_ID
          OpEventGetEventUdsStatus_GetEventUdsStatus_GeneralEventInfo: RteEventRef=OpEventGetEventUdsStatus_GetEventUdsStatus_GeneralEventInfo
          OpEventGetEventFailed_GetEventFailed_GeneralEventInfo: RteEventRef=OpEventGetEventFailed_GetEventFailed_GeneralEventInfo
          OpEventGetFaultDetectionCounter_GetFaultDetectionCounter_GeneralEventInfo: RteEventRef=OpEventGetFaultDetectionCounter_GetFaultDetectionCounter_GeneralEventInfo
          OpEventGetMonitorStatus_GetMonitorStatus_GeneralEventInfo: RteEventRef=OpEventGetMonitorStatus_GetMonitorStatus_GeneralEventInfo
          OpEventGetEventFailed_GetEventFailed_EvtInfo_AutoCreatedDemEvent_NVM_E_WRONG_BLOCK_ID: RteEventRef=OpEventGetEventFailed_GetEventFailed_EvtInfo_AutoCreatedDemEvent_NVM_E_WRONG_BLOCK_ID
          OpEventGetDebouncingOfEvent_GetDebouncingOfEvent_EvtInfo_AutoCreatedDemEvent_NVM_E_VERIFY_FAILED: RteEventRef=OpEventGetDebouncingOfEvent_GetDebouncingOfEvent_EvtInfo_AutoCreatedDemEvent_NVM_E_VERIFY_FAILED
          OpEventGetEventEnableCondition_GetEventEnableCondition_EvtInfo_AutoCreatedDemEvent_NVM_E_WRONG_BLOCK_ID: RteEventRef=OpEventGetEventEnableCondition_GetEventEnableCondition_EvtInfo_AutoCreatedDemEvent_NVM_E_WRONG_BLOCK_ID
          OpEventGetEventUdsStatus_GetEventUdsStatus_EvtInfo_AutoCreatedDemEvent_NVM_E_WRITE_PROTECTED: RteEventRef=OpEventGetEventUdsStatus_GetEventUdsStatus_EvtInfo_AutoCreatedDemEvent_NVM_E_WRITE_PROTECTED
          OpEventGetEventUdsStatus_GetEventUdsStatus_EvtInfo_AutoCreatedDemEvent_NVM_E_REQ_FAILED: RteEventRef=OpEventGetEventUdsStatus_GetEventUdsStatus_EvtInfo_AutoCreatedDemEvent_NVM_E_REQ_FAILED
          OpEventGetMonitorStatus_GetMonitorStatus_EvtInfo_AutoCreatedDemEvent_NVM_E_QUEUE_OVERFLOW: RteEventRef=OpEventGetMonitorStatus_GetMonitorStatus_EvtInfo_AutoCreatedDemEvent_NVM_E_QUEUE_OVERFLOW
          OpEventGetDTCOfEvent_GetDTCOfEvent_GeneralEventInfo: RteEventRef=OpEventGetDTCOfEvent_GetDTCOfEvent_GeneralEventInfo
          OpEventGetDTCOfEvent_GetDTCOfEvent_EvtInfo_AutoCreatedDemEvent_NVM_E_VERIFY_FAILED: RteEventRef=OpEventGetDTCOfEvent_GetDTCOfEvent_EvtInfo_AutoCreatedDemEvent_NVM_E_VERIFY_FAILED
          OpEventGetEventFreezeFrameDataEx_GetEventFreezeFrameDataEx_EvtInfo_AutoCreatedDemEvent_NVM_E_WRONG_BLOCK_ID: RteEventRef=OpEventGetEventFreezeFrameDataEx_GetEventFreezeFrameDataEx_EvtInfo_AutoCreatedDemEvent_NVM_E_WRONG_BLOCK_ID
          OpEventGetEventFreezeFrameDataEx_GetEventFreezeFrameDataEx_EvtInfo_AutoCreatedDemEvent_NVM_E_INTEGRITY_FAILED: RteEventRef=OpEventGetEventFreezeFrameDataEx_GetEventFreezeFrameDataEx_EvtInfo_AutoCreatedDemEvent_NVM_E_INTEGRITY_FAILED
          OpEventGetFaultDetectionCounter_GetFaultDetectionCounter_EvtInfo_AutoCreatedDemEvent_NVM_E_REQ_FAILED: RteEventRef=OpEventGetFaultDetectionCounter_GetFaultDetectionCounter_EvtInfo_AutoCreatedDemEvent_NVM_E_REQ_FAILED
          OpEventGetEventUdsStatus_GetEventUdsStatus_EvtInfo_AutoCreatedDemEvent_NVM_E_VERIFY_FAILED: RteEventRef=OpEventGetEventUdsStatus_GetEventUdsStatus_EvtInfo_AutoCreatedDemEvent_NVM_E_VERIFY_FAILED
          OpEventGetEventEnableCondition_GetEventEnableCondition_EvtInfo_AutoCreatedDemEvent_NVM_E_REQ_FAILED: RteEventRef=OpEventGetEventEnableCondition_GetEventEnableCondition_EvtInfo_AutoCreatedDemEvent_NVM_E_REQ_FAILED
          OpEventGetEventFailed_GetEventFailed_EvtInfo_AutoCreatedDemEvent_NVM_E_QUEUE_OVERFLOW: RteEventRef=OpEventGetEventFailed_GetEventFailed_EvtInfo_AutoCreatedDemEvent_NVM_E_QUEUE_OVERFLOW
          OpEventGetEventEnableCondition_GetEventEnableCondition_EvtInfo_AutoCreatedDemEvent_NVM_E_VERIFY_FAILED: RteEventRef=OpEventGetEventEnableCondition_GetEventEnableCondition_EvtInfo_AutoCreatedDemEvent_NVM_E_VERIFY_FAILED
          OpEventGetDebouncingOfEvent_GetDebouncingOfEvent_EvtInfo_AutoCreatedDemEvent_NVM_E_WRONG_BLOCK_ID: RteEventRef=OpEventGetDebouncingOfEvent_GetDebouncingOfEvent_EvtInfo_AutoCreatedDemEvent_NVM_E_WRONG_BLOCK_ID
          OpEventGetMonitorStatus_GetMonitorStatus_EvtInfo_AutoCreatedDemEvent_NVM_E_WRONG_BLOCK_ID: RteEventRef=OpEventGetMonitorStatus_GetMonitorStatus_EvtInfo_AutoCreatedDemEvent_NVM_E_WRONG_BLOCK_ID
          OpEventGetDebouncingOfEvent_GetDebouncingOfEvent_EvtInfo_AutoCreatedDemEvent_NVM_E_LOSS_OF_REDUNDANCY: RteEventRef=OpEventGetDebouncingOfEvent_GetDebouncingOfEvent_EvtInfo_AutoCreatedDemEvent_NVM_E_LOSS_OF_REDUNDANCY
          OpEventGetEventFreezeFrameDataEx_GetEventFreezeFrameDataEx_EvtInfo_AutoCreatedDemEvent_NVM_E_QUEUE_OVERFLOW: RteEventRef=OpEventGetEventFreezeFrameDataEx_GetEventFreezeFrameDataEx_EvtInfo_AutoCreatedDemEvent_NVM_E_QUEUE_OVERFLOW
          OpEventGetEventFailed_GetEventFailed_EvtInfo_AutoCreatedDemEvent_NVM_E_WRITE_PROTECTED: RteEventRef=OpEventGetEventFailed_GetEventFailed_EvtInfo_AutoCreatedDemEvent_NVM_E_WRITE_PROTECTED
          OpEventGetFaultDetectionCounter_GetFaultDetectionCounter_EvtInfo_AutoCreatedDemEvent_NVM_E_LOSS_OF_REDUNDANCY: RteEventRef=OpEventGetFaultDetectionCounter_GetFaultDetectionCounter_EvtInfo_AutoCreatedDemEvent_NVM_E_LOSS_OF_REDUNDANCY
          OpEventGetEventExtendedDataRecordEx_GetEventExtendedDataRecordEx_EvtInfo_AutoCreatedDemEvent_NVM_E_VERIFY_FAILED: RteEventRef=OpEventGetEventExtendedDataRecordEx_GetEventExtendedDataRecordEx_EvtInfo_AutoCreatedDemEvent_NVM_E_VERIFY_FAILED
          OpEventGetEventStatus_GetEventStatus_EvtInfo_AutoCreatedDemEvent_NVM_E_WRITE_PROTECTED: RteEventRef=OpEventGetEventStatus_GetEventStatus_EvtInfo_AutoCreatedDemEvent_NVM_E_WRITE_PROTECTED
          OpEventGetDTCOfEvent_GetDTCOfEvent_EvtInfo_AutoCreatedDemEvent_NVM_E_INTEGRITY_FAILED: RteEventRef=OpEventGetDTCOfEvent_GetDTCOfEvent_EvtInfo_AutoCreatedDemEvent_NVM_E_INTEGRITY_FAILED
          OpEventGetMonitorStatus_GetMonitorStatus_EvtInfo_AutoCreatedDemEvent_NVM_E_VERIFY_FAILED: RteEventRef=OpEventGetMonitorStatus_GetMonitorStatus_EvtInfo_AutoCreatedDemEvent_NVM_E_VERIFY_FAILED
          OpEventGetEventFailed_GetEventFailed_EvtInfo_AutoCreatedDemEvent_NVM_E_INTEGRITY_FAILED: RteEventRef=OpEventGetEventFailed_GetEventFailed_EvtInfo_AutoCreatedDemEvent_NVM_E_INTEGRITY_FAILED
          OpEventGetEventTested_GetEventTested_EvtInfo_AutoCreatedDemEvent_NVM_E_WRITE_PROTECTED: RteEventRef=OpEventGetEventTested_GetEventTested_EvtInfo_AutoCreatedDemEvent_NVM_E_WRITE_PROTECTED
          OpEventGetFaultDetectionCounter_GetFaultDetectionCounter_EvtInfo_AutoCreatedDemEvent_NVM_E_INTEGRITY_FAILED: RteEventRef=OpEventGetFaultDetectionCounter_GetFaultDetectionCounter_EvtInfo_AutoCreatedDemEvent_NVM_E_INTEGRITY_FAILED
          OpEventGetEventFreezeFrameDataEx_GetEventFreezeFrameDataEx_GeneralEventInfo: RteEventRef=OpEventGetEventFreezeFrameDataEx_GetEventFreezeFrameDataEx_GeneralEventInfo
          OpEventGetEventStatus_GetEventStatus_EvtInfo_AutoCreatedDemEvent_NVM_E_INTEGRITY_FAILED: RteEventRef=OpEventGetEventStatus_GetEventStatus_EvtInfo_AutoCreatedDemEvent_NVM_E_INTEGRITY_FAILED
          OpEventGetEventExtendedDataRecordEx_GetEventExtendedDataRecordEx_EvtInfo_AutoCreatedDemEvent_NVM_E_WRONG_BLOCK_ID: RteEventRef=OpEventGetEventExtendedDataRecordEx_GetEventExtendedDataRecordEx_EvtInfo_AutoCreatedDemEvent_NVM_E_WRONG_BLOCK_ID
          OpEventGetEventFailed_GetEventFailed_EvtInfo_AutoCreatedDemEvent_NVM_E_VERIFY_FAILED: RteEventRef=OpEventGetEventFailed_GetEventFailed_EvtInfo_AutoCreatedDemEvent_NVM_E_VERIFY_FAILED
          OpEventGetEventExtendedDataRecordEx_GetEventExtendedDataRecordEx_EvtInfo_AutoCreatedDemEvent_NVM_E_QUEUE_OVERFLOW: RteEventRef=OpEventGetEventExtendedDataRecordEx_GetEventExtendedDataRecordEx_EvtInfo_AutoCreatedDemEvent_NVM_E_QUEUE_OVERFLOW
          OpEventGetEventStatus_GetEventStatus_EvtInfo_AutoCreatedDemEvent_NVM_E_VERIFY_FAILED: RteEventRef=OpEventGetEventStatus_GetEventStatus_EvtInfo_AutoCreatedDemEvent_NVM_E_VERIFY_FAILED
          OpEventGetEventExtendedDataRecordEx_GetEventExtendedDataRecordEx_GeneralEventInfo: RteEventRef=OpEventGetEventExtendedDataRecordEx_GetEventExtendedDataRecordEx_GeneralEventInfo
          OpEventGetEventUdsStatus_GetEventUdsStatus_EvtInfo_AutoCreatedDemEvent_NVM_E_QUEUE_OVERFLOW: RteEventRef=OpEventGetEventUdsStatus_GetEventUdsStatus_EvtInfo_AutoCreatedDemEvent_NVM_E_QUEUE_OVERFLOW
          OpEventGetFaultDetectionCounter_GetFaultDetectionCounter_EvtInfo_AutoCreatedDemEvent_NVM_E_QUEUE_OVERFLOW: RteEventRef=OpEventGetFaultDetectionCounter_GetFaultDetectionCounter_EvtInfo_AutoCreatedDemEvent_NVM_E_QUEUE_OVERFLOW
          OpEventGetDebouncingOfEvent_GetDebouncingOfEvent_GeneralEventInfo: RteEventRef=OpEventGetDebouncingOfEvent_GetDebouncingOfEvent_GeneralEventInfo
          OpEventGetEventEnableCondition_GetEventEnableCondition_EvtInfo_AutoCreatedDemEvent_NVM_E_WRITE_PROTECTED: RteEventRef=OpEventGetEventEnableCondition_GetEventEnableCondition_EvtInfo_AutoCreatedDemEvent_NVM_E_WRITE_PROTECTED
          OpEventGetEventEnableCondition_GetEventEnableCondition_GeneralEventInfo: RteEventRef=OpEventGetEventEnableCondition_GetEventEnableCondition_GeneralEventInfo
          OpEventGetEventEnableCondition_GetEventEnableCondition_EvtInfo_AutoCreatedDemEvent_NVM_E_INTEGRITY_FAILED: RteEventRef=OpEventGetEventEnableCondition_GetEventEnableCondition_EvtInfo_AutoCreatedDemEvent_NVM_E_INTEGRITY_FAILED
          OpEventGetMonitorStatus_GetMonitorStatus_EvtInfo_AutoCreatedDemEvent_NVM_E_LOSS_OF_REDUNDANCY: RteEventRef=OpEventGetMonitorStatus_GetMonitorStatus_EvtInfo_AutoCreatedDemEvent_NVM_E_LOSS_OF_REDUNDANCY
          OpEventGetDTCOfEvent_GetDTCOfEvent_EvtInfo_AutoCreatedDemEvent_NVM_E_REQ_FAILED: RteEventRef=OpEventGetDTCOfEvent_GetDTCOfEvent_EvtInfo_AutoCreatedDemEvent_NVM_E_REQ_FAILED
          OpEventGetEventFreezeFrameDataEx_GetEventFreezeFrameDataEx_EvtInfo_AutoCreatedDemEvent_NVM_E_REQ_FAILED: RteEventRef=OpEventGetEventFreezeFrameDataEx_GetEventFreezeFrameDataEx_EvtInfo_AutoCreatedDemEvent_NVM_E_REQ_FAILED
          OpEventGetEventStatus_GetEventStatus_EvtInfo_AutoCreatedDemEvent_NVM_E_REQ_FAILED: RteEventRef=OpEventGetEventStatus_GetEventStatus_EvtInfo_AutoCreatedDemEvent_NVM_E_REQ_FAILED
          OpEventGetDebouncingOfEvent_GetDebouncingOfEvent_EvtInfo_AutoCreatedDemEvent_NVM_E_REQ_FAILED: RteEventRef=OpEventGetDebouncingOfEvent_GetDebouncingOfEvent_EvtInfo_AutoCreatedDemEvent_NVM_E_REQ_FAILED
          OpEventGetEventFreezeFrameDataEx_GetEventFreezeFrameDataEx_EvtInfo_AutoCreatedDemEvent_NVM_E_VERIFY_FAILED: RteEventRef=OpEventGetEventFreezeFrameDataEx_GetEventFreezeFrameDataEx_EvtInfo_AutoCreatedDemEvent_NVM_E_VERIFY_FAILED
          OpEventGetMonitorStatus_GetMonitorStatus_EvtInfo_AutoCreatedDemEvent_NVM_E_INTEGRITY_FAILED: RteEventRef=OpEventGetMonitorStatus_GetMonitorStatus_EvtInfo_AutoCreatedDemEvent_NVM_E_INTEGRITY_FAILED
          OpEventGetEventTested_GetEventTested_EvtInfo_AutoCreatedDemEvent_NVM_E_REQ_FAILED: RteEventRef=OpEventGetEventTested_GetEventTested_EvtInfo_AutoCreatedDemEvent_NVM_E_REQ_FAILED
          OpEventGetEventStatus_GetEventStatus_EvtInfo_AutoCreatedDemEvent_NVM_E_QUEUE_OVERFLOW: RteEventRef=OpEventGetEventStatus_GetEventStatus_EvtInfo_AutoCreatedDemEvent_NVM_E_QUEUE_OVERFLOW
          OpEventGetFaultDetectionCounter_GetFaultDetectionCounter_EvtInfo_AutoCreatedDemEvent_NVM_E_WRONG_BLOCK_ID: RteEventRef=OpEventGetFaultDetectionCounter_GetFaultDetectionCounter_EvtInfo_AutoCreatedDemEvent_NVM_E_WRONG_BLOCK_ID
          OpEventGetDebouncingOfEvent_GetDebouncingOfEvent_EvtInfo_AutoCreatedDemEvent_NVM_E_INTEGRITY_FAILED: RteEventRef=OpEventGetDebouncingOfEvent_GetDebouncingOfEvent_EvtInfo_AutoCreatedDemEvent_NVM_E_INTEGRITY_FAILED
          OpEventGetEventTested_GetEventTested_EvtInfo_AutoCreatedDemEvent_NVM_E_QUEUE_OVERFLOW: RteEventRef=OpEventGetEventTested_GetEventTested_EvtInfo_AutoCreatedDemEvent_NVM_E_QUEUE_OVERFLOW
          OpEventGetMonitorStatus_GetMonitorStatus_EvtInfo_AutoCreatedDemEvent_NVM_E_REQ_FAILED: RteEventRef=OpEventGetMonitorStatus_GetMonitorStatus_EvtInfo_AutoCreatedDemEvent_NVM_E_REQ_FAILED
          OpEventGetEventFreezeFrameDataEx_GetEventFreezeFrameDataEx_EvtInfo_AutoCreatedDemEvent_NVM_E_LOSS_OF_REDUNDANCY: RteEventRef=OpEventGetEventFreezeFrameDataEx_GetEventFreezeFrameDataEx_EvtInfo_AutoCreatedDemEvent_NVM_E_LOSS_OF_REDUNDANCY
          OpEventGetEventTested_GetEventTested_EvtInfo_AutoCreatedDemEvent_NVM_E_VERIFY_FAILED: RteEventRef=OpEventGetEventTested_GetEventTested_EvtInfo_AutoCreatedDemEvent_NVM_E_VERIFY_FAILED
          OpEventGetDTCOfEvent_GetDTCOfEvent_EvtInfo_AutoCreatedDemEvent_NVM_E_LOSS_OF_REDUNDANCY: RteEventRef=OpEventGetDTCOfEvent_GetDTCOfEvent_EvtInfo_AutoCreatedDemEvent_NVM_E_LOSS_OF_REDUNDANCY
          OpEventGetMonitorStatus_GetMonitorStatus_EvtInfo_AutoCreatedDemEvent_NVM_E_WRITE_PROTECTED: RteEventRef=OpEventGetMonitorStatus_GetMonitorStatus_EvtInfo_AutoCreatedDemEvent_NVM_E_WRITE_PROTECTED
          OpEventGetEventFailed_GetEventFailed_EvtInfo_AutoCreatedDemEvent_NVM_E_LOSS_OF_REDUNDANCY: RteEventRef=OpEventGetEventFailed_GetEventFailed_EvtInfo_AutoCreatedDemEvent_NVM_E_LOSS_OF_REDUNDANCY
          OpEventGetDTCOfEvent_GetDTCOfEvent_EvtInfo_AutoCreatedDemEvent_NVM_E_WRITE_PROTECTED: RteEventRef=OpEventGetDTCOfEvent_GetDTCOfEvent_EvtInfo_AutoCreatedDemEvent_NVM_E_WRITE_PROTECTED
          OpEventGetEventFreezeFrameDataEx_GetEventFreezeFrameDataEx_EvtInfo_AutoCreatedDemEvent_NVM_E_WRITE_PROTECTED: RteEventRef=OpEventGetEventFreezeFrameDataEx_GetEventFreezeFrameDataEx_EvtInfo_AutoCreatedDemEvent_NVM_E_WRITE_PROTECTED
          OpEventGetEventExtendedDataRecordEx_GetEventExtendedDataRecordEx_EvtInfo_AutoCreatedDemEvent_NVM_E_REQ_FAILED: RteEventRef=OpEventGetEventExtendedDataRecordEx_GetEventExtendedDataRecordEx_EvtInfo_AutoCreatedDemEvent_NVM_E_REQ_FAILED
          OpEventGetEventTested_GetEventTested_EvtInfo_AutoCreatedDemEvent_NVM_E_WRONG_BLOCK_ID: RteEventRef=OpEventGetEventTested_GetEventTested_EvtInfo_AutoCreatedDemEvent_NVM_E_WRONG_BLOCK_ID
          OpEventGetDTCOfEvent_GetDTCOfEvent_EvtInfo_AutoCreatedDemEvent_NVM_E_WRONG_BLOCK_ID: RteEventRef=OpEventGetDTCOfEvent_GetDTCOfEvent_EvtInfo_AutoCreatedDemEvent_NVM_E_WRONG_BLOCK_ID
          OpEventGetFaultDetectionCounter_GetFaultDetectionCounter_EvtInfo_AutoCreatedDemEvent_NVM_E_VERIFY_FAILED: RteEventRef=OpEventGetFaultDetectionCounter_GetFaultDetectionCounter_EvtInfo_AutoCreatedDemEvent_NVM_E_VERIFY_FAILED
          OpEventGetEventStatus_GetEventStatus_GeneralEventInfo: RteEventRef=OpEventGetEventStatus_GetEventStatus_GeneralEventInfo
          OpEventGetEventUdsStatus_GetEventUdsStatus_EvtInfo_AutoCreatedDemEvent_NVM_E_WRONG_BLOCK_ID: RteEventRef=OpEventGetEventUdsStatus_GetEventUdsStatus_EvtInfo_AutoCreatedDemEvent_NVM_E_WRONG_BLOCK_ID
          OpEventGetEventFailed_GetEventFailed_EvtInfo_AutoCreatedDemEvent_NVM_E_REQ_FAILED: RteEventRef=OpEventGetEventFailed_GetEventFailed_EvtInfo_AutoCreatedDemEvent_NVM_E_REQ_FAILED
          OpEventGetFaultDetectionCounter_GetFaultDetectionCounter_EvtInfo_AutoCreatedDemEvent_NVM_E_WRITE_PROTECTED: RteEventRef=OpEventGetFaultDetectionCounter_GetFaultDetectionCounter_EvtInfo_AutoCreatedDemEvent_NVM_E_WRITE_PROTECTED
          OpEventGetEventTested_GetEventTested_EvtInfo_AutoCreatedDemEvent_NVM_E_INTEGRITY_FAILED: RteEventRef=OpEventGetEventTested_GetEventTested_EvtInfo_AutoCreatedDemEvent_NVM_E_INTEGRITY_FAILED
          OpEventGetEventExtendedDataRecordEx_GetEventExtendedDataRecordEx_EvtInfo_AutoCreatedDemEvent_NVM_E_INTEGRITY_FAILED: RteEventRef=OpEventGetEventExtendedDataRecordEx_GetEventExtendedDataRecordEx_EvtInfo_AutoCreatedDemEvent_NVM_E_INTEGRITY_FAILED
          OpEventGetEventExtendedDataRecordEx_GetEventExtendedDataRecordEx_EvtInfo_AutoCreatedDemEvent_NVM_E_WRITE_PROTECTED: RteEventRef=OpEventGetEventExtendedDataRecordEx_GetEventExtendedDataRecordEx_EvtInfo_AutoCreatedDemEvent_NVM_E_WRITE_PROTECTED
          OpEventGetDebouncingOfEvent_GetDebouncingOfEvent_EvtInfo_AutoCreatedDemEvent_NVM_E_QUEUE_OVERFLOW: RteEventRef=OpEventGetDebouncingOfEvent_GetDebouncingOfEvent_EvtInfo_AutoCreatedDemEvent_NVM_E_QUEUE_OVERFLOW
          OpEventGetEventUdsStatus_GetEventUdsStatus_EvtInfo_AutoCreatedDemEvent_NVM_E_LOSS_OF_REDUNDANCY: RteEventRef=OpEventGetEventUdsStatus_GetEventUdsStatus_EvtInfo_AutoCreatedDemEvent_NVM_E_LOSS_OF_REDUNDANCY
          OpEventGetEventTested_GetEventTested_GeneralEventInfo: RteEventRef=OpEventGetEventTested_GetEventTested_GeneralEventInfo
          OpEventGetEventStatus_GetEventStatus_EvtInfo_AutoCreatedDemEvent_EcuMConfiguration_ECUM_E_IMPROPER_CALLER: RteEventRef=OpEventGetEventStatus_GetEventStatus_EvtInfo_AutoCreatedDemEvent_EcuMConfiguration_ECUM_E_IMPROPER_CALLER
          OpEventGetFaultDetectionCounter_GetFaultDetectionCounter_EvtInfo_AutoCreatedDemEvent_EcuMConfiguration_ECUM_E_IMPROPER_CALLER: RteEventRef=OpEventGetFaultDetectionCounter_GetFaultDetectionCounter_EvtInfo_AutoCreatedDemEvent_EcuMConfiguration_ECUM_E_IMPROPER_CALLER
          OpEventGetEventEnableCondition_GetEventEnableCondition_EvtInfo_AutoCreatedDemEvent_EcuMConfiguration_ECUM_E_RAM_CHECK_FAILED: RteEventRef=OpEventGetEventEnableCondition_GetEventEnableCondition_EvtInfo_AutoCreatedDemEvent_EcuMConfiguration_ECUM_E_RAM_CHECK_FAILED
          OpEventGetEventExtendedDataRecordEx_GetEventExtendedDataRecordEx_EvtInfo_AutoCreatedDemEvent_EcuMConfiguration_ECUM_E_A_6cc04a27: RteEventRef=OpEventGetEventExtendedDataRecordEx_GetEventExtendedDataRecordEx_EvtInfo_AutoCreatedDemEvent_EcuMConfiguration_ECUM_E_A_6cc04a27
          OpEventGetDTCOfEvent_GetDTCOfEvent_EvtInfo_AutoCreatedDemEvent_EcuMConfiguration_ECUM_E_CONFIGURATION_DATA_INCONSISTENT: RteEventRef=OpEventGetDTCOfEvent_GetDTCOfEvent_EvtInfo_AutoCreatedDemEvent_EcuMConfiguration_ECUM_E_CONFIGURATION_DATA_INCONSISTENT
          OpEventGetEventFreezeFrameDataEx_GetEventFreezeFrameDataEx_EvtInfo_AutoCreatedDemEvent_EcuMConfiguration_ECUM_E_IMPROPER_CALLER: RteEventRef=OpEventGetEventFreezeFrameDataEx_GetEventFreezeFrameDataEx_EvtInfo_AutoCreatedDemEvent_EcuMConfiguration_ECUM_E_IMPROPER_CALLER
          OpEventGetMonitorStatus_GetMonitorStatus_EvtInfo_AutoCreatedDemEvent_EcuMConfiguration_ECUM_E_CONFIGURATION_DATA_INCONSISTENT: RteEventRef=OpEventGetMonitorStatus_GetMonitorStatus_EvtInfo_AutoCreatedDemEvent_EcuMConfiguration_ECUM_E_CONFIGURATION_DATA_INCONSISTENT
          OpEventGetEventFailed_GetEventFailed_EvtInfo_AutoCreatedDemEvent_EcuMConfiguration_ECUM_E_ALL_RUN_REQUESTS_KILLED: RteEventRef=OpEventGetEventFailed_GetEventFailed_EvtInfo_AutoCreatedDemEvent_EcuMConfiguration_ECUM_E_ALL_RUN_REQUESTS_KILLED
          OpEventGetEventFailed_GetEventFailed_EvtInfo_AutoCreatedDemEvent_EcuMConfiguration_ECUM_E_RAM_CHECK_FAILED: RteEventRef=OpEventGetEventFailed_GetEventFailed_EvtInfo_AutoCreatedDemEvent_EcuMConfiguration_ECUM_E_RAM_CHECK_FAILED
          OpEventGetMonitorStatus_GetMonitorStatus_EvtInfo_AutoCreatedDemEvent_EcuMConfiguration_ECUM_E_ALL_RUN_REQUESTS_KILLED: RteEventRef=OpEventGetMonitorStatus_GetMonitorStatus_EvtInfo_AutoCreatedDemEvent_EcuMConfiguration_ECUM_E_ALL_RUN_REQUESTS_KILLED
          OpEventGetEventFreezeFrameDataEx_GetEventFreezeFrameDataEx_EvtInfo_AutoCreatedDemEvent_EcuMConfiguration_ECUM_E_CONFIGU_7d4a80d3: RteEventRef=OpEventGetEventFreezeFrameDataEx_GetEventFreezeFrameDataEx_EvtInfo_AutoCreatedDemEvent_EcuMConfiguration_ECUM_E_CONFIGU_7d4a80d3
          OpEventGetMonitorStatus_GetMonitorStatus_EvtInfo_AutoCreatedDemEvent_EcuMConfiguration_ECUM_E_RAM_CHECK_FAILED: RteEventRef=OpEventGetMonitorStatus_GetMonitorStatus_EvtInfo_AutoCreatedDemEvent_EcuMConfiguration_ECUM_E_RAM_CHECK_FAILED
          OpEventGetEventEnableCondition_GetEventEnableCondition_EvtInfo_AutoCreatedDemEvent_EcuMConfiguration_ECUM_E_IMPROPER_CALLER: RteEventRef=OpEventGetEventEnableCondition_GetEventEnableCondition_EvtInfo_AutoCreatedDemEvent_EcuMConfiguration_ECUM_E_IMPROPER_CALLER
          OpEventGetEventStatus_GetEventStatus_EvtInfo_AutoCreatedDemEvent_EcuMConfiguration_ECUM_E_RAM_CHECK_FAILED: RteEventRef=OpEventGetEventStatus_GetEventStatus_EvtInfo_AutoCreatedDemEvent_EcuMConfiguration_ECUM_E_RAM_CHECK_FAILED
          OpEventGetEventUdsStatus_GetEventUdsStatus_EvtInfo_AutoCreatedDemEvent_EcuMConfiguration_ECUM_E_RAM_CHECK_FAILED: RteEventRef=OpEventGetEventUdsStatus_GetEventUdsStatus_EvtInfo_AutoCreatedDemEvent_EcuMConfiguration_ECUM_E_RAM_CHECK_FAILED
          OpEventGetEventFreezeFrameDataEx_GetEventFreezeFrameDataEx_EvtInfo_AutoCreatedDemEvent_EcuMConfiguration_ECUM_E_ALL_RUN_993f76de: RteEventRef=OpEventGetEventFreezeFrameDataEx_GetEventFreezeFrameDataEx_EvtInfo_AutoCreatedDemEvent_EcuMConfiguration_ECUM_E_ALL_RUN_993f76de
          OpEventGetEventStatus_GetEventStatus_EvtInfo_AutoCreatedDemEvent_EcuMConfiguration_ECUM_E_ALL_RUN_REQUESTS_KILLED: RteEventRef=OpEventGetEventStatus_GetEventStatus_EvtInfo_AutoCreatedDemEvent_EcuMConfiguration_ECUM_E_ALL_RUN_REQUESTS_KILLED
          OpEventGetEventExtendedDataRecordEx_GetEventExtendedDataRecordEx_EvtInfo_AutoCreatedDemEvent_EcuMConfiguration_ECUM_E_I_7db075fd: RteEventRef=OpEventGetEventExtendedDataRecordEx_GetEventExtendedDataRecordEx_EvtInfo_AutoCreatedDemEvent_EcuMConfiguration_ECUM_E_I_7db075fd
          OpEventGetEventTested_GetEventTested_EvtInfo_AutoCreatedDemEvent_EcuMConfiguration_ECUM_E_IMPROPER_CALLER: RteEventRef=OpEventGetEventTested_GetEventTested_EvtInfo_AutoCreatedDemEvent_EcuMConfiguration_ECUM_E_IMPROPER_CALLER
          OpEventGetEventTested_GetEventTested_EvtInfo_AutoCreatedDemEvent_EcuMConfiguration_ECUM_E_CONFIGURATION_DATA_INCONSISTENT: RteEventRef=OpEventGetEventTested_GetEventTested_EvtInfo_AutoCreatedDemEvent_EcuMConfiguration_ECUM_E_CONFIGURATION_DATA_INCONSISTENT
          OpEventGetEventStatus_GetEventStatus_EvtInfo_AutoCreatedDemEvent_EcuMConfiguration_ECUM_E_CONFIGURATION_DATA_INCONSISTENT: RteEventRef=OpEventGetEventStatus_GetEventStatus_EvtInfo_AutoCreatedDemEvent_EcuMConfiguration_ECUM_E_CONFIGURATION_DATA_INCONSISTENT
          OpEventGetEventFailed_GetEventFailed_EvtInfo_AutoCreatedDemEvent_EcuMConfiguration_ECUM_E_CONFIGURATION_DATA_INCONSISTENT: RteEventRef=OpEventGetEventFailed_GetEventFailed_EvtInfo_AutoCreatedDemEvent_EcuMConfiguration_ECUM_E_CONFIGURATION_DATA_INCONSISTENT
          OpEventGetDTCOfEvent_GetDTCOfEvent_EvtInfo_AutoCreatedDemEvent_EcuMConfiguration_ECUM_E_RAM_CHECK_FAILED: RteEventRef=OpEventGetDTCOfEvent_GetDTCOfEvent_EvtInfo_AutoCreatedDemEvent_EcuMConfiguration_ECUM_E_RAM_CHECK_FAILED
          OpEventGetEventTested_GetEventTested_EvtInfo_AutoCreatedDemEvent_EcuMConfiguration_ECUM_E_ALL_RUN_REQUESTS_KILLED: RteEventRef=OpEventGetEventTested_GetEventTested_EvtInfo_AutoCreatedDemEvent_EcuMConfiguration_ECUM_E_ALL_RUN_REQUESTS_KILLED
          OpEventGetDebouncingOfEvent_GetDebouncingOfEvent_EvtInfo_AutoCreatedDemEvent_EcuMConfiguration_ECUM_E_CONFIGURATION_DAT_7642b2c3: RteEventRef=OpEventGetDebouncingOfEvent_GetDebouncingOfEvent_EvtInfo_AutoCreatedDemEvent_EcuMConfiguration_ECUM_E_CONFIGURATION_DAT_7642b2c3
          OpEventGetMonitorStatus_GetMonitorStatus_EvtInfo_AutoCreatedDemEvent_EcuMConfiguration_ECUM_E_IMPROPER_CALLER: RteEventRef=OpEventGetMonitorStatus_GetMonitorStatus_EvtInfo_AutoCreatedDemEvent_EcuMConfiguration_ECUM_E_IMPROPER_CALLER
          OpEventGetDebouncingOfEvent_GetDebouncingOfEvent_EvtInfo_AutoCreatedDemEvent_EcuMConfiguration_ECUM_E_RAM_CHECK_FAILED: RteEventRef=OpEventGetDebouncingOfEvent_GetDebouncingOfEvent_EvtInfo_AutoCreatedDemEvent_EcuMConfiguration_ECUM_E_RAM_CHECK_FAILED
          OpEventGetDTCOfEvent_GetDTCOfEvent_EvtInfo_AutoCreatedDemEvent_EcuMConfiguration_ECUM_E_ALL_RUN_REQUESTS_KILLED: RteEventRef=OpEventGetDTCOfEvent_GetDTCOfEvent_EvtInfo_AutoCreatedDemEvent_EcuMConfiguration_ECUM_E_ALL_RUN_REQUESTS_KILLED
          OpEventGetFaultDetectionCounter_GetFaultDetectionCounter_EvtInfo_AutoCreatedDemEvent_EcuMConfiguration_ECUM_E_ALL_RUN_R_5c1d7bad: RteEventRef=OpEventGetFaultDetectionCounter_GetFaultDetectionCounter_EvtInfo_AutoCreatedDemEvent_EcuMConfiguration_ECUM_E_ALL_RUN_R_5c1d7bad
          OpEventGetEventFreezeFrameDataEx_GetEventFreezeFrameDataEx_EvtInfo_AutoCreatedDemEvent_EcuMConfiguration_ECUM_E_RAM_CHECK_FAILED: RteEventRef=OpEventGetEventFreezeFrameDataEx_GetEventFreezeFrameDataEx_EvtInfo_AutoCreatedDemEvent_EcuMConfiguration_ECUM_E_RAM_CHECK_FAILED
          OpEventGetEventTested_GetEventTested_EvtInfo_AutoCreatedDemEvent_EcuMConfiguration_ECUM_E_RAM_CHECK_FAILED: RteEventRef=OpEventGetEventTested_GetEventTested_EvtInfo_AutoCreatedDemEvent_EcuMConfiguration_ECUM_E_RAM_CHECK_FAILED
          OpEventGetEventExtendedDataRecordEx_GetEventExtendedDataRecordEx_EvtInfo_AutoCreatedDemEvent_EcuMConfiguration_ECUM_E_C_96bd3475: RteEventRef=OpEventGetEventExtendedDataRecordEx_GetEventExtendedDataRecordEx_EvtInfo_AutoCreatedDemEvent_EcuMConfiguration_ECUM_E_C_96bd3475
          OpEventGetEventEnableCondition_GetEventEnableCondition_EvtInfo_AutoCreatedDemEvent_EcuMConfiguration_ECUM_E_ALL_RUN_REQ_5b1f807c: RteEventRef=OpEventGetEventEnableCondition_GetEventEnableCondition_EvtInfo_AutoCreatedDemEvent_EcuMConfiguration_ECUM_E_ALL_RUN_REQ_5b1f807c
          OpEventGetEventEnableCondition_GetEventEnableCondition_EvtInfo_AutoCreatedDemEvent_EcuMConfiguration_ECUM_E_CONFIGURATI_06f5d14c: RteEventRef=OpEventGetEventEnableCondition_GetEventEnableCondition_EvtInfo_AutoCreatedDemEvent_EcuMConfiguration_ECUM_E_CONFIGURATI_06f5d14c
          OpEventGetEventUdsStatus_GetEventUdsStatus_EvtInfo_AutoCreatedDemEvent_EcuMConfiguration_ECUM_E_ALL_RUN_REQUESTS_KILLED: RteEventRef=OpEventGetEventUdsStatus_GetEventUdsStatus_EvtInfo_AutoCreatedDemEvent_EcuMConfiguration_ECUM_E_ALL_RUN_REQUESTS_KILLED
          OpEventGetEventFailed_GetEventFailed_EvtInfo_AutoCreatedDemEvent_EcuMConfiguration_ECUM_E_IMPROPER_CALLER: RteEventRef=OpEventGetEventFailed_GetEventFailed_EvtInfo_AutoCreatedDemEvent_EcuMConfiguration_ECUM_E_IMPROPER_CALLER
          OpEventGetFaultDetectionCounter_GetFaultDetectionCounter_EvtInfo_AutoCreatedDemEvent_EcuMConfiguration_ECUM_E_RAM_CHECK_FAILED: RteEventRef=OpEventGetFaultDetectionCounter_GetFaultDetectionCounter_EvtInfo_AutoCreatedDemEvent_EcuMConfiguration_ECUM_E_RAM_CHECK_FAILED
          OpEventGetEventExtendedDataRecordEx_GetEventExtendedDataRecordEx_EvtInfo_AutoCreatedDemEvent_EcuMConfiguration_ECUM_E_R_25bd882a: RteEventRef=OpEventGetEventExtendedDataRecordEx_GetEventExtendedDataRecordEx_EvtInfo_AutoCreatedDemEvent_EcuMConfiguration_ECUM_E_R_25bd882a
          OpEventGetFaultDetectionCounter_GetFaultDetectionCounter_EvtInfo_AutoCreatedDemEvent_EcuMConfiguration_ECUM_E_CONFIGURA_55d3b4f6: RteEventRef=OpEventGetFaultDetectionCounter_GetFaultDetectionCounter_EvtInfo_AutoCreatedDemEvent_EcuMConfiguration_ECUM_E_CONFIGURA_55d3b4f6
          OpEventGetEventUdsStatus_GetEventUdsStatus_EvtInfo_AutoCreatedDemEvent_EcuMConfiguration_ECUM_E_IMPROPER_CALLER: RteEventRef=OpEventGetEventUdsStatus_GetEventUdsStatus_EvtInfo_AutoCreatedDemEvent_EcuMConfiguration_ECUM_E_IMPROPER_CALLER
          OpEventGetDebouncingOfEvent_GetDebouncingOfEvent_EvtInfo_AutoCreatedDemEvent_EcuMConfiguration_ECUM_E_ALL_RUN_REQUESTS_KILLED: RteEventRef=OpEventGetDebouncingOfEvent_GetDebouncingOfEvent_EvtInfo_AutoCreatedDemEvent_EcuMConfiguration_ECUM_E_ALL_RUN_REQUESTS_KILLED
          OpEventGetDTCOfEvent_GetDTCOfEvent_EvtInfo_AutoCreatedDemEvent_EcuMConfiguration_ECUM_E_IMPROPER_CALLER: RteEventRef=OpEventGetDTCOfEvent_GetDTCOfEvent_EvtInfo_AutoCreatedDemEvent_EcuMConfiguration_ECUM_E_IMPROPER_CALLER
          OpEventGetEventUdsStatus_GetEventUdsStatus_EvtInfo_AutoCreatedDemEvent_EcuMConfiguration_ECUM_E_CONFIGURATION_DATA_INCONSISTENT: RteEventRef=OpEventGetEventUdsStatus_GetEventUdsStatus_EvtInfo_AutoCreatedDemEvent_EcuMConfiguration_ECUM_E_CONFIGURATION_DATA_INCONSISTENT
          OpEventGetDebouncingOfEvent_GetDebouncingOfEvent_EvtInfo_AutoCreatedDemEvent_EcuMConfiguration_ECUM_E_IMPROPER_CALLER: RteEventRef=OpEventGetDebouncingOfEvent_GetDebouncingOfEvent_EvtInfo_AutoCreatedDemEvent_EcuMConfiguration_ECUM_E_IMPROPER_CALLER
          OpEventGetEventFailed_GetEventFailed_Event_DTC_0x000002: RteEventRef=OpEventGetEventFailed_GetEventFailed_Event_DTC_0x000002
          OpEventGetEventFreezeFrameDataEx_GetEventFreezeFrameDataEx_Event_DTC_0x000002: RteEventRef=OpEventGetEventFreezeFrameDataEx_GetEventFreezeFrameDataEx_Event_DTC_0x000002
          OpEventGetFaultDetectionCounter_GetFaultDetectionCounter_EvtInfo_DTC_0x000002: RteEventRef=OpEventGetFaultDetectionCounter_GetFaultDetectionCounter_EvtInfo_DTC_0x000002
          OpEventGetEventFreezeFrameDataEx_GetEventFreezeFrameDataEx_EvtInfo_DTC_0x000002: RteEventRef=OpEventGetEventFreezeFrameDataEx_GetEventFreezeFrameDataEx_EvtInfo_DTC_0x000002
          OpEventGetEventFailed_GetEventFailed_EvtInfo_DTC_0x000002: RteEventRef=OpEventGetEventFailed_GetEventFailed_EvtInfo_DTC_0x000002
          OpEventGetEventTested_GetEventTested_Event_DTC_0x000002: RteEventRef=OpEventGetEventTested_GetEventTested_Event_DTC_0x000002
          OpEventGetEventExtendedDataRecordEx_GetEventExtendedDataRecordEx_Event_DTC_0x000002: RteEventRef=OpEventGetEventExtendedDataRecordEx_GetEventExtendedDataRecordEx_Event_DTC_0x000002
          OpEventGetMonitorStatus_GetMonitorStatus_EvtInfo_DTC_0x000002: RteEventRef=OpEventGetMonitorStatus_GetMonitorStatus_EvtInfo_DTC_0x000002
          OpEventGetEventStatus_GetEventStatus_EvtInfo_DTC_0x000002: RteEventRef=OpEventGetEventStatus_GetEventStatus_EvtInfo_DTC_0x000002
          OpEventGetEventUdsStatus_GetEventUdsStatus_EvtInfo_DTC_0x000002: RteEventRef=OpEventGetEventUdsStatus_GetEventUdsStatus_EvtInfo_DTC_0x000002
          OpEventGetDebouncingOfEvent_GetDebouncingOfEvent_EvtInfo_DTC_0x000002: RteEventRef=OpEventGetDebouncingOfEvent_GetDebouncingOfEvent_EvtInfo_DTC_0x000002
          OpEventGetEventUdsStatus_GetEventUdsStatus_Event_DTC_0x000002: RteEventRef=OpEventGetEventUdsStatus_GetEventUdsStatus_Event_DTC_0x000002
          OpEventSetEventStatus_SetEventStatus_Event_DTC_0x000002: RteEventRef=OpEventSetEventStatus_SetEventStatus_Event_DTC_0x000002
          OpEventGetDTCOfEvent_GetDTCOfEvent_Event_DTC_0x000002: RteEventRef=OpEventGetDTCOfEvent_GetDTCOfEvent_Event_DTC_0x000002
          OpEventResetEventStatus_ResetEventStatus_Event_DTC_0x000002: RteEventRef=OpEventResetEventStatus_ResetEventStatus_Event_DTC_0x000002
          OpEventGetEventTested_GetEventTested_EvtInfo_DTC_0x000002: RteEventRef=OpEventGetEventTested_GetEventTested_EvtInfo_DTC_0x000002
          OpEventGetEventEnableCondition_GetEventEnableCondition_EvtInfo_DTC_0x000002: RteEventRef=OpEventGetEventEnableCondition_GetEventEnableCondition_EvtInfo_DTC_0x000002
          OpEventResetEventDebounceStatus_ResetEventDebounceStatus_Event_DTC_0x000002: RteEventRef=OpEventResetEventDebounceStatus_ResetEventDebounceStatus_Event_DTC_0x000002
          OpEventGetDTCOfEvent_GetDTCOfEvent_EvtInfo_DTC_0x000002: RteEventRef=OpEventGetDTCOfEvent_GetDTCOfEvent_EvtInfo_DTC_0x000002
          OpEventGetFaultDetectionCounter_GetFaultDetectionCounter_Event_DTC_0x000002: RteEventRef=OpEventGetFaultDetectionCounter_GetFaultDetectionCounter_Event_DTC_0x000002
          OpEventGetEventExtendedDataRecordEx_GetEventExtendedDataRecordEx_EvtInfo_DTC_0x000002: RteEventRef=OpEventGetEventExtendedDataRecordEx_GetEventExtendedDataRecordEx_EvtInfo_DTC_0x000002
          OpEventGetEventStatus_GetEventStatus_Event_DTC_0x000002: RteEventRef=OpEventGetEventStatus_GetEventStatus_Event_DTC_0x000002
      CpSaDoorFrontRight_EcuSwComposition: RteSoftwareComponentInstanceRef=CpSaDoorFrontRight
        TMT_RCtSaDoorReadDoor (RteEventToTaskMapping):
          RteImmediateRestart = false
          RtePositionInTask = 2
          RteEventRef = TMT_RCtSaDoorReadDoor
          RteMappedToTaskRef = IO_Task
          RteUsedOsEventRef = Rte_Ev_Cyclic_IO_Task_0_200ms
          RteUsedOsAlarmRef = Rte_Al_TE_IO_Task_0_200ms
      CpSaDoorFrontLeft_EcuSwComposition: RteSoftwareComponentInstanceRef=CpSaDoorFrontLeft
        TMT_RCtSaDoorReadDoor (RteEventToTaskMapping):
          RteImmediateRestart = false
          RtePositionInTask = 3
          RteEventRef = TMT_RCtSaDoorReadDoor
          RteMappedToTaskRef = IO_Task
          RteUsedOsEventRef = Rte_Ev_Cyclic_IO_Task_0_200ms
          RteUsedOsAlarmRef = Rte_Al_TE_IO_Task_0_200ms
      CpSaInteriorLightFront_EcuSwComposition: RteSoftwareComponentInstanceRef=CpSaInteriorLightFront
        DRT_RCtSaInteriorLightSwitchLight_PpLightState_DeLightState (RteEventToTaskMapping):
          RteImmediateRestart = false
          RtePositionInTask = 8
          RteEventRef = DRT_RCtSaInteriorLightSwitchLight_PpLightState_DeLightState
          RteMappedToTaskRef = IO_Task
          RteUsedOsEventRef = Rte_Ev_Run_CpSaInteriorLightFront_RCtSaInteriorLightSwitchLight
      CpApMySwc_EcuSwComposition: RteSoftwareComponentInstanceRef=CpApMySwc
        6 x RteEventToTaskMapping, all with RteImmediateRestart=false, RteMappedToTaskRef=My_Task:
          TMT_RCtApMySwcCode: RtePositionInTask=1, RteEventRef=TMT_RCtApMySwcCode, RteUsedOsAlarmRef=Rte_Al_TE_CpApMySwc_RCtApMySwcCode, RteUsedOsEventRef=Rte_Ev_Run_CpApMySwc_RCtApMySwcCode
          CtApMySwc_InitEvent: RtePositionInTask=0, RteEventRef=CtApMySwc_InitEvent
          MST_RCtApMySwcComM_ModeChange_FULL_COMM_Exit_0: RtePositionInTask=2, RteEventRef=MST_RCtApMySwcComM_ModeChange_FULL_COMM_Exit_0, RteUsedOsEventRef=Rte_Ev_Run_CpApMySwc_RCtApMySwcComM_ModeChange_FULL_COMM_Exit
          MST_RCtApMySwcComM_ModeChange_FULL_COMM_Entry_0: RtePositionInTask=3, RteEventRef=MST_RCtApMySwcComM_ModeChange_FULL_COMM_Entry_0, RteUsedOsEventRef=Rte_Ev_Run_CpApMySwc_RCtApMySwcComM_ModeChange_FULL_COMM_Entry
          DRT_Runnable_PpMrpPShutdownTimerDisplayCtApMySwc_requestedMode: RtePositionInTask=4, RteEventRef=DRT_Runnable_PpMrpPShutdownTimerDisplayCtApMySwc_requestedMode, RteUsedOsEventRef=Rte_Ev_Run_CpApMySwc_RCtApMySwcPostRunCode
          MST_RCtApMySwcPostRunCode_0: RtePositionInTask=4, RteEventRef=MST_RCtApMySwcPostRunCode_0, RteUsedOsEventRef=Rte_Ev_Run1_CpApMySwc_RCtApMySwcPostRunCode
        ExArLightOnOffCounter (RteExclusiveAreaImplementation): RteExclusiveAreaImplMechanism=ALL_INTERRUPT_BLOCKING, RteExclusiveAreaRef=ExArLightOnOffCounter
        ExArOdometer (RteExclusiveAreaImplementation): RteExclusiveAreaImplMechanism=ALL_INTERRUPT_BLOCKING, RteExclusiveAreaRef=ExArOdometer
        NvmBlock_CpApMySwc_SnNvMPimLightOnOffCounter (RteNvRamAllocation):
          RteNvmRamBlockLocationSymbol = Rte_CpApMySwc_PimLightOnOffCounter
          RteNvmBlockRef = CpApMySwcSnNvMPimLightOnOffCounter
          RteSwNvRamMappingRef = SnNvMPimLightOnOffCounter
        NvmBlock_CpApMySwc_SnNvMPimOdometer (RteNvRamAllocation):
          RteNvmRamBlockLocationSymbol = Rte_CpApMySwc_PimOdometer
          RteNvmRomBlockLocationSymbol = Rte_CtApMySwc_CalOdometer
          RteNvmBlockRef = CpApMySwcSnNvMPimOdometer
          RteSwNvRamMappingRef = SnNvMPimOdometer
        6 x RteEventToTaskMapping, all with RteImmediateRestart=false:
          OIT_PpNvMNotifyJobFinishedOdometerCtApMySwc_JobFinished_PpNvMNotifyJobFinishedOdometerCtApMySwc_JobFinished: RteEventRef=OIT_PpNvMNotifyJobFinishedOdometerCtApMySwc_JobFinished_PpNvMNotifyJobFinishedOdometerCtApMySwc_JobFinished
          OIT_DataServices_Diag_RWDI_LightOnOffCounter_LightOnOffCounter_Value_ConditionCheckRead_DataServices_Diag_RWDI_LightOnOf2065F94A: RteEventRef=OIT_DataServices_Diag_RWDI_LightOnOffCounter_LightOnOffCounter_Value_ConditionCheckRead_DataServices_Diag_RWDI_LightOnOf2065F94A
          OIT_DataServices_Diag_RWDI_LightOnOffCounter_LightOnOffCounter_Value_WriteData_DataServices_Diag_RWDI_LightOnOffCounter_9798F8A6: RteEventRef=OIT_DataServices_Diag_RWDI_LightOnOffCounter_LightOnOffCounter_Value_WriteData_DataServices_Diag_RWDI_LightOnOffCounter_9798F8A6
          OIT_DataServices_Diag_RWDI_LightOnOffCounter_LightOnOffCounter_Value_ReadData_DataServices_Diag_RWDI_LightOnOffCounter_LBCB6C10A: RteEventRef=OIT_DataServices_Diag_RWDI_LightOnOffCounter_LightOnOffCounter_Value_ReadData_DataServices_Diag_RWDI_LightOnOffCounter_LBCB6C10A
          OIT_CBReadData_OccurrenceCounter_OccurenceCounter_ReadData_CBReadData_OccurrenceCounter_OccurenceCounter_ReadData: RteEventRef=OIT_CBReadData_OccurrenceCounter_OccurenceCounter_ReadData_CBReadData_OccurrenceCounter_OccurenceCounter_ReadData
          OIT_CBReadData_OdometerValue_OdometerValue_ReadData_CBReadData_OdometerValue_OdometerValue_ReadData: RteEventRef=OIT_CBReadData_OdometerValue_OdometerValue_ReadData_CBReadData_OdometerValue_OdometerValue_ReadData
    3 x RteSwComponentType:
      CtSaDoor: RteComponentTypeRef=CtSaDoor, RteImplementationRef=CtSaDoor_Implementation
        ComponentTypeCalibration (RteComponentTypeCalibration): RteCalibrationSupportEnabled=false
      CtSaInteriorLight: RteComponentTypeRef=CtSaInteriorLight, RteImplementationRef=CtSaInteriorLight_Implementation
        ComponentTypeCalibration (RteComponentTypeCalibration): RteCalibrationSupportEnabled=false
      CtApMySwc: RteComponentTypeRef=CtApMySwc, RteImplementationRef=CtApMySwc_Implementation
        ComponentTypeCalibration (RteComponentTypeCalibration): RteCalibrationSupportEnabled=false
    NvM_EcuSwComposition (RteSwComponentInstance): RteSoftwareComponentInstanceRef=NvM
      23 x RteEventToTaskMapping, all with RteImmediateRestart=false:
        Timer_NvM_MainFunction: RtePositionInTask=0, RteEventRef=Timer_NvM_MainFunction, RteUsedOsEventRef=Rte_Ev_Cyclic2_SchM_Task_0_10ms, RteUsedOsAlarmRef=Rte_Al_TE2_SchM_Task_0_10ms, RteMappedToTaskRef=SchM_Task
        OpEventGetErrorStatus_GetErrorStatus_PS_NvMConfigBlock: RteEventRef=OpEventGetErrorStatus_GetErrorStatus_PS_NvMConfigBlock
        OpEventReadBlock_ReadBlock_PS_NvMConfigBlock: RteEventRef=OpEventReadBlock_ReadBlock_PS_NvMConfigBlock
        OpEventWriteBlock_WriteBlock_PS_NvMConfigBlock: RteEventRef=OpEventWriteBlock_WriteBlock_PS_NvMConfigBlock
        OpEventSetBlockProtection_SetBlockProtection_PAdmin_NvMConfigBlock: RteEventRef=OpEventSetBlockProtection_SetBlockProtection_PAdmin_NvMConfigBlock
        OpEventEraseBlock_EraseBlock_PS_NvMConfigBlock: RteEventRef=OpEventEraseBlock_EraseBlock_PS_NvMConfigBlock
        OpEventSetRamBlockStatus_SetRamBlockStatus_PS_NvMConfigBlock: RteEventRef=OpEventSetRamBlockStatus_SetRamBlockStatus_PS_NvMConfigBlock
        OpEventInvalidateNvBlock_InvalidateNvBlock_PS_NvMConfigBlock: RteEventRef=OpEventInvalidateNvBlock_InvalidateNvBlock_PS_NvMConfigBlock
        OpEventSetRamBlockStatus_SetRamBlockStatus_PS_CpApMySwcSnNvMPimLightOnOffCounter: RteEventRef=OpEventSetRamBlockStatus_SetRamBlockStatus_PS_CpApMySwcSnNvMPimLightOnOffCounter
        OpEventWriteBlock_WriteBlock_PS_CpApMySwcSnNvMPimLightOnOffCounter: RteEventRef=OpEventWriteBlock_WriteBlock_PS_CpApMySwcSnNvMPimLightOnOffCounter
        OpEventGetErrorStatus_GetErrorStatus_PS_CpApMySwcSnNvMPimOdometer: RteEventRef=OpEventGetErrorStatus_GetErrorStatus_PS_CpApMySwcSnNvMPimOdometer
        OpEventGetErrorStatus_GetErrorStatus_PS_CpApMySwcSnNvMPimLightOnOffCounter: RteEventRef=OpEventGetErrorStatus_GetErrorStatus_PS_CpApMySwcSnNvMPimLightOnOffCounter
        OpEventEraseBlock_EraseBlock_PS_CpApMySwcSnNvMPimOdometer: RteEventRef=OpEventEraseBlock_EraseBlock_PS_CpApMySwcSnNvMPimOdometer
        OpEventWriteBlock_WriteBlock_PS_CpApMySwcSnNvMPimOdometer: RteEventRef=OpEventWriteBlock_WriteBlock_PS_CpApMySwcSnNvMPimOdometer
        OpEventSetBlockProtection_SetBlockProtection_PAdmin_CpApMySwcSnNvMPimLightOnOffCounter: RteEventRef=OpEventSetBlockProtection_SetBlockProtection_PAdmin_CpApMySwcSnNvMPimLightOnOffCounter
        OpEventEraseBlock_EraseBlock_PS_CpApMySwcSnNvMPimLightOnOffCounter: RteEventRef=OpEventEraseBlock_EraseBlock_PS_CpApMySwcSnNvMPimLightOnOffCounter
        OpEventReadBlock_ReadBlock_PS_CpApMySwcSnNvMPimOdometer: RteEventRef=OpEventReadBlock_ReadBlock_PS_CpApMySwcSnNvMPimOdometer
        OpEventInvalidateNvBlock_InvalidateNvBlock_PS_CpApMySwcSnNvMPimOdometer: RteEventRef=OpEventInvalidateNvBlock_InvalidateNvBlock_PS_CpApMySwcSnNvMPimOdometer
        OpEventSetRamBlockStatus_SetRamBlockStatus_PS_CpApMySwcSnNvMPimOdometer: RteEventRef=OpEventSetRamBlockStatus_SetRamBlockStatus_PS_CpApMySwcSnNvMPimOdometer
        OpEventReadBlock_ReadBlock_PS_CpApMySwcSnNvMPimLightOnOffCounter: RteEventRef=OpEventReadBlock_ReadBlock_PS_CpApMySwcSnNvMPimLightOnOffCounter
        OpEventInvalidateNvBlock_InvalidateNvBlock_PS_CpApMySwcSnNvMPimLightOnOffCounter: RteEventRef=OpEventInvalidateNvBlock_InvalidateNvBlock_PS_CpApMySwcSnNvMPimLightOnOffCounter
        OpEventSetBlockProtection_SetBlockProtection_PAdmin_CpApMySwcSnNvMPimOdometer: RteEventRef=OpEventSetBlockProtection_SetBlockProtection_PAdmin_CpApMySwcSnNvMPimOdometer
        OpEventRestoreBlockDefaults_RestoreBlockDefaults_PS_CpApMySwcSnNvMPimOdometer: RteEventRef=OpEventRestoreBlockDefaults_RestoreBlockDefaults_PS_CpApMySwcSnNvMPimOdometer
    3 x RteBswModuleInstance:
      Fee: RteBswImplementationRef=Fee_Impl, RteBswModuleConfigurationRef=Fee
        Fee_MainFunctionTimingEvent0 (RteBswEventToTaskMapping):
          RteBswImmediateRestart = false
          RteBswPositionInTask = 1
          RteBswEventRef = Fee_MainFunctionTimingEvent0
          RteBswMappedToTaskRef = SchM_Task
          RteBswUsedOsEventRef = Rte_Ev_Cyclic2_SchM_Task_0_5ms
          RteBswUsedOsAlarmRef = Rte_Al_TE2_SchM_Task_0_5ms
        FEE_EXCLUSIVE_AREA_0 (RteBswExclusiveAreaImpl): RteExclusiveAreaImplMechanism=ALL_INTERRUPT_BLOCKING, RteBswExclusiveAreaRef=FEE_EXCLUSIVE_AREA_0
      Fls: RteBswImplementationRef=Fls_Impl, RteBswModuleConfigurationRef=Fls
        Fls_MainFunctionTimingEvent0 (RteBswEventToTaskMapping):
          RteBswImmediateRestart = false
          RteBswPositionInTask = 2
          RteBswEventRef = Fls_MainFunctionTimingEvent0
          RteBswMappedToTaskRef = SchM_Task
          RteBswUsedOsEventRef = Rte_Ev_Cyclic2_SchM_Task_0_10ms
          RteBswUsedOsAlarmRef = Rte_Al_TE2_SchM_Task_0_10ms
      NvM: RteBswImplementationRef=NvM_Impl, RteBswModuleConfigurationRef=NvM
        NvM_MainFunctionTimingEvent0 (RteBswEventToTaskMapping):
          RteBswImmediateRestart = false
          RteBswPositionInTask = 0
          RteBswEventRef = NvM_MainFunctionTimingEvent0
          RteBswUsedOsEventRef = Rte_Ev_Cyclic2_SchM_Task_0_10ms
          RteBswUsedOsAlarmRef = Rte_Al_TE2_SchM_Task_0_10ms
          RteBswMappedToTaskRef = SchM_Task
        NVM_EXCLUSIVE_AREA_0 (RteBswExclusiveAreaImpl): RteExclusiveAreaImplMechanism=ALL_INTERRUPT_BLOCKING, RteBswExclusiveAreaRef=NVM_EXCLUSIVE_AREA_0
    CpCddIoHwAb_EcuSwComposition (RteSwComponentInstance): RteSoftwareComponentInstanceRef=CpCddIoHwAb
      8 x RteEventToTaskMapping, all with RteImmediateRestart=false:
        OIT_PpDoorFrontLeft_ReadChannel_PpDoorFrontLeft_ReadChannel: RtePositionInTask=2, RteEventRef=OIT_PpDoorFrontLeft_ReadChannel_PpDoorFrontLeft_ReadChannel
        OIT_PpInteriorLightFront_WriteChannel_PpInteriorLightFront_WriteChannel: RtePositionInTask=9, RteEventRef=OIT_PpInteriorLightFront_WriteChannel_PpInteriorLightFront_WriteChannel
        OIT_PpDoorFrontRight_ReadChannel_PpDoorFrontRight_ReadChannel: RtePositionInTask=4, RteEventRef=OIT_PpDoorFrontRight_ReadChannel_PpDoorFrontRight_ReadChannel
        OIT_PpInteriorLightFrontDEFECT_ReadChannel_PpInteriorLightFrontDEFECT_ReadChannel: RtePositionInTask=6, RteEventRef=OIT_PpInteriorLightFrontDEFECT_ReadChannel_PpInteriorLightFrontDEFECT_ReadChannel
        OIT_RCtCddIoHwAb_PpDisplayState_ReadChannel_PpDisplayState_ReadChannel: RtePositionInTask=0, RteEventRef=OIT_RCtCddIoHwAb_PpDisplayState_ReadChannel_PpDisplayState_ReadChannel
        OIT_RCtCddIoHwAb_PpDisplayState_WriteChannel_PpDisplayState_WriteChannel: RtePositionInTask=1, RteEventRef=OIT_RCtCddIoHwAb_PpDisplayState_WriteChannel_PpDisplayState_WriteChannel
        OIT_RCtCddIoHwAb_PpLocalClamp15_ReadChannel_PpLocalClamp15_ReadChannel: RtePositionInTask=10, RteEventRef=OIT_RCtCddIoHwAb_PpLocalClamp15_ReadChannel_PpLocalClamp15_ReadChannel
        OIT_RCtCddIoHwAb_PpLocalClamp15_WriteChannel_PpLocalClamp15_WriteChannel: RtePositionInTask=11, RteEventRef=OIT_RCtCddIoHwAb_PpLocalClamp15_WriteChannel_PpLocalClamp15_WriteChannel
    CtCddIoHwAb (RteSwComponentType): RteComponentTypeRef=CtCddIoHwAb, RteImplementationRef=CtCddIoHwAb_Implementation
      ComponentTypeCalibration (RteComponentTypeCalibration): RteCalibrationSupportEnabled=false
    CpSaDisplay_EcuSwComposition (RteSwComponentInstance): RteSoftwareComponentInstanceRef=CpSaDisplay
      5 x RteEventToTaskMapping, all with RteImmediateRestart=false, RteMappedToTaskRef=IO_Task:
        DRT_RCtApDisplayBusStateHandling_PiDisplayState_DeDisplayBusState: RtePositionInTask=4, RteEventRef=DRT_RCtApDisplayBusStateHandling_PiDisplayState_DeDisplayBusState, RteUsedOsEventRef=Rte_Ev_Run_CpSaDisplay_RCtApDisplayBusStateHandling
        DRT_RCtApDisplayLightOnOffHandling_PiDisplayState_DeLightOnOffCounter: RtePositionInTask=5, RteEventRef=DRT_RCtApDisplayLightOnOffHandling_PiDisplayState_DeLightOnOffCounter, RteUsedOsEventRef=Rte_Ev_Run_CpSaDisplay_RCtApDisplayLightOnOffHandling
        DRT_RCtApDisplayOdometerValue_PiDisplayState_DeOdometerValue: RtePositionInTask=6, RteEventRef=DRT_RCtApDisplayOdometerValue_PiDisplayState_DeOdometerValue, RteUsedOsEventRef=Rte_Ev_Run_CpSaDisplay_RCtApDisplayOdometerValue
        DRT_RCtApDisplayOdometerWriteRequestPending_PiDisplayState_DeOdometerWriteRequestPending: RtePositionInTask=7, RteEventRef=DRT_RCtApDisplayOdometerWriteRequestPending_PiDisplayState_DeOdometerWriteRequestPending, RteUsedOsEventRef=Rte_Ev_Run_CpSaDisplay_RCtApDisplayOdometerWriteRequestPending
        TMT_RCtApDisplayReadIgnitionSignal: RtePositionInTask=0, RteEventRef=TMT_RCtApDisplayReadIgnitionSignal, RteUsedOsEventRef=Rte_Ev_Cyclic_IO_Task_0_200ms, RteUsedOsAlarmRef=Rte_Al_TE_IO_Task_0_200ms
    CtSaDisplay (RteSwComponentType): RteComponentTypeRef=CtSaDisplay, RteImplementationRef=CtSaDisplay_Implementation
      ComponentTypeCalibration (RteComponentTypeCalibration): RteCalibrationSupportEnabled=false
    Dcm_EcuSwComposition (RteSwComponentInstance): RteSoftwareComponentInstanceRef=Dcm
      7 x RteEventToTaskMapping, all with RteImmediateRestart=false:
        Timer_Dcm_MainFunction: RtePositionInTask=16, RteEventRef=Timer_Dcm_MainFunction, RteMappedToTaskRef=SchM_Task, RteUsedOsEventRef=Rte_Ev_Cyclic2_SchM_Task_0_10ms, RteUsedOsAlarmRef=Rte_Al_TE2_SchM_Task_0_10ms
        OpEventGetActiveProtocol_GetActiveProtocol_DCMServices: RteEventRef=OpEventGetActiveProtocol_GetActiveProtocol_DCMServices
        OpEventGetSesCtrlType_GetSesCtrlType_DCMServices: RteEventRef=OpEventGetSesCtrlType_GetSesCtrlType_DCMServices
        OpEventResetToDefaultSession_ResetToDefaultSession_DCMServices: RteEventRef=OpEventResetToDefaultSession_ResetToDefaultSession_DCMServices
        OpEventGetSecurityLevel_GetSecurityLevel_DCMServices: RteEventRef=OpEventGetSecurityLevel_GetSecurityLevel_DCMServices
        OpEventSetActiveDiagnostic_SetActiveDiagnostic_DCMServices: RteEventRef=OpEventSetActiveDiagnostic_SetActiveDiagnostic_DCMServices
        OpEventGetRequestKind_GetRequestKind_DCMServices: RteEventRef=OpEventGetRequestKind_GetRequestKind_DCMServices
    3 x RteBswModuleInstance:
      Dem: RteBswImplementationRef=Dem_Impl, RteBswModuleConfigurationRef=Dem
        Dem_MasterMainFunctionTimingEvent0 (RteBswEventToTaskMapping):
          RteBswImmediateRestart = false
          RteBswPositionInTask = 12
          RteBswEventRef = Dem_MasterMainFunctionTimingEvent0
          RteBswMappedToTaskRef = SchM_Task
          RteBswUsedOsEventRef = Rte_Ev_Cyclic2_SchM_Task_0_10ms
          RteBswUsedOsAlarmRef = Rte_Al_TE2_SchM_Task_0_10ms
        Dem_SatelliteMainFunctionTimingEvent0 (RteBswEventToTaskMapping):
          RteBswImmediateRestart = false
          RteBswPositionInTask = 13
          RteBswEventRef = Dem_SatelliteMainFunctionTimingEvent0
          RteBswMappedToTaskRef = SchM_Task
          RteBswUsedOsEventRef = Rte_Ev_Cyclic2_SchM_Task_0_10ms
          RteBswUsedOsAlarmRef = Rte_Al_TE2_SchM_Task_0_10ms
        4 x RteBswExclusiveAreaImpl, all with RteExclusiveAreaImplMechanism=ALL_INTERRUPT_BLOCKING:
          DEM_EXCLUSIVE_AREA_{0..3}: RteBswExclusiveAreaRef=DEM_EXCLUSIVE_AREA_{0..3}
      CanTp: RteBswImplementationRef=CanTp_Impl, RteBswModuleConfigurationRef=CanTp
        CanTp_MainFunctionTimingEvent0 (RteBswEventToTaskMapping):
          RteBswImmediateRestart = false
          RteBswPositionInTask = 15
          RteBswEventRef = CanTp_MainFunctionTimingEvent0
          RteBswMappedToTaskRef = SchM_Task
          RteBswUsedOsEventRef = Rte_Ev_Cyclic2_SchM_Task_0_5ms
          RteBswUsedOsAlarmRef = Rte_Al_TE2_SchM_Task_0_5ms
        CANTP_EXCLUSIVE_AREA_0 (RteBswExclusiveAreaImpl): RteExclusiveAreaImplMechanism=ALL_INTERRUPT_BLOCKING, RteBswExclusiveAreaRef=CANTP_EXCLUSIVE_AREA_0
      Dcm: RteBswImplementationRef=Dcm_Impl, RteBswModuleConfigurationRef=Dcm
        Dcm_MainFunctionTimingEvent0 (RteBswEventToTaskMapping):
          RteBswImmediateRestart = false
          RteBswPositionInTask = 16
          RteBswEventRef = Dcm_MainFunctionTimingEvent0
          RteBswMappedToTaskRef = SchM_Task
          RteBswUsedOsEventRef = Rte_Ev_Cyclic2_SchM_Task_0_10ms
          RteBswUsedOsAlarmRef = Rte_Al_TE2_SchM_Task_0_10ms
        DCM_EXCLUSIVE_AREA_0 (RteBswExclusiveAreaImpl): RteExclusiveAreaImplMechanism=ALL_INTERRUPT_BLOCKING, RteBswExclusiveAreaRef=DCM_EXCLUSIVE_AREA_0
