AUTOSAR XML (schema 4-2-1)
package /ActiveEcuC
  module config EcuM: implementation-config-variant=VARIANT-PRE-COMPILE, module-description=EcuM_Impl
    EcuMGeneral:
      EcuMDevErrorDetect = true
      EcuMIncludeDem = false
      EcuMIncludeDet = true
      EcuMMainFunctionPeriod = 0.01
      EcuMVersionInfoApi = false
      EcuMDeferredBswMNotification = false
      EcuMSlaveCoreHandling = false
      EcuMEnableFixBehavior = false
      EcuMGeneration: EcuMOutOfBoundsWriteSanitizer=false, EcuMOutOfBoundsReadSanitizer=false, EcuMInterfacesForDeactivatedData=false
    EcuMFlexGeneral: EcuMAlarmClockPresent=false, EcuMResetLoopDetection=false, EcuMEnableDefBehaviour=false
    EcuMConfiguration
      EcuMFlexConfiguration: EcuMFlexModuleConfigurationRef=CanConfigSet, EcuMNormalMcuModeRef=NORMAL
        ECUM_RESET_WDG (EcuMResetMode): EcuMResetModeId=1
        ECUM_CAUSE_DCM (EcuMShutdownCause): EcuMShutdownCauseId=3
        ECUM_CAUSE_UNKNOWN (EcuMShutdownCause): EcuMShutdownCauseId=0
        ECUM_RESET_IO (EcuMResetMode): EcuMResetModeId=2
        ECUM_RESET_MCU (EcuMResetMode): EcuMResetModeId=0
        ECUM_CAUSE_WDGM (EcuMShutdownCause): EcuMShutdownCauseId=2
        ECUM_RESET_WAKEUP (EcuMResetMode): EcuMResetModeId=3
        ECUM_CAUSE_ECU_STATE (EcuMShutdownCause): EcuMShutdownCauseId=1
        EcuMFlexUserConfig: EcuMGoDownRequestID=42, EcuMFlexUser=0
        EcuMGoDownAllowedUsers: EcuMGoDownAllowedUserRef=EcuMFlexUserConfig
      EcuMCommonConfiguration: EcuMConfigConsistencyHash=228133751307707412, EcuMDefaultAppMode=OSDEFAULTAPPMODE, EcuMOSResource=OsResource
        EcuMDefaultShutdownTarget: EcuMDefaultState=EcuMStateReset, EcuMDefaultResetModeRef=ECUM_RESET_MCU
        5 x EcuMWakeupSource, all with EcuMValidationTimeout=0, EcuMCheckWakeupTimeout=0, EcuMWakeupSourcePolling=false, EcuMResetReasonRef=McuResetReasonConf:
          ECUM_WKSOURCE_POWER: EcuMWakeupSourceId=0
          ECUM_WKSOURCE_INTERNAL_RESET: EcuMWakeupSourceId=2
          ECUM_WKSOURCE_INTERNAL_WDG: EcuMWakeupSourceId=3
          ECUM_WKSOURCE_RESET: EcuMWakeupSourceId=1
          ECUM_WKSOURCE_EXTERNAL_WDG: EcuMWakeupSourceId=4
        EcuMSleepMode:
          EcuMSleepModeId = 0
          EcuMSleepModeMcuModeRef = SLEEP
          EcuMWakeupSourceMask = ECUM_WKSOURCE_EXTERNAL_WDG
          EcuMWakeupSourceMask = ECUM_WKSOURCE_INTERNAL_RESET
          EcuMWakeupSourceMask = ECUM_WKSOURCE_INTERNAL_WDG
          EcuMWakeupSourceMask = ECUM_WKSOURCE_POWER
          EcuMWakeupSourceMask = ECUM_WKSOURCE_RESET
        EcuMDriverInitListOne
          EcuMDriverInitItem: EcuMModuleID=Code, EcuMAdditionalInitCode=BswInitListOne();
        EcuMDemEventParameterRefs:
          ECUM_E_ALL_RUN_REQUESTS_KILLED = AutoCreatedDemEvent_EcuMConfiguration_ECUM_E_ALL_RUN_REQUESTS_KILLED
          ECUM_E_CONFIGURATION_DATA_INCONSISTENT = AutoCreatedDemEvent_EcuMConfiguration_ECUM_E_CONFIGURATION_DATA_INCONSISTENT
          ECUM_E_RAM_CHECK_FAILED = AutoCreatedDemEvent_EcuMConfiguration_ECUM_E_RAM_CHECK_FAILED
          ECUM_E_IMPROPER_CALLER = AutoCreatedDemEvent_EcuMConfiguration_ECUM_E_IMPROPER_CALLER
        EcuMDriverRestartList
        ECUM_WKSOURCE_CAN (EcuMWakeupSource): EcuMWakeupSourceId=5, EcuMWakeupSourcePolling=false, EcuMComMChannelRef=CAN00_f26020e5
        CAN00_f26020e5 (EcuMWakeupSource): EcuMWakeupSourceId=6, EcuMWakeupSourcePolling=false, EcuMComMChannelRef=CAN00_f26020e5  # CN_CAN00
