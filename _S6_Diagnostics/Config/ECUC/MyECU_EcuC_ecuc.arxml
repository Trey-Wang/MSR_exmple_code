AUTOSAR XML (schema 4-2-1)
package /ActiveEcuC
  module config EcuC: implementation-config-variant=VARIANT-PRE-COMPILE, module-description=EcuC_Impl
    EcucPduCollection: PduIdTypeEnum=UINT8, PduLengthTypeEnum=UINT16
      17 x Pdu, all with J1939Requestable=false:
        msg_Transmit_ca20852c: PduLength=1, SysTPduToFrameMappingRef=msg_Transmit
        msg_nm_RearECU_721237f7: PduLength=8, SysTPduToFrameMappingRef=msg_nm_RearECU
        msg_nm_MyECU_5fb848b3: PduLength=8, SysTPduToFrameMappingRef=msg_nm_MyECU  # msg_nm_MyECU_oCAN00
        msg_Receive_ff2f8fca: PduLength=1, SysTPduToFrameMappingRef=msg_Receive
        CAN00_NmRxPdu_f26020e5: PduLength=8
        MyECU_NmRxPdu_5faa4e95: PduLength=8, SysTPduToFrameMappingRef=msg_nm_RearECU
        PT_msg_diag_RequestGlobal_PP_msg_diag_RequestGlobal_Rx_0fb271d2_5e566ad9: PduLength=7  # msg_diag_RequestGlobal_oCAN00
        PT_msg_diag_Request_MyECU_PP_msg_diag_Request_MyECU_Rx_0fb271d2_5e566ad9: PduLength=8  # msg_diag_Request_MyECU_oCAN00
        PT_msg_diag_Response_MyECU_PP_msg_diag_Response_MyECU_Tx_0fb271d2_5e566ad9: PduLength=8  # msg_diag_Response_MyECU_oCAN00
        msg_diag_RequestGlobal_Tp_4e10fc23: PduLength=8, SysTPduToFrameMappingRef=msg_diag_RequestGlobal_Tp
        msg_diag_Request_MyECU_Tp_fec7ea51: PduLength=8, SysTPduToFrameMappingRef=msg_diag_Request_MyECU_Tp
        msg_diag_Response_MyECU_Tp_4167da22: PduLength=8, SysTPduToFrameMappingRef=msg_diag_Response_MyECU_Tp
        PT_msg_diag_RequestGlobal_Tp_PP_msg_diag_RequestGlobal_Tp_Rx_0fb271d2_5e566ad9: PduLength=8, SysTPduToFrameMappingRef=msg_diag_RequestGlobal_Tp  # msg_diag_RequestGlobal_Tp_oCAN00
        PT_msg_Receive_PP_msg_Receive_Rx_0fb271d2_5e566ad9: PduLength=1, SysTPduToFrameMappingRef=msg_Receive  # msg_Receive_oCAN00
        PT_msg_diag_Request_MyECU_Tp_PP_msg_diag_Request_MyECU_Tp_Rx_0fb271d2_5e566ad9: PduLength=8, SysTPduToFrameMappingRef=msg_diag_Request_MyECU_Tp  # msg_diag_Request_MyECU_Tp_oCAN00
        PT_msg_Transmit_PP_msg_Transmit_Tx_0fb271d2_5e566ad9: PduLength=1, SysTPduToFrameMappingRef=msg_Transmit  # msg_Transmit_oCAN00
        PT_msg_diag_Response_MyECU_Tp_PP_msg_diag_Response_MyECU_Tp_Tx_0fb271d2_5e566ad9: PduLength=8, SysTPduToFrameMappingRef=msg_diag_Response_MyECU_Tp  # msg_diag_Response_MyECU_Tp_oCAN00
    EcucGeneral:
      CPUType = CPU32Bit
      SizeOfInt = Size32Bit
      ByteOrder = LITTLE_ENDIAN
      AtomicBitAccessInBitfield = false
      AtomicVariableAccess = Atomic32BitAccess
      BitOrder = LSB_to_MSB
      SizeOfEnum = Size16Bit
      SizeOfROMPointer = Size32Bit
      SizeOfRAMPointer = Size32Bit
      BitFieldDataType = INT
      StructAlignment = Auto
      ArrayAlignment = Auto
      StructInArrayAlignment = Auto
      DummyFunction = false
      EcuCSafeBswChecks = false
      DummyStatement = false
      DummyStatementKind = SelfAssignment
      ConditionalGenerating = true
      EcucBswImplementationCodeType = EcuCSourceCode
      EcuCUseStdReturnTypeForRte = true
      PostbuildLoadable: AlignmentFillPattern=0, PBROMStartAddress=0, PBRAMStartAddress=0, PBROMEndAddress=0, PBRAMEndAddress=0
      BswInitialization
        35 x InitFunction:
          BswM_Init: Header=BswM.h, InitPhase=NO_INIT, ConfigType=BswM_ConfigType, ConfigPtrName=BswM_Config_Ptr, ConfigPtrClass=BSWM_INIT_DATA, ModuleRef=BswM
          BswM_InitMemory: Header=BswM.h, InitPhase=INIT_MEMORY, ModuleRef=BswM
          Can_InitMemory: Header=Can.h, InitPhase=INIT_MEMORY, ModuleRef=Can
          Can_Init: Header=Can.h, InitPhase=INIT_TWO_DRV, ConfigType=Can_ConfigType, ConfigPtrName=Can_Config_Ptr, ConfigPtrClass=CAN_INIT_DATA, ModuleRef=Can
          CanIf_InitMemory: Header=CanIf.h, InitPhase=INIT_MEMORY, ModuleRef=CanIf
          CanIf_Init: Header=CanIf.h, InitPhase=INIT_TWO_IF, ConfigType=CanIf_ConfigType, ConfigPtrName=CanIf_Config_Ptr, ConfigPtrClass=CANIF_INIT_DATA, ModuleRef=CanIf
          CanNm_InitMemory: Header=CanNm.h, InitPhase=INIT_MEMORY, ModuleRef=CanNm
          CanNm_Init: Header=CanNm.h, InitPhase=INIT_TWO_NM, ConfigType=CanNm_ConfigType, ConfigPtrName=CanNm_Config_Ptr, ConfigPtrClass=CANNM_INIT_DATA, ModuleRef=CanNm
          CanSM_InitMemory: Header=CanSM_EcuM.h, InitPhase=INIT_MEMORY, ModuleRef=CanSM
          CanSM_Init: Header=CanSM_EcuM.h, InitPhase=INIT_TWO_SM, ConfigType=CanSM_ConfigType, ConfigPtrName=CanSM_Config_Ptr, ConfigPtrClass=CANSM_INIT_DATA, ModuleRef=CanSM
          Com_Init: Header=Com.h, InitPhase=INIT_TWO_COM, ConfigType=Com_ConfigType, ConfigPtrName=Com_Config_Ptr, ConfigPtrClass=COM_INIT_DATA, ModuleRef=Com
          Com_InitMemory: Header=Com.h, InitPhase=INIT_MEMORY, ModuleRef=Com
          ComM_InitMemory: Header=ComM.h, InitPhase=INIT_MEMORY, ModuleRef=ComM
          ComM_Init: Header=ComM.h, InitPhase=INIT_TWO_POST_NVMREADALL, ModuleRef=ComM
          Det_Init: Header=Det.h, InitPhase=INIT_ZERO, ConfigType=Det_ConfigType, ConfigPtrName=Det_Config_Ptr, ConfigPtrClass=DET_INIT_DATA, ModuleRef=Det
          Det_InitMemory: Header=Det.h, InitPhase=INIT_MEMORY, ModuleRef=Det
          EcuM_Init: Header=EcuM.h, InitPhase=NO_INIT, ConfigType=EcuM_PbConfigType, ConfigPtrName=EcuM_Config_Ptr, ConfigPtrClass=ECUM_INIT_DATA, ModuleRef=EcuM
          Mcu_Init: Header=Mcu.h, InitPhase=INIT_TWO_MCAL, ConfigType=Mcu_ConfigType, ConfigPtrName=McuModuleConfiguration, ConfigPtrClass=MCU_APPL_CONST, ModuleRef=Mcu
          Nm_InitMemory: Header=Nm.h, InitPhase=INIT_MEMORY, ModuleRef=Nm
          Nm_Init: Header=Nm.h, InitPhase=INIT_TWO_NM, ModuleRef=Nm
          PduR_Init: Header=PduR.h, InitPhase=INIT_TWO_COM, ConfigType=PduR_PBConfigType, ConfigPtrName=PduR_Config_Ptr, ConfigPtrClass=PDUR_INIT_DATA, ModuleRef=PduR
          PduR_InitMemory: Header=PduR.h, InitPhase=INIT_MEMORY, ModuleRef=PduR
          SchM_Init: Header=Rte_Main.h, InitPhase=NO_INIT, ModuleRef=Rte
          Rte_InitMemory: Header=Rte_Main.h, InitPhase=INIT_MEMORY, ModuleRef=Rte
          Dio_Init: Header=Dio.h, InitPhase=INIT_TWO_MCAL, ConfigType=Dio_ConfigType, ConfigPtrName=DioConfig, ConfigPtrClass=DIO_APPL_CONST, ModuleRef=Dio
          Fee_Init: Header=Fee.h, InitPhase=INIT_TWO_IF, ModuleRef=Fee
          Fls_Init: Header=Fls.h, InitPhase=INIT_TWO_MCAL, ConfigType=Fls_ConfigType, ConfigPtrName=FlsConfigSet, ConfigPtrClass=FLS_APPL_CONST, ModuleRef=Fls
          NvM_Init: Header=NvM.h, InitPhase=INIT_TWO_SYS, ModuleRef=NvM
          Dem_PreInit: Header=Dem.h, InitPhase=INIT_ZERO, ConfigType=Dem_ConfigType, ConfigPtrName=Dem_Config_Ptr, ConfigPtrClass=DEM_INIT_DATA, ModuleRef=Dem
          Dem_Init: Header=Dem.h, InitPhase=INIT_TWO_POST_NVMREADALL, ConfigType=Dem_ConfigType, ConfigPtrName=Dem_Config_Ptr, ConfigPtrClass=DEM_INIT_DATA, ModuleRef=Dem
          Dem_InitMemory: Header=Dem.h, InitPhase=INIT_MEMORY, ModuleRef=Dem
          CanTp_InitMemory: Header=CanTp.h, InitPhase=INIT_MEMORY, ModuleRef=CanTp
          CanTp_Init: Header=CanTp.h, InitPhase=INIT_TWO_TP, ConfigType=CanTp_ConfigType, ConfigPtrName=CanTp_Config_Ptr, ConfigPtrClass=CANTP_INIT_DATA, ModuleRef=CanTp
          Dcm_InitMemory: Header=Dcm.h, InitPhase=INIT_MEMORY, ModuleRef=Dcm
          Dcm_Init: Header=Dcm.h, InitPhase=INIT_TWO_POST_NVMREADALL, ConfigType=Dcm_ConfigType, ConfigPtrName=NULL_PTR, ConfigPtrClass=DCM_CONST, ModuleRef=Dcm
    EcucHardware
      EcucCoreDefinition: EcucCoreId=0
