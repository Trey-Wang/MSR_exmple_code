AUTOSAR XML (schema 4-2-1)
package /ActiveEcuC
  module config Os: implementation-config-variant=VARIANT-PRE-COMPILE, module-description=Os_Impl
    OsPublishedInformation: OsKernelVersion=7, OsPlatformName=VTT
      VTT (OsDerivativeInformation): OsExceptionVectorTableAlignment=0, OsInterruptVectorTableAlignment=0, OsHardwareManuals=N/A, OsMpuAlignment=0, OsStackAlignment=0
        OsSystemIntCtrl: OsSystemIntCtrlPrioOrder=ASC, OsSystemIntCtrlMaxPrios=200, OsSystemIntCtrlBaseAddress=0, OsSystemIntCtrlMaxSources=10000
        STM0 (OsHardwareTimer): OsHardwareTimerUnit=STM, OsHardwareTimerHighResPossible=true, OsHardwareTimerId=0, OsHardwareTimerSize=32, OsHardwareTimerBaseAddress=0
          STM0_Ch0 (OsHardwareTimerChannel): OsHardwareTimerChannelId=0, OsHardwareTimerChannelIntSource=0, OsHardwareTimerChannelOffset=0
        PIT0 (OsHardwareTimer):
          OsHardwareTimerUnit = PIT
          OsHardwareTimerHighResPossible = false
          OsHardwareTimerId = 0
          OsHardwareTimerSize = 32
          OsHardwareTimerBaseAddress = 0
          OsHardwareTimerType = HardwareTimer
          PIT0_Ch0 (OsHardwareTimerChannel): OsHardwareTimerChannelId=0, OsHardwareTimerChannelIntSource=0, OsHardwareTimerChannelOffset=0
        OsPhysicalCore0 (OsPhysicalCore):
          OsPhysicalCoreId = 0
          OsPhysicalCoreExceptionSources = 0
          OsPhysicalCoreIsAutostart = false
          OsPhysicalCoreMasterStartAllowed = false
          OsPhysicalCorePrivelegedHwAccess = false
    OS_APPMODE_ANY (OsAppMode)
    OSDEFAULTAPPMODE (OsAppMode)
    OsOS:
      OsGenerateMemMap = EMPTY
      OsGenerateMemMapForThreads = false
      OsStackMonitoring = true
      OsStatus = STANDARD
      OsUseGetServiceId = false
      OsUseParameterAccess = false
      OsUseResScheduler = false
      OsForcibleTermination = false
      OsGenerateCalloutStubs = true
      OsGenerateMemMapForNearAddressing = true
      OsServiceProtection = false
      OsStackUsageMeasurement = false
      OsUseXSignalAsyncApiCalls = false
      OsScalabilityClass = SC1
      OsNumberOfCores = 1
      OsMasterCore = OsCore
      OsSystemTimer = SystemTimer
      OsHooks: OsErrorHook=true, OsPostTaskHook=false, OsPreTaskHook=false, OsShutdownHook=false, OsStartupHook=false
    SystemTimer (OsCounter):
      OsCounterMaxAllowedValue = 2147483647
      OsCounterMinCycle = 1
      OsCounterType = HARDWARE
      OsSecondsPerTick = 0.001
      OsCounterTicksPerBase = 1
      OsCounterAccessingApplication = SystemApplication_OsCore
      OsDriver: OsDriverHighResolution=false, OsDriverHardwareTimerChannelRef=PIT0_Ch0, OsDriverIsrRef=CounterIsr_SystemTimer
    OsResource: OsResourceProperty=STANDARD, OsResourceAccessingApplication=SystemApplication_OsCore
    OsCore:
      OsCoreIsAutostart = true
      OsCoreIsAutosar = true
      OsCorePhysicalCoreRef = OsPhysicalCore0
      OsCoreEcucCoreRef = EcucCoreDefinition
      OsCoreIdleTask = IdleTask_OsCore
      OsCoreSystemApplication = SystemApplication_OsCore
      OsCoreStacks:
        OsCoreKernelStackSize = 1024
        OsCoreStartupStackSize = 1024
        OsCoreShutdownStackSize = 1024
        OsCoreErrorStackSize = 1024
        OsCoreProtectionStackSize = 1024
        OsCoreInitStackSize = 1024
    IdleTask_OsCore (OsTask):
      OsTaskActivation = 1
      OsTaskPriority = 4294967295
      OsTaskSchedule = FULL
      OsTaskStackSharing = false
      OsTaskStackSize = 1024
      OsTaskType = AUTO
      OsTaskAccessingApplication = SystemApplication_OsCore
      OsTaskResourceRef = OsResource
      OsTaskAutostart: OsTaskAppModeRef=OS_APPMODE_ANY, OsTaskAppModeRef=OSDEFAULTAPPMODE
    SystemApplication_OsCore (OsApplication):
      OsTrusted = true
      OsTrustedApplicationDelayTimingViolationCall = false
      OsTrustedApplicationWithProtection = false
      OsApplicationIsPrivileged = true
      OsAppUseTrustedFunctionStubs = false
      OsApplicationCoreRef = EcucCoreDefinition
      OsAppTaskRef = IdleTask_OsCore
      OsAppCounterRef = SystemTimer
      OsAppTaskRef = SchM_Task
      OsAppAlarmRef = Rte_Al_TE2_SchM_Task_0_10ms
      OsAppAlarmRef = Rte_Al_TE2_SchM_Task_0_20ms
      OsAppAlarmRef = Rte_Al_TE2_SchM_Task_0_5ms
      OsAppTaskRef = My_Task
      OsAppTaskRef = IO_Task
      OsAppAlarmRef = Rte_Al_TE_IO_Task_0_200ms
      OsAppTaskRef = Init_Task
      OsAppIsrRef = CounterIsr_SystemTimer
      OsAppAlarmRef = Rte_Al_TE_CpApMySwc_RCtApMySwcCode
      OsApplicationHooks: OsAppErrorHook=false, OsAppShutdownHook=false, OsAppStartupHook=false
    SchM_Task (OsTask):
      OsTaskActivation = 1
      OsTaskPriority = 6
      OsTaskSchedule = FULL
      OsTaskStackSharing = false
      OsTaskStackSize = 1024
      OsTaskType = EXTENDED
      OsTaskAccessingApplication = SystemApplication_OsCore
      OsTaskEventRef = Rte_Ev_Cyclic2_SchM_Task_0_10ms
      OsTaskEventRef = Rte_Ev_Cyclic2_SchM_Task_0_20ms
      OsTaskEventRef = Rte_Ev_Cyclic2_SchM_Task_0_5ms
    Rte_Al_TE2_SchM_Task_0_10ms (OsAlarm): OsAlarmCounterRef=SystemTimer, OsAlarmAccessingApplication=SystemApplication_OsCore
      OsAlarmAction
        OsAlarmSetEvent: OsAlarmSetEventRef=Rte_Ev_Cyclic2_SchM_Task_0_10ms, OsAlarmSetEventTaskRef=SchM_Task
    Rte_Al_TE2_SchM_Task_0_20ms (OsAlarm): OsAlarmCounterRef=SystemTimer, OsAlarmAccessingApplication=SystemApplication_OsCore
      OsAlarmAction
        OsAlarmSetEvent: OsAlarmSetEventRef=Rte_Ev_Cyclic2_SchM_Task_0_20ms, OsAlarmSetEventTaskRef=SchM_Task
    Rte_Ev_Cyclic2_SchM_Task_0_10ms (OsEvent)
    Rte_Ev_Cyclic2_SchM_Task_0_20ms (OsEvent)
    My_Task (OsTask):
      OsTaskActivation = 1
      OsTaskPriority = 3
      OsTaskSchedule = NON
      OsTaskStackSharing = false
      OsTaskStackSize = 1024
      OsTaskType = EXTENDED
      OsTaskAccessingApplication = SystemApplication_OsCore
      OsTaskEventRef = Rte_Ev_Run_CpApMySwc_RCtApMySwcCode
      OsTaskEventRef = Rte_Ev_Run_CpApMySwc_RCtApMySwcComM_ModeChange_FULL_COMM_Entry
      OsTaskEventRef = Rte_Ev_Run_CpApMySwc_RCtApMySwcComM_ModeChange_FULL_COMM_Exit
      OsTaskEventRef = Rte_Ev_Run1_CpApMySwc_RCtApMySwcPostRunCode
      OsTaskEventRef = Rte_Ev_Run_CpApMySwc_RCtApMySwcPostRunCode
    IO_Task (OsTask):
      OsTaskActivation = 1
      OsTaskPriority = 2
      OsTaskSchedule = NON
      OsTaskStackSharing = false
      OsTaskStackSize = 1024
      OsTaskType = EXTENDED
      OsTaskAccessingApplication = SystemApplication_OsCore
      OsTaskEventRef = Rte_Ev_Cyclic_IO_Task_0_200ms
      OsTaskEventRef = Rte_Ev_Run_CpSaInteriorLightFront_RCtSaInteriorLightSwitchLight
      OsTaskEventRef = Rte_Ev_Run_CpSaDisplay_RCtApDisplayBusStateHandling
      OsTaskEventRef = Rte_Ev_Run_CpSaDisplay_RCtApDisplayLightOnOffHandling
      OsTaskEventRef = Rte_Ev_Run_CpSaDisplay_RCtApDisplayOdometerValue
      OsTaskEventRef = Rte_Ev_Run_CpSaDisplay_RCtApDisplayOdometerWriteRequestPending
    Rte_Al_TE_IO_Task_0_200ms (OsAlarm): OsAlarmCounterRef=SystemTimer, OsAlarmAccessingApplication=SystemApplication_OsCore
      OsAlarmAction
        OsAlarmSetEvent: OsAlarmSetEventRef=Rte_Ev_Cyclic_IO_Task_0_200ms, OsAlarmSetEventTaskRef=IO_Task
    Rte_Ev_Cyclic_IO_Task_0_200ms (OsEvent)
    Rte_Ev_Run_CpSaInteriorLightFront_RCtSaInteriorLightSwitchLight (OsEvent)
    Init_Task (OsTask):
      OsTaskActivation = 1
      OsTaskPriority = 4
      OsTaskSchedule = NON
      OsTaskStackSharing = false
      OsTaskStackSize = 1024
      OsTaskType = BASIC
      OsTaskAccessingApplication = SystemApplication_OsCore
      OsTaskAutostart: OsTaskAppModeRef=OSDEFAULTAPPMODE
    CounterIsr_SystemTimer (OsIsr):
      OsIsrCategory = CATEGORY_2
      OsIsrInterruptType = EXTERNAL
      OsIsrInterruptSource = 1
      OsIsrInterruptPriority = 1
      OsIsrStackSize = 1024
      OsIsrEnableNesting = false
      OsIsrSpecialFunctionName = Os_TimerPitIsr
    Rte_Al_TE_CpApMySwc_RCtApMySwcCode (OsAlarm): OsAlarmCounterRef=SystemTimer, OsAlarmAccessingApplication=SystemApplication_OsCore
      OsAlarmAction
        OsAlarmSetEvent: OsAlarmSetEventRef=Rte_Ev_Run_CpApMySwc_RCtApMySwcCode, OsAlarmSetEventTaskRef=My_Task
    9 x OsEvent:
      Rte_Ev_Run_CpSaDisplay_RCtApDisplayBusStateHandling
      Rte_Ev_Run_CpSaDisplay_RCtApDisplayLightOnOffHandling
      Rte_Ev_Run_CpSaDisplay_RCtApDisplayOdometerValue
      Rte_Ev_Run_CpSaDisplay_RCtApDisplayOdometerWriteRequestPending
      Rte_Ev_Run_CpApMySwc_RCtApMySwcCode
      Rte_Ev_Run_CpApMySwc_RCtApMySwcComM_ModeChange_FULL_COMM_Entry
      Rte_Ev_Run_CpApMySwc_RCtApMySwcComM_ModeChange_FULL_COMM_Exit
      Rte_Ev_Run1_CpApMySwc_RCtApMySwcPostRunCode
      Rte_Ev_Run_CpApMySwc_RCtApMySwcPostRunCode
    Rte_Al_TE2_SchM_Task_0_5ms (OsAlarm): OsAlarmCounterRef=SystemTimer, OsAlarmAccessingApplication=SystemApplication_OsCore
      OsAlarmAction
        OsAlarmSetEvent: OsAlarmSetEventRef=Rte_Ev_Cyclic2_SchM_Task_0_5ms, OsAlarmSetEventTaskRef=SchM_Task
    Rte_Ev_Cyclic2_SchM_Task_0_5ms (OsEvent)
