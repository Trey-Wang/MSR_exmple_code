AUTOSAR XML (schema 4-2-1)
package /ActiveEcuC
  module config VTTCntrl: implementation-config-variant=VARIANT-PRE-COMPILE, module-description=VTTCntrl_Impl
    VttGeneral:
      VttPreferredInputAsrVersion = 4.2.1
      VttRequiredEcucGeneratorVersion = 1.0
      VttEntryPointName = main
      VttHeaderFile = 
      VttUserCalloutOnStateChange = true
      VttDllName = MyECU.dll
    VttSystemVariables
      3 x VttSysVarType:
        sint64
        float64
        uint64
      Display (VttSysVarNamespace)
      3 x VttSysVar, all with VttSysVarInstanceTypeRef=uint64, VttSysVarNamespaceRef=Display:
        Display_LightOnOffCounter
        Display_Odometer
        Display_OdometerWriteReqPending
