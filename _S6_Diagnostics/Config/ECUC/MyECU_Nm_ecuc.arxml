AUTOSAR XML (schema 4-2-1)
package /ActiveEcuC
  module config Nm: implementation-config-variant=VARIANT-PRE-COMPILE, module-description=Nm_Impl
    NmGlobalConfig
      NmGlobalFeatures:
        NmNodeIdEnabled = true
        NmUserDataEnabled = true
        NmBusSynchronizationEnabled = false
        NmCarWakeUpRxEnabled = false
        NmComControlEnabled = false
        NmComUserDataSupport = false
        NmCoordinatorSupportEnabled = false
        NmNodeDetectionEnabled = false
        NmPduRxIndicationEnabled = false
        NmRemoteSleepIndEnabled = false
        NmRepeatMsgIndEnabled = false
        NmStateChangeIndEnabled = false
        NmMacroLayerEnabled = false
        NmCoordinatorSyncSupport = false
        NmRuntimeMeasurementSupport = false
        NmCoordinatorRequestChannelsInBusSleep = false
        NmCoordinatorPassiveStartUpForwarding = false
      NmGlobalConstants: NmNumberOfChannels=1
      NmGlobalProperties: NmDevErrorDetect=true, NmVersionInfoApi=false, NmSafeBswChecks=true, NmCycletimeMainFunction=0.01
      NmGeneration:
        NmOutOfBoundsWriteSanitizer = false
        NmOutOfBoundsReadSanitizer = false
        NmShortSymbols = false
        NmInterfacesForDeactivatedData = false
        NmReferringKeysInComments = false
    CAN00_f26020e5 (NmChannelConfig):  # CN_CAN00
      NmChannelId = 0
      NmChannelSleepMaster = false
      NmStateReportEnabled = false
      NmSynchronizingNetwork = false
      NmPassiveModeEnabled = false
      NmComMChannelRef = CAN00_f26020e5
      CAN00_CAN_17d0077e (NmBusType)
        NmStandardBusNmConfig: NmStandardBusType=NM_BUSNM_CANNM  # CAN00_CAN
