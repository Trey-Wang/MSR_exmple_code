AUTOSAR XML (schema 4-2-1)
package /ActiveEcuC
  module config ComM: implementation-config-variant=VARIANT-PRE-COMPILE, module-description=ComM_Impl
    ComMGeneral:
      ComMPncIdCounting = COMM_PNC_ID_COUNT_FROM_NM_MESSAGE
      ComMPncSupport = false
      ComMDevErrorDetect = true
      ComMEcuGroupClassification = 3
      ComMModeLimitationEnabled = false
      ComMSynchronousWakeUp = true
      ComMTMinFullComModeDuration = 5
      ComMVersionInfoApi = true
      ComMWakeupInhibitionEnabled = false
      ComMSafeBswChecks = false
      ComMOperationGetInhibitionStatusEnabled = false
      ComMPncExtendedFunctionalityEnabled = false
      ComMPncGatewayEnabled = false
      ComMPncToChannelRoutingLimitationEnabled = false
      ComMGeneration: ComMOutOfBoundsWriteSanitizer=false, ComMOutOfBoundsReadSanitizer=false
    ComMConfigSet: ComMPncEnabled=false
      CAN00_f26020e5 (ComMChannel):  # CN_CAN00
        ComMBusType = COMM_BUS_TYPE_CAN
        ComMChannelId = 0
        ComMFullCommRequestNotificationEnabled = false
        ComMMainFunctionPeriod = 0.02
        ComMNoCom = false
        ComMNoWakeup = false
        ComMNetworkManagement: ComMNmVariant=FULL, ComMPncNmRequest=true
        CHNL_f276589c (ComMUserPerChannel): ComMUserChannel=USR_INTERIOR_LIGHT  # CN_CAN00
      USR_INTERIOR_LIGHT (ComMUser): ComMUserIdentifier=0, ComMUserModeNotification=true
      USR_CHNL_f276589c (ComMUser): ComMUserIdentifier=1, ComMUserModeNotification=false  # CN_CAN00
