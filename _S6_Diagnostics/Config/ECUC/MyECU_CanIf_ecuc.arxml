AUTOSAR XML (schema 4-2-1)
package /ActiveEcuC
  module config CanIf: implementation-config-variant=VARIANT-PRE-COMPILE, module-description=CanIf_Impl
    CanIfPrivateCfg:
      CanIfPrivateSoftwareFilterType = LINEAR
      CanIfPrivateDlcCheck = true
      CanIfSupportTTCAN = false
      CanIfTransceiverMapping = false
      CanIfTransceiverHandling = false
      CanIfSupportExtendedIds = false
      CanIfSupportNmOsek = false
      CanIfTxBufferType = BYTE_QUEUE
      CanIfOptimizeOneController = true
      CanIfWakeupSupport = true
      CanIfStaticFdTxBufferSupport = false
      CanIfRxSearchConsiderMsgType = false
      CanIfMultipleBasicCANTxObjects = false
      CanIfTxBufferFifoSupport = false
      CanIfSetPduReceptionModeSupport = false
      CanIfDataChecksumRxSupport = false
      CanIfDataChecksumTxSupport = false
    CanIfPublicCfg:
      CanIfPublicPnSupport = false
      CanIfPublicCancelTransmitSupport = false
      CanIfPublicDevErrorDetect = true
      CanIfPublicHandleTypeEnum = UINT8
      CanIfPublicMultipleDrvSupport = false
      CanIfPublicNumberOfCanHwUnits = 1
      CanIfPublicReadRxPduDataApi = false
      CanIfPublicReadRxPduNotifyStatusApi = false
      CanIfPublicReadTxPduNotifyStatusApi = false
      CanIfPublicSetDynamicTxIdApi = false
      CanIfPublicTxBuffering = true
      CanIfPublicTxConfirmPollingSupport = false
      CanIfPublicVersionInfoApi = true
      CanIfPublicWakeupCheckValidSupport = false
      CanIfPnWakeupTxPduFilterSupport = false
      CanIfPnTrcvHandlingSupport = false
      CanIfJ1939DynAddrSupport = DISABLED
      CanIfSafeBswChecks = false
      CanIfSetBaudrateApi = false
      CanIfPublicChangeBaudrateSupport = false
    CanIfInitCfg: CanIfInitCfgSet=dummy
      CanIfInitHohCfg: CanIfInitRefCfgSet=CanConfigSet
        CN_CAN00_e98c47e6_Rx_Std (CanIfHrhCfg): CanIfHrhSoftwareFilter=true, CanIfHrhCanCtrlIdRef=CT_CAN00_e98c47e6, CanIfHrhIdSymRef=CN_CAN00_e98c47e6_Rx_Std
        CN_CAN00_e98c47e6_Tx (CanIfHthCfg): CanIfHthCanCtrlIdRef=CT_CAN00_e98c47e6, CanIfHthIdSymRef=CN_CAN00_e98c47e6_Tx
      msg_nm_MyECU_oCAN00_Tx_3abd61be (CanIfTxPduCfg):
        CanIfTxPduCanId = 1024
        CanIfTxPduCanIdType = STANDARD_CAN
        CanIfTxPduDlc = 8
        CanIfTxPduUserTxConfirmationName = CanNm_TxConfirmation
        CanIfTxPduUserTxConfirmationUL = CAN_NM
        CanIfTxPduId = 1
        CanIfTxPduReadNotifyStatus = false
        CanIfTxPduType = STATIC
        CanIfTxPduBufferRef = CanIfBufferCfg_0fb271d2
        CanIfTxPduRef = msg_nm_MyECU_5fb848b3
      msg_Receive_oCAN00_Rx_3abd61be (CanIfRxPduCfg):
        CanIfRxPduCanId = 528
        CanIfRxPduCanIdType = STANDARD_CAN
        CanIfRxPduDlc = 1
        CanIfRxPduUserRxIndicationName = PduR_CanIfRxIndication
        CanIfRxPduUserRxIndicationUL = PDUR
        CanIfRxPduId = 3
        CanIfRxPduReadData = false
        CanIfRxPduReadNotifyStatus = false
        CanIfRxPduDlcCheck = true
        CanIfRxPduHrhIdRef = CN_CAN00_e98c47e6_Rx_Std
        CanIfRxPduRef = PT_msg_Receive_PP_msg_Receive_Rx_0fb271d2_5e566ad9
      msg_Transmit_oCAN00_Tx_3abd61be (CanIfTxPduCfg):
        CanIfTxPduCanId = 512
        CanIfTxPduCanIdType = STANDARD_CAN
        CanIfTxPduDlc = 1
        CanIfTxPduUserTxConfirmationName = NULL_PTR
        CanIfTxPduUserTxConfirmationUL = NONE
        CanIfTxPduId = 2
        CanIfTxPduReadNotifyStatus = false
        CanIfTxPduType = STATIC
        CanIfTxPduBufferRef = CanIfBufferCfg_0fb271d2
        CanIfTxPduRef = PT_msg_Transmit_PP_msg_Transmit_Tx_0fb271d2_5e566ad9
      MyECU_5faa4e95_NMCanIDRange (CanIfRxPduCfg):
        CanIfRxPduCanIdType = STANDARD_CAN
        CanIfRxPduDlc = 8
        CanIfRxPduUserRxIndicationName = CanNm_RxIndication
        CanIfRxPduUserRxIndicationUL = CAN_NM
        CanIfRxPduId = 0
        CanIfRxPduReadData = false
        CanIfRxPduReadNotifyStatus = false
        CanIfRxPduDlcCheck = true
        CanIfRxPduHrhIdRef = CN_CAN00_e98c47e6_Rx_Std
        CanIfRxPduRef = MyECU_NmRxPdu_5faa4e95
        CHNL (CanIfRxPduCanIdRange): CanIfRxPduCanIdRangeLowerCanId=1024, CanIfRxPduCanIdRangeUpperCanId=1087
      CanIfBufferCfg_0fb271d2 (CanIfBufferCfg):  # CHNL
        CanIfBufferSize = 3
        CanIfTxBufferHandlingType = PRIO_BY_CANID
        CanIfTxBufferMappedTxPdus = 3
        CanIfTxBufferMaxPduLength = 8
        CanIfBufferHthRef = CN_CAN00_e98c47e6_Tx
      msg_diag_Response_MyECU_Tp_oCAN00_Tx_3abd61be (CanIfTxPduCfg):
        CanIfTxPduCanId = 1554
        CanIfTxPduCanIdType = STANDARD_CAN
        CanIfTxPduDlc = 8
        CanIfTxPduUserTxConfirmationName = CanTp_TxConfirmation
        CanIfTxPduUserTxConfirmationUL = CAN_TP
        CanIfTxPduId = 0
        CanIfTxPduReadNotifyStatus = false
        CanIfTxPduType = STATIC
        CanIfTxPduBufferRef = CanIfBufferCfg_0fb271d2
        CanIfTxPduRef = PT_msg_diag_Response_MyECU_Tp_PP_msg_diag_Response_MyECU_Tp_Tx_0fb271d2_5e566ad9
      msg_diag_RequestGlobal_Tp_oCAN00_Rx_3abd61be (CanIfRxPduCfg):
        CanIfRxPduCanId = 1556
        CanIfRxPduCanIdType = STANDARD_CAN
        CanIfRxPduDlc = 8
        CanIfRxPduUserRxIndicationName = CanTp_RxIndication
        CanIfRxPduUserRxIndicationType = PDUID_PDUINFOPTR
        CanIfRxPduUserRxIndicationUL = CAN_TP
        CanIfRxPduId = 1
        CanIfRxPduReadData = false
        CanIfRxPduReadNotifyStatus = false
        CanIfRxPduDlcCheck = true
        CanIfRxPduHrhIdRef = CN_CAN00_e98c47e6_Rx_Std
        CanIfRxPduRef = PT_msg_diag_RequestGlobal_Tp_PP_msg_diag_RequestGlobal_Tp_Rx_0fb271d2_5e566ad9
      msg_diag_Request_MyECU_Tp_oCAN00_Rx_3abd61be (CanIfRxPduCfg):
        CanIfRxPduCanId = 1552
        CanIfRxPduCanIdType = STANDARD_CAN
        CanIfRxPduDlc = 8
        CanIfRxPduUserRxIndicationName = CanTp_RxIndication
        CanIfRxPduUserRxIndicationType = PDUID_PDUINFOPTR
        CanIfRxPduUserRxIndicationUL = CAN_TP
        CanIfRxPduId = 2
        CanIfRxPduReadData = false
        CanIfRxPduReadNotifyStatus = false
        CanIfRxPduDlcCheck = true
        CanIfRxPduHrhIdRef = CN_CAN00_e98c47e6_Rx_Std
        CanIfRxPduRef = PT_msg_diag_Request_MyECU_Tp_PP_msg_diag_Request_MyECU_Tp_Rx_0fb271d2_5e566ad9
    CanIfDispatchCfg:
      CanIfDispatchUserCtrlBusOffName = CanSM_ControllerBusOff
      CanIfDispatchUserCtrlBusOffUL = CAN_SM
      CanIfDispatchUserCtrlModeIndicationName = CanSM_ControllerModeIndication
      CanIfDispatchUserCtrlModeIndicationUL = CAN_SM
    Can (CanIfCtrlDrvCfg): CanIfCtrlDrvTxCancellation=false, CanIfCtrlDrvInitHohConfigRef=CanIfInitHohCfg, CanIfCtrlDrvNameRef=CanGeneral
      CT_CAN00_e98c47e6 (CanIfCtrlCfg): CanIfCtrlId=0, CanIfCtrlWakeupSupport=true, CanIfCtrlJ1939DynAddrSupport=DISABLED, CanIfCtrlCanCtrlRef=CT_CAN00_e98c47e6
