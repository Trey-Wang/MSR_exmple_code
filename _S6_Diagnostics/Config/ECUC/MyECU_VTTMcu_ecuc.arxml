AUTOSAR XML (schema 4-2-1)
package /ActiveEcuC
  module config VTTMcu: implementation-config-variant=VARIANT-PRE-COMPILE, module-description=VTTMcu_Impl
    McuGeneralConfiguration:
      McuDevErrorDetect = true
      McuGetRamStateApi = false
      McuInitClock = true
      McuNoPll = true
      McuPerformResetApi = true
      McuVersionInfoApi = true
      McuSafeBswChecks = false
    McuPublishedInformation
      McuResetReasonConf: McuResetReason=0
    McuModuleConfiguration
      4 x McuModeSettingConf:
        SLEEP: McuMode=1, McuVttMode=VTTMCU_MODE_SLEEP
        RESET: McuMode=2, McuVttMode=VTTMCU_MODE_RESET
        NORMAL: McuMode=0, McuVttMode=VTTMCU_MODE_NORMAL
        POWER_OFF: McuMode=3, McuVttMode=VTTMCU_MODE_POWER_OFF
      McuClockSettingConfig
        McuClockReferencePoint: McuClockReferencePointFrequency=80000000
