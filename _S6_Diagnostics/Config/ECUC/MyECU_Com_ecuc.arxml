AUTOSAR XML (schema 4-2-1)
package /ActiveEcuC
  module config Com: implementation-config-variant=VARIANT-PRE-COMPILE, module-description=Com_Impl
    ComConfig: ComConfigurationId=0, ComRxDeferredNotificationCacheSize=0, ComRxImmediateNotificationCacheSize=0
      ComTimeBase: ComRxTimeBase=0.01, ComTxTimeBase=0.01, ComGwTimeBase=0.01, ComTxCycleCounterTimeBase=0.1
      MyECU_oCAN00_Tx_fcef2243 (ComIPduGroup): ComIPduGroupHandleId=1
      MyECU_oCAN00_Rx_fcef2243 (ComIPduGroup): ComIPduGroupHandleId=0
      msg_Receive_oCAN00_3abd61be (ComIPdu):
        ComIPduDirection = RECEIVE
        ComIPduType = NORMAL
        ComIPduHandleId = 0
        ComIPduSignalProcessing = DEFERRED
        ComIPduCancellationSupport = false
        ComIPduGroupRef = MyECU_oCAN00_Rx_fcef2243
        ComIPduSignalRef = sig_State_RearInteriorLight_2b456e3f
        ComIPduSignalRef = sig_State_RearLeftDoor_2b456e3f
        ComIPduSignalRef = sig_State_RearRightDoor_2b456e3f
        ComPduIdRef = PT_msg_Receive_PP_msg_Receive_Rx_0fb271d2_5e566ad9
      sig_State_RearLeftDoor_2b456e3f (ComSignal):
        ComBitPosition = 0
        ComBitSize = 1
        ComSignalEndianness = LITTLE_ENDIAN
        ComSignalInitValue = 0
        ComSignalType = UINT8
        ComTimeout = 0
        ComSignalAccess = ACCESS_NEEDED_BY_SWC_OR_COM
        ComHandleId = 0
        ComSystemTemplateSystemSignalRef = sig_State_RearLeftDoor
      msg_Transmit_oCAN00_3abd61be (ComIPdu):
        ComIPduDirection = SEND
        ComIPduType = NORMAL
        ComIPduHandleId = 0
        ComIPduSignalProcessing = DEFERRED
        ComIPduCancellationSupport = false
        ComIPduGroupRef = MyECU_oCAN00_Tx_fcef2243
        ComIPduSignalRef = sig_RearInteriorLight_0723e95e
        ComPduIdRef = PT_msg_Transmit_PP_msg_Transmit_Tx_0fb271d2_5e566ad9
        ComTxIPdu: ComMinimumDelayTime=0, ComTxIPduUnusedAreasDefault=0
          ComTxModeTrue
            ComTxMode: ComTxModeMode=PERIODIC, ComTxModeTimeOffset=0, ComTxModeTimePeriod=0.1
          ComTxModeFalse
            ComTxMode: ComTxModeMode=PERIODIC, ComTxModeTimeOffset=0, ComTxModeTimePeriod=0.1
      3 x ComSignal, all with ComBitSize=1, ComSignalEndianness=LITTLE_ENDIAN, ComSignalInitValue=0, ComSignalType=UINT8:
        sig_RearInteriorLight_0723e95e: ComBitPosition=0, ComTransferProperty=PENDING, ComSignalAccess=ACCESS_NEEDED_BY_SWC_OR_COM, ComHandleId=0, ComSystemTemplateSystemSignalRef=sig_RearInteriorLight
        sig_State_RearRightDoor_2b456e3f: ComBitPosition=1, ComTimeout=0, ComSignalAccess=ACCESS_NEEDED_BY_SWC_OR_COM, ComHandleId=1, ComSystemTemplateSystemSignalRef=sig_State_RearRightDoor
        sig_State_RearInteriorLight_2b456e3f: ComBitPosition=2, ComTimeout=0, ComSignalAccess=ACCESS_NOT_NEEDED, ComSystemTemplateSystemSignalRef=sig_State_RearInteriorLight
    ComGeneral:
      ComConfigurationUseDet = true
      ComEnableSignalGroupArrayApi = false
      ComRetryFailedTransmitRequests = false
      ComSupportedIPduGroups = 2
      ComVersionInfoApi = false
      ComAdvancedIPduCallouts = false
      ComOptimizedIPduGroupHandling = false
      ComMetaDataSupport = false
      ComReceiveSignalMacroAPI = false
      ComDeferredEventCacheSupport = false
      ComMainfunctionTimingDomainSupport = true
      ComDescriptionRoutingCodeGeneration = false
      ComSafeBswChecks = false
    ComGeneration:
      ComOutOfBoundsWriteProtectionStrategy = NONE
      ComOutOfBoundsWriteSanitizer = false
      ComOutOfBoundsReadSanitizer = false
      ComReduceConstantData2Define = false
      ComBoolDataInArrayOfStructStrategy = BOOLEAN
      ComDeduplicateIndirectedData = true
      ComDataDeduplicationStrategy = WITH_CAST
      ComReduceBoolDataByNegationThreshold = 2
      ComReduceBoolDataByNumericalComparisonThreshold = 2
      ComReduceBoolDataByNumericalRelationThreshold = 2
      ComReduceBoolDataByNumericalOperandStrategy = WITH_ANY_VALUE
      ComReduceNumericalDataByOffsetThreshold = 2
      ComReduceNumericalDataByArraySubtractionThreshold = 2
      ComReduceDataByStreaming = false
      ComShortSymbols = false
      ComInterfacesForDeactivatedData = false
      ComReferringKeysInComments = false
    ComOptimization:
      ComTxCyclicProcessingISRLockThreshold = 1
      ComTxDeadlineMonitoringISRLockThreshold = 1
      ComTxProcessingISRLockThreshold = 1
      ComRxDeadlineMonitoringISRLockThreshold = 1
      ComRxDeferredProcessingISRLockThreshold = 1
      ComGatewayProcessingISRLockThreshold = 1
      ComGatewayDescriptionProcessingISRLockThreshold = 1
      ComIPduGroupISRLockThreshold = 1
