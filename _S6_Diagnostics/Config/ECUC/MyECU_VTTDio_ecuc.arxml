AUTOSAR XML (schema 4-2-1)
package /ActiveEcuC
  module config VTTDio: implementation-config-variant=VARIANT-PRE-COMPILE, module-description=VTTDio_Impl
    DioGeneral: DioDevErrorDetect=true, DioFlipChannelApi=false, DioVersionInfoApi=false, DioSafeBswChecks=true
    DioConfig
      DioPort: DioPortId=0
        4 x DioChannel:
          env_InteriorLightFront: DioChannelId=0
          env_DoorFrontLeft: DioChannelId=1
          env_DoorFrontRight: DioChannelId=2
          env_InteriorLightFrontDEFECT: DioChannelId=3
        DioChannelGroup: DioPortMask=1, DioPortOffset=0
        env_DisplayBusAwake (DioChannel): DioChannelId=4
        env_LocalClamp15 (DioChannel): DioChannelId=5
