AUTOSAR XML (schema 4-2-1)
package /ActiveEcuC
  ecuc value collection ActiveEcuC: ecu-extract=SYSTEM
    ecuc-values:
      Rte
      Os
      VTTCntrl
      VTTCan
      VTTEcuC
      VTTMcu
      VTTOs
      VTTDio
      CanIf
      CanNm
      CanSM
      Can
      ComM
      Com
      Crc
      Det
      EcuC
      EcuM
      Mcu
      Nm
      PduR
      Dio
      Fee
      Fls
      MemIf
      NvM
      VTTFls
      BswM
      Dem
      CanTp
      Dcm
