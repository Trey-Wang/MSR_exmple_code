AUTOSAR XML (schema 4-2-1)
package /ActiveEcuC
  module config VTTEcuC: implementation-config-variant=VARIANT-PRE-COMPILE, module-description=VTTEcuC_Impl
    EcucGeneral:
      ByteOrder = LITTLE_ENDIAN
      AtomicBitAccessInBitfield = false
      AtomicVariableAccess = Atomic32BitAccess
      CPUType = CPU32Bit
      SizeOfInt = Size32Bit
      BitOrder = LSB_to_MSB
      SizeOfEnum = Size32Bit
      SizeOfROMPointer = Size32Bit
      SizeOfRAMPointer = Size32Bit
      BitFieldDataType = INT
      StructAlignment = Auto
      ArrayAlignment = Auto
      StructInArrayAlignment = Auto
      DummyFunction = false
      EcuCSafeBswChecks = false
      DummyStatement = false
      DummyStatementKind = None
      ConditionalGenerating = true
      EcucBswImplementationCodeType = EcuCSourceCode
      EcuCUseStdReturnTypeForRte = false
    EcucHardware
      EcucCoreDefinition: EcucCoreId=0
