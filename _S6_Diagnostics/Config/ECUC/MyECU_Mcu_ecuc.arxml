AUTOSAR XML (schema 4-2-1)
package /ActiveEcuC
  module config Mcu: implementation-config-variant=VARIANT-PRE-COMPILE, module-description=Mcu_Impl
    McuGeneralConfiguration:
      McuDevErrorDetect = true
      McuGetRamStateApi = false
      McuInitClock = true
      McuNoPll = true
      McuPerformResetApi = true
      McuVersionInfoApi = true
      McuSafeBswChecks = false
    McuModuleConfiguration
      McuClockSettingConfig
        McuClockReferencePoint: McuClockReferencePointFrequency=80000000
      4 x McuModeSettingConf:
        NORMAL: McuMode=0, McuVttMode=VTTMCU_MODE_NORMAL
        SLEEP: McuMode=1, McuVttMode=VTTMCU_MODE_SLEEP
        RESET: McuMode=2, McuVttMode=VTTMCU_MODE_RESET
        POWER_OFF: McuMode=3, McuVttMode=VTTMCU_MODE_POWER_OFF
    McuPublishedInformation
      McuResetReasonConf: McuResetReason=0
