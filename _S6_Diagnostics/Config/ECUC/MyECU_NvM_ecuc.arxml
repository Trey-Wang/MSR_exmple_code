AUTOSAR XML (schema 4-2-1)
package /ActiveEcuC
  module config NvM: implementation-config-variant=VARIANT-PRE-COMPILE, module-description=NvM_Impl
    NvMConfigBlock (NvMBlockDescriptor):
      NvMBlockCrcType = NVM_CRC16
      NvMCalcRamBlockCrc = false
      NvMNvramBlockIdentifier = 1
      NvMBlockManagementType = NVM_BLOCK_REDUNDANT
      NvMNvBlockNum = 2
      NvMBlockUseCrc = true
      NvMNvBlockLength = 2
      NvMBlockJobPriority = 127
      NvMBlockUseSyncMechanism = false
      NvMBlockWriteProt = false
      NvMBswMBlockStatusInformation = false
      NvMInitBlockCallback = NULL_PTR
      NvMMaxNumOfReadRetries = 0
      NvMMaxNumOfWriteRetries = 0
      NvMResistantToChangedSw = true
      NvMRomBlockDataAddress = NULL_PTR
      NvMRomBlockNum = 0
      NvMSelectBlockForReadAll = true
      NvMSelectBlockForWriteAll = true
      NvMSingleBlockCallback = NULL_PTR
      NvMStaticBlockIDCheck = false
      NvMWriteBlockOnce = false
      NvMWriteRamBlockToNvCallback = NULL_PTR
      NvMWriteVerification = false
      NvMWriteVerificationDataSize = 1
      NvMUseServicePorts = true
      NvMUseJobendCallback = false
      NvMUseInitCallback = false
      NvMAutomaticBlockLength = false
      NvMBlockLengthCheck = false
      NvMBlockLengthCheckType = true
      NvMBlockUseCRCCompMechanism = false
      NvMTargetBlockReference
        NvMFeeRef: NvMNameOfFeeBlock=FeeConfigBlock
    NvMCommon:
      NvMBswMMultiBlockJobStatusInformation = true
      NvMCompiledConfigId = 1
      NvMCrcNumOfBytes = 64
      NvMDatasetSelectionBits = 4
      NvMDevErrorDetect = true
      NvMDrvModeSwitch = false
      NvMDynamicConfiguration = false
      NvMJobPrioritization = false
      NvMMultiBlockCallback = NULL_PTR
      NvMPollingMode = true
      NvMRepeatMirrorOperations = 0
      NvMSetRamBlockStatusApi = true
      NvMSizeStandardJobQueue = 2
      NvMVersionInfoApi = false
      NvMMaxNoOfWriteRetries = 1
      NvMMainFunctionPeriod = 0.01
      NvMUseBlockIdCheck = false
      NvMRepairRedundantBlocksApi = false
      NvMApiConfigClass = NVM_API_CONFIG_CLASS_3
      NvMSafeBswChecks = true
    NvMCommonVendorParams:
      NvMMultiblockId = MultiBlockRequest
      NvMCrcIntBuffer = true
      NvMKillWriteAllApi = true
      NvMCfgCbkIncludeList = main.h
      NvMCfgCbkIncludeList = Dem.h
      NvMCfgCbkIncludeList = Dem_Cbk.h
    NvmDemEventParameterRefs:
      NVM_E_INTEGRITY_FAILED = AutoCreatedDemEvent_NVM_E_INTEGRITY_FAILED
      NVM_E_LOSS_OF_REDUNDANCY = AutoCreatedDemEvent_NVM_E_LOSS_OF_REDUNDANCY
      NVM_E_QUEUE_OVERFLOW = AutoCreatedDemEvent_NVM_E_QUEUE_OVERFLOW
      NVM_E_REQ_FAILED = AutoCreatedDemEvent_NVM_E_REQ_FAILED
      NVM_E_VERIFY_FAILED = AutoCreatedDemEvent_NVM_E_VERIFY_FAILED
      NVM_E_WRITE_PROTECTED = AutoCreatedDemEvent_NVM_E_WRITE_PROTECTED
      NVM_E_WRONG_BLOCK_ID = AutoCreatedDemEvent_NVM_E_WRONG_BLOCK_ID
    12 x NvMBlockDescriptor, all with NvMBlockCrcType=NVM_CRC16, NvMBlockManagementType=NVM_BLOCK_NATIVE, NvMSelectBlockForReadAll=true, NvMSelectBlockForWriteAll=true, NvMWriteRamBlockToNvCallback=NULL_PTR, NvMBswMBlockStatusInformation=false, NvMBlockUseCrc=true, NvMBlockUseSyncMechanism=false, NvMCalcRamBlockCrc=false, NvMBlockJobPriority=127, NvMBlockWriteProt=false, NvMNvBlockNum=1, NvMWriteBlockOnce=false, NvMBlockUseCRCCompMechanism=false:
      DemAdminDataBlock: NvMInitBlockCallback=Dem_NvM_InitAdminData, NvMResistantToChangedSw=true, NvMUseInitCallback=true, NvMUseJobendCallback=true, NvMSingleBlockCallback=Dem_NvM_JobFinished, NvMNvBlockLength=10, NvMNvramBlockIdentifier=2, NvMRamBlockDataAddress=Dem_Cfg_AdminData, NvMRomBlockDataAddress=NULL_PTR, NvMUseServicePorts=false
        NvMTargetBlockReference
          NvMFeeRef: NvMNameOfFeeBlock=FeeDemAdminDataBlock
      DemStatusDataBlock: NvMInitBlockCallback=Dem_NvM_InitStatusData, NvMResistantToChangedSw=true, NvMUseInitCallback=true, NvMUseJobendCallback=true, NvMSingleBlockCallback=Dem_NvM_JobFinished, NvMNvBlockLength=22, NvMNvramBlockIdentifier=5, NvMRamBlockDataAddress=Dem_Cfg_StatusData, NvMRomBlockDataAddress=NULL_PTR, NvMUseServicePorts=false
        NvMTargetBlockReference
          NvMFeeRef: NvMNameOfFeeBlock=FeeDemStatusDataBlock
      DemPrimaryDataBlock0: NvMInitBlockCallback=NULL_PTR, NvMResistantToChangedSw=true, NvMUseInitCallback=false, NvMUseJobendCallback=true, NvMSingleBlockCallback=Dem_NvM_JobFinished, NvMNvBlockLength=20, NvMNvramBlockIdentifier=6, NvMRamBlockDataAddress=Dem_Cfg_PrimaryEntry_0, NvMRomBlockDataAddress=Dem_Cfg_MemoryEntryInit, NvMUseServicePorts=false
        NvMTargetBlockReference
          NvMFeeRef: NvMNameOfFeeBlock=FeeDemPrimaryDataBlock0
      DemPrimaryDataBlock1: NvMInitBlockCallback=NULL_PTR, NvMResistantToChangedSw=true, NvMUseInitCallback=false, NvMUseJobendCallback=true, NvMSingleBlockCallback=Dem_NvM_JobFinished, NvMNvBlockLength=20, NvMNvramBlockIdentifier=7, NvMRamBlockDataAddress=Dem_Cfg_PrimaryEntry_1, NvMRomBlockDataAddress=Dem_Cfg_MemoryEntryInit, NvMUseServicePorts=false
        NvMTargetBlockReference
          NvMFeeRef: NvMNameOfFeeBlock=FeeDemPrimaryDataBlock1
      DemPrimaryDataBlock2: NvMInitBlockCallback=NULL_PTR, NvMResistantToChangedSw=true, NvMUseInitCallback=false, NvMUseJobendCallback=true, NvMSingleBlockCallback=Dem_NvM_JobFinished, NvMNvBlockLength=20, NvMNvramBlockIdentifier=8, NvMRamBlockDataAddress=Dem_Cfg_PrimaryEntry_2, NvMRomBlockDataAddress=Dem_Cfg_MemoryEntryInit, NvMUseServicePorts=false
        NvMTargetBlockReference
          NvMFeeRef: NvMNameOfFeeBlock=FeeDemPrimaryDataBlock2
      DemPrimaryDataBlock3: NvMInitBlockCallback=NULL_PTR, NvMResistantToChangedSw=true, NvMUseInitCallback=false, NvMUseJobendCallback=true, NvMSingleBlockCallback=Dem_NvM_JobFinished, NvMNvBlockLength=20, NvMNvramBlockIdentifier=9, NvMRamBlockDataAddress=Dem_Cfg_PrimaryEntry_3, NvMRomBlockDataAddress=Dem_Cfg_MemoryEntryInit, NvMUseServicePorts=false
        NvMTargetBlockReference
          NvMFeeRef: NvMNameOfFeeBlock=FeeDemPrimaryDataBlock3
      DemPrimaryDataBlock4: NvMInitBlockCallback=NULL_PTR, NvMResistantToChangedSw=true, NvMUseInitCallback=false, NvMUseJobendCallback=true, NvMSingleBlockCallback=Dem_NvM_JobFinished, NvMNvBlockLength=20, NvMNvramBlockIdentifier=10, NvMRamBlockDataAddress=Dem_Cfg_PrimaryEntry_4, NvMRomBlockDataAddress=Dem_Cfg_MemoryEntryInit, NvMUseServicePorts=false
        NvMTargetBlockReference
          NvMFeeRef: NvMNameOfFeeBlock=FeeDemPrimaryDataBlock4
      DemPrimaryDataBlock5: NvMInitBlockCallback=NULL_PTR, NvMResistantToChangedSw=true, NvMUseInitCallback=false, NvMUseJobendCallback=true, NvMSingleBlockCallback=Dem_NvM_JobFinished, NvMNvBlockLength=20, NvMNvramBlockIdentifier=11, NvMRamBlockDataAddress=Dem_Cfg_PrimaryEntry_5, NvMRomBlockDataAddress=Dem_Cfg_MemoryEntryInit, NvMUseServicePorts=false
        NvMTargetBlockReference
          NvMFeeRef: NvMNameOfFeeBlock=FeeDemPrimaryDataBlock5
      DemPrimaryDataBlock6: NvMInitBlockCallback=NULL_PTR, NvMResistantToChangedSw=true, NvMUseInitCallback=false, NvMUseJobendCallback=true, NvMSingleBlockCallback=Dem_NvM_JobFinished, NvMNvBlockLength=20, NvMNvramBlockIdentifier=12, NvMRamBlockDataAddress=Dem_Cfg_PrimaryEntry_6, NvMRomBlockDataAddress=Dem_Cfg_MemoryEntryInit, NvMUseServicePorts=false
        NvMTargetBlockReference
          NvMFeeRef: NvMNameOfFeeBlock=FeeDemPrimaryDataBlock6
      DemPrimaryDataBlock7: NvMInitBlockCallback=NULL_PTR, NvMResistantToChangedSw=true, NvMUseInitCallback=false, NvMUseJobendCallback=true, NvMSingleBlockCallback=Dem_NvM_JobFinished, NvMNvBlockLength=20, NvMNvramBlockIdentifier=13, NvMRamBlockDataAddress=Dem_Cfg_PrimaryEntry_7, NvMRomBlockDataAddress=Dem_Cfg_MemoryEntryInit, NvMUseServicePorts=false
        NvMTargetBlockReference
          NvMFeeRef: NvMNameOfFeeBlock=FeeDemPrimaryDataBlock7
      CpApMySwcSnNvMPimLightOnOffCounter: NvMInitBlockCallback=NULL_PTR, NvMResistantToChangedSw=false, NvMUseInitCallback=false, NvMUseJobendCallback=false, NvMSingleBlockCallback=NULL_PTR, NvMNvBlockLength=4, NvMNvramBlockIdentifier=3, NvMUseServicePorts=true, NvMRamBlockDataAddress=Rte_CpApMySwc_PimLightOnOffCounter, NvMRomBlockDataAddress=NULL_PTR  # UC:Derived from NvBlockNeeds
        NvMTargetBlockReference
          NvMFeeRef: NvMNameOfFeeBlock=FeeCpApMySwcSnNvMPimLightOnOffCounter
      CpApMySwcSnNvMPimOdometer: NvMInitBlockCallback=NULL_PTR, NvMResistantToChangedSw=false, NvMUseInitCallback=false, NvMUseJobendCallback=true, NvMSingleBlockCallback=NULL_PTR, NvMNvBlockLength=4, NvMNvramBlockIdentifier=4, NvMUseServicePorts=true, NvMRamBlockDataAddress=Rte_CpApMySwc_PimOdometer, NvMRomBlockDataAddress=Rte_CtApMySwc_CalOdometer  # UC:Derived from NvBlockNeeds
        NvMTargetBlockReference
          NvMFeeRef: NvMNameOfFeeBlock=FeeCpApMySwcSnNvMPimOdometer
