AUTOSAR XML (schema 4-3-0)
package /Constants
  7 x constant specification:
    CBackLightDimCtrlInit: value-spec=0
    CDisplayOff: value-spec=0
    CDoorClosed: value-spec=0
    CLightOff: value-spec=0
    COdometerDefault: value-spec=1000
    CUInt32Zero: value-spec=0
    CWriteReqNotPending: value-spec=0
