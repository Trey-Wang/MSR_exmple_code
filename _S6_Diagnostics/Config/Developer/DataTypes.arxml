AUTOSAR XML (schema 4-3-0)
standard types defined: boolean, UInt8, uint8_DataConstr, uint32_DataConstr, uint8, uint32
package /ComponentTypes/DataTypeMappingSets
  data type mapping set DemoTypeMapping
    data-type-maps:
      application-data-type=AdtDoorState, implementation-data-type=IdtDoorState
      application-data-type=AdtLightState, implementation-data-type=IdtLightState
      application-data-type=AdtLightOnOffCounter, implementation-data-type=uint32
      application-data-type=AdtOdometer, implementation-data-type=uint32
    mode-request-type-maps:
      implementation-data-type=BswM_ESH_Mode, mode-group=ESH_Mode
      implementation-data-type=uint8, mode-group=ComMMode
package /Predefined_DEV/ImplementationDataTypes
  impl type NvM_RequestResultType: compu {0=NVM_REQ_OK, 1=NVM_REQ_NOT_OK, 2=NVM_REQ_PENDING, 3=NVM_REQ_INTEGRITY_FAILED, 4=NVM_REQ_BLOCK_SKIPPED, 5=NVM_REQ_NV_INVALIDATED, 6=NVM_REQ_CANCELED, 7=NVM_REQ_REDUNDANCY_FAILED, 8=NVM_REQ_RESTORED_FROM_ROM}, implementation-data-type=uint8
  impl type NvM_ServiceIdType: compu {6=NVM_READ_BLOCK, 7=NVM_WRITE_BLOCK, 8=NVM_RESTORE_BLOCK_DEFAULTS, 9=NVM_ERASE_BLOCK, 11=NVM_INVALIDATE_NV_BLOCK, 12=NVM_READ_ALL}, implementation-data-type=uint8
  impl type Dem_UdsStatusByteType: compu {mask 1: 1=DEM_UDS_STATUS_TF, mask 2: 2=DEM_UDS_STATUS_TFTOC, mask 4: 4=DEM_UDS_STATUS_PDTC, mask 8: 8=DEM_UDS_STATUS_CDTC, mask 16: 16=DEM_UDS_STATUS_TNCSLC, mask 32: 32=DEM_UDS_STATUS_TFSLC, mask 64: 64=DEM_UDS_STATUS_TNCTOC, mask 128: 128=DEM_UDS_STATUS_WIR}, range raw 0..255, implementation-data-type=uint8
package /DataType/Semantics
  compu method CM_sig_RearInteriorLight: 0..1=RANGE
  compu method CM_sig_State_RearInteriorLight: 0..1=RANGE
  compu method CM_sig_State_RearLeftDoor: 0..1=RANGE
  compu method CM_sig_State_RearRightDoor: 0..1=RANGE
package /DataTypes
  app type AdtDoorState: category=BOOLEAN, sw-calibration-access=READ-ONLY
  app type AdtLightState: category=BOOLEAN, sw-calibration-access=READ-ONLY
  4 x impl type, all with type-emitter=RTE:
    IdtDoorState: compu {0=CMDOORSTATE_DOORCLOSED, 1=CMDOORSTATE_DOOROPEN}, implementation-data-type=boolean
    IdtLightState: compu {0=CMLIGHTSTATE_LIGHTOFF, 1=CMLIGHTSTATE_LIGHTON}, implementation-data-type=boolean
    IdtDioValueType: implementation-data-type=uint8
    IdtDisplayIgnitionState: category=VALUE, base-type=UInt8, sw-calibration-access=READ-ONLY, compu {0=CMIGNITION_STATEON, 1=CMIGNITION_STATEOFF}
  app type AdtOdometer: category=VALUE, sw-calibration-access=READ-ONLY
  app type AdtLightOnOffCounter: category=VALUE, sw-calibration-access=READ-ONLY
