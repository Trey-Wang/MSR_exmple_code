AUTOSAR XML (schema 4-0-3)
package /DaVinci_Project
  module config Com
    ComConfig
      3 x ComSignal, all with ComSignalType=UINT8:
        sig_RearInteriorLight_0723e95e
        sig_State_RearLeftDoor_2b456e3f
        sig_State_RearRightDoor_2b456e3f
  module config Rte
    17 x RteBswModuleInstance:
      BswM
        BswM_MainFunctionTimingEvent0 (RteBswEventToTaskMapping): RteBswUsedOsEventRef=Rte_Ev_Cyclic2_SchM_Task_0_10ms, RteBswUsedOsAlarmRef=Os/Rte_Al_TE2_SchM_Task_0_10ms
      Can
        3 x RteBswEventToTaskMapping, all with RteBswUsedOsEventRef=Rte_Ev_Cyclic2_SchM_Task_0_10ms, RteBswUsedOsAlarmRef=Os/Rte_Al_TE2_SchM_Task_0_10ms:
          Can_MainFunction_BusOffTimingEvent0
          Can_MainFunction_ModeTimingEvent0
          Can_MainFunction_WakeupTimingEvent0
      CanIf
      CanNm
        CanNm_MainFunctionTimingEvent0 (RteBswEventToTaskMapping): RteBswUsedOsEventRef=Rte_Ev_Cyclic2_SchM_Task_0_10ms, RteBswUsedOsAlarmRef=Os/Rte_Al_TE2_SchM_Task_0_10ms
      CanSM
        CanSM_MainFunctionTimingEvent0 (RteBswEventToTaskMapping): RteBswUsedOsEventRef=Rte_Ev_Cyclic2_SchM_Task_0_10ms, RteBswUsedOsAlarmRef=Os/Rte_Al_TE2_SchM_Task_0_10ms
      CanTp
        CanTp_MainFunctionTimingEvent0 (RteBswEventToTaskMapping): RteBswUsedOsEventRef=Rte_Ev_Cyclic2_SchM_Task_0_5ms, RteBswUsedOsAlarmRef=Os/Rte_Al_TE2_SchM_Task_0_5ms
      Com
        Com_MainFunctionRxTimingEvent0 (RteBswEventToTaskMapping): RteBswUsedOsEventRef=Rte_Ev_Cyclic2_SchM_Task_0_10ms, RteBswUsedOsAlarmRef=Os/Rte_Al_TE2_SchM_Task_0_10ms
        Com_MainFunctionTxTimingEvent0 (RteBswEventToTaskMapping): RteBswUsedOsEventRef=Rte_Ev_Cyclic2_SchM_Task_0_10ms, RteBswUsedOsAlarmRef=Os/Rte_Al_TE2_SchM_Task_0_10ms
      ComM
        ComM_MainFunction_0TimingEvent0 (RteBswEventToTaskMapping): RteBswUsedOsEventRef=Rte_Ev_Cyclic2_SchM_Task_0_20ms, RteBswUsedOsAlarmRef=Os/Rte_Al_TE2_SchM_Task_0_20ms
      Dcm
        Dcm_MainFunctionTimingEvent0 (RteBswEventToTaskMapping): RteBswUsedOsEventRef=Rte_Ev_Cyclic2_SchM_Task_0_10ms, RteBswUsedOsAlarmRef=Os/Rte_Al_TE2_SchM_Task_0_10ms
      Dem
        Dem_MasterMainFunctionTimingEvent0 (RteBswEventToTaskMapping): RteBswUsedOsEventRef=Rte_Ev_Cyclic2_SchM_Task_0_10ms, RteBswUsedOsAlarmRef=Os/Rte_Al_TE2_SchM_Task_0_10ms
        Dem_SatelliteMainFunctionTimingEvent0 (RteBswEventToTaskMapping): RteBswUsedOsEventRef=Rte_Ev_Cyclic2_SchM_Task_0_10ms, RteBswUsedOsAlarmRef=Os/Rte_Al_TE2_SchM_Task_0_10ms
      Det
      EcuM
        EcuM_MainFunctionTimingEvent0 (RteBswEventToTaskMapping): RteBswUsedOsEventRef=Rte_Ev_Cyclic2_SchM_Task_0_10ms, RteBswUsedOsAlarmRef=Os/Rte_Al_TE2_SchM_Task_0_10ms
      Fee
        Fee_MainFunctionTimingEvent0 (RteBswEventToTaskMapping): RteBswUsedOsEventRef=Rte_Ev_Cyclic2_SchM_Task_0_5ms, RteBswUsedOsAlarmRef=Os/Rte_Al_TE2_SchM_Task_0_5ms
      Fls
        Fls_MainFunctionTimingEvent0 (RteBswEventToTaskMapping): RteBswUsedOsEventRef=Rte_Ev_Cyclic2_SchM_Task_0_10ms, RteBswUsedOsAlarmRef=Os/Rte_Al_TE2_SchM_Task_0_10ms
      Nm
      NvM
        NvM_MainFunctionTimingEvent0 (RteBswEventToTaskMapping): RteBswUsedOsEventRef=Rte_Ev_Cyclic2_SchM_Task_0_10ms, RteBswUsedOsAlarmRef=Os/Rte_Al_TE2_SchM_Task_0_10ms
      PduR
    14 x RteSwComponentInstance:
      BswM_EcuSwComposition
        Timer_BswM_MainFunction (RteEventToTaskMapping): RteUsedOsEventRef=Rte_Ev_Cyclic2_SchM_Task_0_10ms, RteUsedOsAlarmRef=Os/Rte_Al_TE2_SchM_Task_0_10ms
      ComM_EcuSwComposition
        Timer_ComM_MainFunction_0 (RteEventToTaskMapping): RteUsedOsEventRef=Rte_Ev_Cyclic2_SchM_Task_0_20ms, RteUsedOsAlarmRef=Os/Rte_Al_TE2_SchM_Task_0_20ms
      CpApMySwc_EcuSwComposition
        5 x RteEventToTaskMapping:
          TMT_RCtApMySwcCode: RteUsedOsEventRef=Rte_Ev_Run_CpApMySwc_RCtApMySwcCode, RteUsedOsAlarmRef=Os/Rte_Al_TE_CpApMySwc_RCtApMySwcCode
          MST_RCtApMySwcComM_ModeChange_FULL_COMM_Entry_0: RteUsedOsEventRef=Rte_Ev_Run_CpApMySwc_RCtApMySwcComM_ModeChange_FULL_COMM_Entry
          MST_RCtApMySwcComM_ModeChange_FULL_COMM_Exit_0: RteUsedOsEventRef=Rte_Ev_Run_CpApMySwc_RCtApMySwcComM_ModeChange_FULL_COMM_Exit
          DRT_Runnable_PpMrpPShutdownTimerDisplayCtApMySwc_requestedMode: RteUsedOsEventRef=Rte_Ev_Run_CpApMySwc_RCtApMySwcPostRunCode
          MST_RCtApMySwcPostRunCode_0: RteUsedOsEventRef=Rte_Ev_Run1_CpApMySwc_RCtApMySwcPostRunCode
        NvmBlock_CpApMySwc_SnNvMPimLightOnOffCounter (RteNvRamAllocation): RteNvmRamBlockLocationSymbol=Rte_CpApMySwc_PimLightOnOffCounter, RteNvmBlockRef=CpApMySwcSnNvMPimLightOnOffCounter
        NvmBlock_CpApMySwc_SnNvMPimOdometer (RteNvRamAllocation):
          RteNvmRamBlockLocationSymbol = Rte_CpApMySwc_PimOdometer
          RteNvmRomBlockLocationSymbol = Rte_CtApMySwc_CalOdometer
          RteNvmBlockRef = CpApMySwcSnNvMPimOdometer
      CpCddIoHwAb_EcuSwComposition
      CpSaDisplay_EcuSwComposition
        5 x RteEventToTaskMapping:
          DRT_RCtApDisplayBusStateHandling_PiDisplayState_DeDisplayBusState: RteUsedOsEventRef=Rte_Ev_Run_CpSaDisplay_RCtApDisplayBusStateHandling
          DRT_RCtApDisplayLightOnOffHandling_PiDisplayState_DeLightOnOffCounter: RteUsedOsEventRef=Rte_Ev_Run_CpSaDisplay_RCtApDisplayLightOnOffHandling
          DRT_RCtApDisplayOdometerValue_PiDisplayState_DeOdometerValue: RteUsedOsEventRef=Rte_Ev_Run_CpSaDisplay_RCtApDisplayOdometerValue
          DRT_RCtApDisplayOdometerWriteRequestPending_PiDisplayState_DeOdometerWriteRequestPending: RteUsedOsEventRef=Rte_Ev_Run_CpSaDisplay_RCtApDisplayOdometerWriteRequestPending
          TMT_RCtApDisplayReadIgnitionSignal: RteUsedOsEventRef=Rte_Ev_Cyclic_IO_Task_0_200ms, RteUsedOsAlarmRef=Os/Rte_Al_TE_IO_Task_0_200ms
      CpSaDoorFrontLeft_EcuSwComposition
        TMT_RCtSaDoorReadDoor (RteEventToTaskMapping): RteUsedOsEventRef=Rte_Ev_Cyclic_IO_Task_0_200ms, RteUsedOsAlarmRef=Os/Rte_Al_TE_IO_Task_0_200ms
      CpSaDoorFrontRight_EcuSwComposition
        TMT_RCtSaDoorReadDoor (RteEventToTaskMapping): RteUsedOsEventRef=Rte_Ev_Cyclic_IO_Task_0_200ms, RteUsedOsAlarmRef=Os/Rte_Al_TE_IO_Task_0_200ms
      CpSaInteriorLightFront_EcuSwComposition
        DRT_RCtSaInteriorLightSwitchLight_PpLightState_DeLightState (RteEventToTaskMapping): RteUsedOsEventRef=Rte_Ev_Run_CpSaInteriorLightFront_RCtSaInteriorLightSwitchLight
      Dcm_EcuSwComposition
        Timer_Dcm_MainFunction (RteEventToTaskMapping): RteUsedOsEventRef=Rte_Ev_Cyclic2_SchM_Task_0_10ms, RteUsedOsAlarmRef=Os/Rte_Al_TE2_SchM_Task_0_10ms
      DemMaster_0_EcuSwComposition
        Timer_Dem_MasterMainFunction (RteEventToTaskMapping): RteUsedOsEventRef=Rte_Ev_Cyclic2_SchM_Task_0_10ms, RteUsedOsAlarmRef=Os/Rte_Al_TE2_SchM_Task_0_10ms
      DemSatellite_0_EcuSwComposition
        Timer_Dem_SatelliteMainFunction (RteEventToTaskMapping): RteUsedOsEventRef=Rte_Ev_Cyclic2_SchM_Task_0_10ms, RteUsedOsAlarmRef=Os/Rte_Al_TE2_SchM_Task_0_10ms
      Det_EcuSwComposition
      EcuM_EcuSwComposition
        Timer_EcuM_MainFunction (RteEventToTaskMapping): RteUsedOsEventRef=Rte_Ev_Cyclic2_SchM_Task_0_10ms, RteUsedOsAlarmRef=Os/Rte_Al_TE2_SchM_Task_0_10ms
      NvM_EcuSwComposition
        Timer_NvM_MainFunction (RteEventToTaskMapping): RteUsedOsEventRef=Rte_Ev_Cyclic2_SchM_Task_0_10ms, RteUsedOsAlarmRef=Os/Rte_Al_TE2_SchM_Task_0_10ms
    RteOsInteraction
      5 x RteUsedOsActivation, all with RteExpectedActivationOffset=0:
        Rte_Al_TE_IO_Task_0_200ms: RteActivationOsAlarmRef=Os/Rte_Al_TE_IO_Task_0_200ms, RteActivationOsTaskRef=IO_Task
        Rte_Al_TE_CpApMySwc_RCtApMySwcCode: RteActivationOsAlarmRef=Os/Rte_Al_TE_CpApMySwc_RCtApMySwcCode, RteActivationOsTaskRef=My_Task
        Rte_Al_TE2_SchM_Task_0_10ms: RteActivationOsAlarmRef=Os/Rte_Al_TE2_SchM_Task_0_10ms, RteActivationOsTaskRef=SchM_Task
        Rte_Al_TE2_SchM_Task_0_20ms: RteActivationOsAlarmRef=Os/Rte_Al_TE2_SchM_Task_0_20ms, RteActivationOsTaskRef=SchM_Task
        Rte_Al_TE2_SchM_Task_0_5ms: RteActivationOsAlarmRef=Os/Rte_Al_TE2_SchM_Task_0_5ms, RteActivationOsTaskRef=SchM_Task
  module config NvM
    CpApMySwcSnNvMPimLightOnOffCounter (NvMBlockDescriptor): NvMNvBlockLength=4, NvMRamBlockDataAddress=Rte_CpApMySwc_PimLightOnOffCounter, NvMRomBlockDataAddress=NULL_PTR
    CpApMySwcSnNvMPimOdometer (NvMBlockDescriptor): NvMNvBlockLength=4, NvMRamBlockDataAddress=Rte_CpApMySwc_PimOdometer, NvMRomBlockDataAddress=Rte_CtApMySwc_CalOdometer
  module config Os
    IO_Task (OsTask):
      OsTaskActivation = 1
      OsTaskPriority = 2
      OsTaskSchedule = NON
      OsTaskEventRef = Rte_Ev_Cyclic_IO_Task_0_200ms
      OsTaskEventRef = Rte_Ev_Run_CpSaDisplay_RCtApDisplayBusStateHandling
      OsTaskEventRef = Rte_Ev_Run_CpSaDisplay_RCtApDisplayLightOnOffHandling
      OsTaskEventRef = Rte_Ev_Run_CpSaDisplay_RCtApDisplayOdometerValue
      OsTaskEventRef = Rte_Ev_Run_CpSaDisplay_RCtApDisplayOdometerWriteRequestPending
      OsTaskEventRef = Rte_Ev_Run_CpSaInteriorLightFront_RCtSaInteriorLightSwitchLight
    Rte_Al_TE_IO_Task_0_200ms (OsAlarm): OsAlarmCounterRef=SystemTimer
      OsAlarmAction
        OsAlarmSetEvent: OsAlarmSetEventRef=Rte_Ev_Cyclic_IO_Task_0_200ms, OsAlarmSetEventTaskRef=IO_Task
    My_Task (OsTask):
      OsTaskActivation = 1
      OsTaskPriority = 3
      OsTaskSchedule = NON
      OsTaskEventRef = Rte_Ev_Run1_CpApMySwc_RCtApMySwcPostRunCode
      OsTaskEventRef = Rte_Ev_Run_CpApMySwc_RCtApMySwcCode
      OsTaskEventRef = Rte_Ev_Run_CpApMySwc_RCtApMySwcComM_ModeChange_FULL_COMM_Entry
      OsTaskEventRef = Rte_Ev_Run_CpApMySwc_RCtApMySwcComM_ModeChange_FULL_COMM_Exit
      OsTaskEventRef = Rte_Ev_Run_CpApMySwc_RCtApMySwcPostRunCode
    Rte_Al_TE_CpApMySwc_RCtApMySwcCode (OsAlarm): OsAlarmCounterRef=SystemTimer
      OsAlarmAction
        OsAlarmSetEvent: OsAlarmSetEventRef=Rte_Ev_Run_CpApMySwc_RCtApMySwcCode, OsAlarmSetEventTaskRef=My_Task
    SchM_Task (OsTask):
      OsTaskActivation = 1
      OsTaskPriority = 6
      OsTaskSchedule = FULL
      OsTaskEventRef = Rte_Ev_Cyclic2_SchM_Task_0_10ms
      OsTaskEventRef = Rte_Ev_Cyclic2_SchM_Task_0_20ms
      OsTaskEventRef = Rte_Ev_Cyclic2_SchM_Task_0_5ms
    3 x OsAlarm, all with OsAlarmCounterRef=SystemTimer:
      Rte_Al_TE2_SchM_Task_0_10ms
        OsAlarmAction
          OsAlarmSetEvent: OsAlarmSetEventRef=Rte_Ev_Cyclic2_SchM_Task_0_10ms, OsAlarmSetEventTaskRef=SchM_Task
      Rte_Al_TE2_SchM_Task_0_20ms
        OsAlarmAction
          OsAlarmSetEvent: OsAlarmSetEventRef=Rte_Ev_Cyclic2_SchM_Task_0_20ms, OsAlarmSetEventTaskRef=SchM_Task
      Rte_Al_TE2_SchM_Task_0_5ms
        OsAlarmAction
          OsAlarmSetEvent: OsAlarmSetEventRef=Rte_Ev_Cyclic2_SchM_Task_0_5ms, OsAlarmSetEventTaskRef=SchM_Task
    14 x OsEvent:
      Rte_Ev_Cyclic2_SchM_Task_0_10ms
      Rte_Ev_Cyclic2_SchM_Task_0_20ms
      Rte_Ev_Cyclic2_SchM_Task_0_5ms
      Rte_Ev_Cyclic_IO_Task_0_200ms
      Rte_Ev_Run1_CpApMySwc_RCtApMySwcPostRunCode
      Rte_Ev_Run_CpApMySwc_RCtApMySwcCode
      Rte_Ev_Run_CpApMySwc_RCtApMySwcComM_ModeChange_FULL_COMM_Entry
      Rte_Ev_Run_CpApMySwc_RCtApMySwcComM_ModeChange_FULL_COMM_Exit
      Rte_Ev_Run_CpApMySwc_RCtApMySwcPostRunCode
      Rte_Ev_Run_CpSaDisplay_RCtApDisplayBusStateHandling
      Rte_Ev_Run_CpSaDisplay_RCtApDisplayLightOnOffHandling
      Rte_Ev_Run_CpSaDisplay_RCtApDisplayOdometerValue
      Rte_Ev_Run_CpSaDisplay_RCtApDisplayOdometerWriteRequestPending
      Rte_Ev_Run_CpSaInteriorLightFront_RCtSaInteriorLightSwitchLight
  ecuc value collection DaVinci_Project: ecuc-values=[Com, Rte, Os, NvM]
